/* saturn_fixed.ld -- Fixed-address linker script for Daytona USA reimpl
 * AUTO-GENERATED by tools/gen_fixed_layout.py -- do not edit manually
 *
 * Places every function at its original address in the production binary.
 * Overflowing C functions go in the OVERFLOW section with trampolines
 * at their original addresses.
 */

OUTPUT_FORMAT("elf32-sh")
OUTPUT_ARCH(sh)
ENTRY(_start)

MEMORY
{
    HWRAM (rwx) : ORIGIN = 0x06003000, LENGTH = 0xE0000
    LWRAM (rw)  : ORIGIN = 0x00200000, LENGTH = 0x100000
}

SECTIONS
{
    /* Entry point -- _start + boot() */
    .text.startup 0x06003000 :
    {
        *(.text.startup)
    } > HWRAM

    .func_FUN_060030FC 0x060030FC : SUBALIGN(1)
    {
        /* overflow: FUN_060030FC goes to catchall */
    } > HWRAM
    .func_FUN_06003218 0x06003218 : SUBALIGN(1)
    {
        *(.text.FUN_06003218)
        *(.text.sound_timer_init)
    } > HWRAM
    .func_FUN_06003274 0x06003274 : SUBALIGN(1)
    {
        *(.text.FUN_06003274)
        *(.text.vdp_init_dispatcher)
    } > HWRAM
    .func_FUN_060032D4 0x060032D4 : SUBALIGN(1)
    {
        *(.text.trampoline_FUN_060032D4)
    } > HWRAM
    .func_FUN_0600330A 0x0600330A : SUBALIGN(1)
    {
        *(.text.FUN_0600330A)
    } > HWRAM
    .func_FUN_06003466 0x06003466 : SUBALIGN(1)
    {
        *(.text.FUN_06003466)
    } > HWRAM
    .func_FUN_060034D4 0x060034D4 : SUBALIGN(1)
    {
        *(.text.FUN_060034D4)
    } > HWRAM
    .func_FUN_06003508 0x06003508 : SUBALIGN(1)
    {
        *(.text.FUN_06003508)
    } > HWRAM
    .func_FUN_06003578 0x06003578 : SUBALIGN(1)
    {
        *(.text.FUN_06003578)
    } > HWRAM
    .func_FUN_060038D4 0x060038D4 : SUBALIGN(1)
    {
        *(.text.FUN_060038D4)
        *(.text.vdp2_cram_load)
    } > HWRAM
    .func_FUN_06003A3C 0x06003A3C : SUBALIGN(1)
    {
        *(.text.FUN_06003A3C)
    } > HWRAM
    .func_FUN_06004670 0x06004670 : SUBALIGN(1)
    {
        *(.text.FUN_06004670)
    } > HWRAM
    .func_FUN_06004A98 0x06004A98 : SUBALIGN(1)
    {
        *(.text.FUN_06004A98)
    } > HWRAM
    .func_FUN_06004F14 0x06004F14 : SUBALIGN(1)
    {
        *(.text.FUN_06004F14)
    } > HWRAM
    .func_FUN_06004F28 0x06004F28 : SUBALIGN(1)
    {
        *(.text.FUN_06004F28)
    } > HWRAM
    .func_FUN_0600508C 0x0600508C : SUBALIGN(1)
    {
        *(.text.FUN_0600508C)
    } > HWRAM
    .func_FUN_06005120 0x06005120 : SUBALIGN(1)
    {
        *(.text.FUN_06005120)
    } > HWRAM
    .func_FUN_06005198 0x06005198 : SUBALIGN(1)
    {
        *(.text.FUN_06005198)
    } > HWRAM
    .func_FUN_06005294 0x06005294 : SUBALIGN(1)
    {
        *(.text.FUN_06005294)
    } > HWRAM
    .func_FUN_060053AC 0x060053AC : SUBALIGN(1)
    {
        *(.text.FUN_060053AC)
    } > HWRAM
    .func_FUN_06005494 0x06005494 : SUBALIGN(1)
    {
        *(.text.FUN_06005494)
    } > HWRAM
    .func_FUN_0600553C 0x0600553C : SUBALIGN(1)
    {
        *(.text.FUN_0600553C)
    } > HWRAM
    .func_FUN_060055BC 0x060055BC : SUBALIGN(1)
    {
        *(.text.FUN_060055BC)
    } > HWRAM
    .func_FUN_06005788 0x06005788 : SUBALIGN(1)
    {
        *(.text.FUN_06005788)
    } > HWRAM
    .func_FUN_0600579C 0x0600579C : SUBALIGN(1)
    {
        *(.text.FUN_0600579C)
    } > HWRAM
    .func_FUN_060058FA 0x060058FA : SUBALIGN(1)
    {
        *(.text.FUN_060058FA)
    } > HWRAM
    .func_FUN_06005928 0x06005928 : SUBALIGN(1)
    {
        *(.text.FUN_06005928)
    } > HWRAM
    .func_FUN_06005A22 0x06005A22 : SUBALIGN(1)
    {
        *(.text.FUN_06005A22)
    } > HWRAM
    .func_FUN_06005AE8 0x06005AE8 : SUBALIGN(1)
    {
        *(.text.FUN_06005AE8)
    } > HWRAM
    .func_FUN_06005C98 0x06005C98 : SUBALIGN(1)
    {
        *(.text.FUN_06005C98)
    } > HWRAM
    .func_FUN_06005DD4 0x06005DD4 : SUBALIGN(1)
    {
        *(.text.FUN_06005DD4)
    } > HWRAM
    .func_FUN_06005ECC 0x06005ECC : SUBALIGN(1)
    {
        *(.text.FUN_06005ECC)
    } > HWRAM
    .func_FUN_060061C8 0x060061C8 : SUBALIGN(1)
    {
        /* overflow: FUN_060061C8 goes to catchall */
    } > HWRAM
    .func_FUN_0600629C 0x0600629C : SUBALIGN(1)
    {
        *(.text.FUN_0600629C)
    } > HWRAM
    .func_FUN_060064F2 0x060064F2 : SUBALIGN(1)
    {
        *(.text.FUN_060064F2)
    } > HWRAM
    .func_FUN_060067C8 0x060067C8 : SUBALIGN(1)
    {
        *(.text.FUN_060067C8)
    } > HWRAM
    .func_FUN_06006868 0x06006868 : SUBALIGN(1)
    {
        *(.text.FUN_06006868)
    } > HWRAM
    .func_FUN_06006A9C 0x06006A9C : SUBALIGN(1)
    {
        *(.text.FUN_06006A9C)
    } > HWRAM
    .func_FUN_06006CDC 0x06006CDC : SUBALIGN(1)
    {
        *(.text.FUN_06006CDC)
    } > HWRAM
    .func_FUN_06006F3C 0x06006F3C : SUBALIGN(1)
    {
        *(.text.FUN_06006F3C)
    } > HWRAM
    .func_FUN_06007268 0x06007268 : SUBALIGN(1)
    {
        *(.text.FUN_06007268)
    } > HWRAM
    .func_FUN_060072E6 0x060072E6 : SUBALIGN(1)
    {
        *(.text.FUN_060072E6)
    } > HWRAM
    .func_FUN_0600736C 0x0600736C : SUBALIGN(1)
    {
        *(.text.FUN_0600736C)
    } > HWRAM
    .func_FUN_06007370 0x06007370 : SUBALIGN(1)
    {
        *(.text.FUN_06007370)
    } > HWRAM
    .func_FUN_0600747C 0x0600747C : SUBALIGN(1)
    {
        *(.text.FUN_0600747C)
    } > HWRAM
    .func_FUN_06007658 0x06007658 : SUBALIGN(1)
    {
        *(.text.FUN_06007658)
    } > HWRAM
    .func_FUN_06007790 0x06007790 : SUBALIGN(1)
    {
        *(.text.FUN_06007790)
    } > HWRAM
    .func_FUN_060078DC 0x060078DC : SUBALIGN(1)
    {
        *(.text.FUN_060078DC)
    } > HWRAM
    .func_FUN_06007A50 0x06007A50 : SUBALIGN(1)
    {
        *(.text.FUN_06007A50)
    } > HWRAM
    .func_FUN_06007BCC 0x06007BCC : SUBALIGN(1)
    {
        *(.text.FUN_06007BCC)
    } > HWRAM
    .func_FUN_06007CEC 0x06007CEC : SUBALIGN(1)
    {
        *(.text.FUN_06007CEC)
    } > HWRAM
    .func_FUN_06007D8E 0x06007D8E : SUBALIGN(1)
    {
        *(.text.FUN_06007D8E)
    } > HWRAM
    .func_FUN_06007E08 0x06007E08 : SUBALIGN(1)
    {
        *(.text.FUN_06007E08)
    } > HWRAM
    .func_FUN_060081F4 0x060081F4 : SUBALIGN(1)
    {
        *(.text.FUN_060081F4)
    } > HWRAM
    .func_FUN_06008318 0x06008318 : SUBALIGN(1)
    {
        *(.text.FUN_06008318)
    } > HWRAM
    .func_FUN_06008418 0x06008418 : SUBALIGN(1)
    {
        *(.text.trampoline_FUN_06008418)
    } > HWRAM
    .func_FUN_06008460 0x06008460 : SUBALIGN(1)
    {
        *(.text.trampoline_FUN_06008460)
    } > HWRAM
    .func_FUN_060084CA 0x060084CA : SUBALIGN(1)
    {
        *(.text.FUN_060084CA)
    } > HWRAM
    .func_FUN_060085B8 0x060085B8 : SUBALIGN(1)
    {
        *(.text.FUN_060085B8)
    } > HWRAM
    .func_FUN_060086C0 0x060086C0 : SUBALIGN(1)
    {
        *(.text.FUN_060086C0)
    } > HWRAM
    .func_FUN_060088CC 0x060088CC : SUBALIGN(1)
    {
        *(.text.FUN_060088CC)
    } > HWRAM
    .func_FUN_06008938 0x06008938 : SUBALIGN(1)
    {
        /* overflow: FUN_06008938 goes to catchall */
    } > HWRAM
    .func_FUN_0600893C 0x0600893C : SUBALIGN(1)
    {
        *(.text.FUN_0600893C)
    } > HWRAM
    .func_FUN_06008A18 0x06008A18 : SUBALIGN(1)
    {
        *(.text.FUN_06008A18)
    } > HWRAM
    .func_FUN_06008B04 0x06008B04 : SUBALIGN(1)
    {
        /* overflow: FUN_06008B04 goes to catchall */
    } > HWRAM
    .func_FUN_06008B34 0x06008B34 : SUBALIGN(1)
    {
        *(.text.FUN_06008B34)
    } > HWRAM
    .func_FUN_06008B78 0x06008B78 : SUBALIGN(1)
    {
        /* overflow: FUN_06008B78 goes to catchall */
    } > HWRAM
    .func_FUN_06008B9C 0x06008B9C : SUBALIGN(1)
    {
        *(.text.FUN_06008B9C)
    } > HWRAM
    .func_FUN_06008BD8 0x06008BD8 : SUBALIGN(1)
    {
        /* overflow: FUN_06008BD8 goes to catchall */
    } > HWRAM
    .func_FUN_06008BFC 0x06008BFC : SUBALIGN(1)
    {
        /* overflow: FUN_06008BFC goes to catchall */
    } > HWRAM
    .func_FUN_06008C14 0x06008C14 : SUBALIGN(1)
    {
        *(.text.FUN_06008C14)
    } > HWRAM
    .func_FUN_06008C76 0x06008C76 : SUBALIGN(1)
    {
        *(.text.FUN_06008C76)
    } > HWRAM
    .func_FUN_06008CCC 0x06008CCC : SUBALIGN(1)
    {
        /* overflow: FUN_06008CCC goes to catchall */
    } > HWRAM
    .func_FUN_06008CD0 0x06008CD0 : SUBALIGN(1)
    {
        *(.text.FUN_06008CD0)
    } > HWRAM
    .func_FUN_06008D74 0x06008D74 : SUBALIGN(1)
    {
        *(.text.FUN_06008D74)
    } > HWRAM
    .func_FUN_06008E00 0x06008E00 : SUBALIGN(1)
    {
        /* overflow: FUN_06008E00 goes to catchall */
    } > HWRAM
    .func_FUN_06008E48 0x06008E48 : SUBALIGN(1)
    {
        *(.text.FUN_06008E48)
    } > HWRAM
    .func_FUN_06008EBC 0x06008EBC : SUBALIGN(1)
    {
        *(.text.FUN_06008EBC)
    } > HWRAM
    .func_FUN_06009098 0x06009098 : SUBALIGN(1)
    {
        *(.text.FUN_06009098)
    } > HWRAM
    .func_FUN_06009290 0x06009290 : SUBALIGN(1)
    {
        *(.text.FUN_06009290)
    } > HWRAM
    .func_FUN_060092D0 0x060092D0 : SUBALIGN(1)
    {
        *(.text.FUN_060092D0)
    } > HWRAM
    .func_FUN_06009508 0x06009508 : SUBALIGN(1)
    {
        *(.text.FUN_06009508)
    } > HWRAM
    .func_FUN_0600955E 0x0600955E : SUBALIGN(1)
    {
        *(.text.FUN_0600955E)
    } > HWRAM
    .func_FUN_060096DC 0x060096DC : SUBALIGN(1)
    {
        *(.text.FUN_060096DC)
    } > HWRAM
    .func_FUN_06009788 0x06009788 : SUBALIGN(1)
    {
        *(.text.FUN_06009788)
    } > HWRAM
    .func_FUN_06009A60 0x06009A60 : SUBALIGN(1)
    {
        *(.text.FUN_06009A60)
    } > HWRAM
    .func_FUN_06009C48 0x06009C48 : SUBALIGN(1)
    {
        /* overflow: FUN_06009C48 goes to catchall */
    } > HWRAM
    .func_FUN_06009CFC 0x06009CFC : SUBALIGN(1)
    {
        *(.text.FUN_06009CFC)
    } > HWRAM
    .func_FUN_06009D4E 0x06009D4E : SUBALIGN(1)
    {
        *(.text.FUN_06009D4E)
    } > HWRAM
    .func_FUN_06009DD0 0x06009DD0 : SUBALIGN(1)
    {
        /* overflow: FUN_06009DD0 goes to catchall */
    } > HWRAM
    .func_FUN_06009E02 0x06009E02 : SUBALIGN(1)
    {
        *(.text.FUN_06009E02)
    } > HWRAM
    .func_FUN_06009E60 0x06009E60 : SUBALIGN(1)
    {
        *(.text.FUN_06009E60)
    } > HWRAM
    .func_FUN_06009F10 0x06009F10 : SUBALIGN(1)
    {
        *(.text.FUN_06009F10)
    } > HWRAM
    .func_FUN_06009FFC 0x06009FFC : SUBALIGN(1)
    {
        *(.text.FUN_06009FFC)
    } > HWRAM
    .func_FUN_0600A000 0x0600A000 : SUBALIGN(1)
    {
        /* overflow: FUN_0600A000 goes to catchall */
    } > HWRAM
    .func_FUN_0600A026 0x0600A026 : SUBALIGN(1)
    {
        *(.text.FUN_0600A026)
    } > HWRAM
    .func_FUN_0600A0C0 0x0600A0C0 : SUBALIGN(1)
    {
        *(.text.FUN_0600A0C0)
    } > HWRAM
    .func_FUN_0600A140 0x0600A140 : SUBALIGN(1)
    {
        *(.text.FUN_0600A140)
    } > HWRAM
    .func_FUN_0600A392 0x0600A392 : SUBALIGN(1)
    {
        *(.text.FUN_0600A392)
    } > HWRAM
    .func_FUN_0600A474 0x0600A474 : SUBALIGN(1)
    {
        *(.text.FUN_0600A474)
    } > HWRAM
    .func_FUN_0600A478 0x0600A478 : SUBALIGN(1)
    {
        *(.text.FUN_0600A478)
    } > HWRAM
    .func_FUN_0600A4AA 0x0600A4AA : SUBALIGN(1)
    {
        *(.text.FUN_0600A4AA)
    } > HWRAM
    .func_FUN_0600A4CA 0x0600A4CA : SUBALIGN(1)
    {
        *(.text.FUN_0600A4CA)
    } > HWRAM
    .func_FUN_0600A5B2 0x0600A5B2 : SUBALIGN(1)
    {
        *(.text.FUN_0600A5B2)
    } > HWRAM
    .func_FUN_0600A614 0x0600A614 : SUBALIGN(1)
    {
        *(.text.FUN_0600A614)
    } > HWRAM
    .func_FUN_0600A76C 0x0600A76C : SUBALIGN(1)
    {
        *(.text.FUN_0600A76C)
    } > HWRAM
    .func_FUN_0600A914 0x0600A914 : SUBALIGN(1)
    {
        *(.text.FUN_0600A914)
    } > HWRAM
    .func_FUN_0600AA98 0x0600AA98 : SUBALIGN(1)
    {
        *(.text.FUN_0600AA98)
    } > HWRAM
    .func_FUN_0600AC44 0x0600AC44 : SUBALIGN(1)
    {
        *(.text.FUN_0600AC44)
    } > HWRAM
    .func_FUN_0600ADD4 0x0600ADD4 : SUBALIGN(1)
    {
        *(.text.FUN_0600ADD4)
    } > HWRAM
    .func_FUN_0600AFB2 0x0600AFB2 : SUBALIGN(1)
    {
        *(.text.FUN_0600AFB2)
    } > HWRAM
    .func_FUN_0600B1A0 0x0600B1A0 : SUBALIGN(1)
    {
        *(.text.FUN_0600B1A0)
    } > HWRAM
    .func_FUN_0600B340 0x0600B340 : SUBALIGN(1)
    {
        *(.text.FUN_0600B340)
    } > HWRAM
    .func_FUN_0600B4D2 0x0600B4D2 : SUBALIGN(1)
    {
        *(.text.FUN_0600B4D2)
    } > HWRAM
    .func_FUN_0600B6A0 0x0600B6A0 : SUBALIGN(1)
    {
        *(.text.FUN_0600B6A0)
    } > HWRAM
    .func_FUN_0600B914 0x0600B914 : SUBALIGN(1)
    {
        *(.text.FUN_0600B914)
    } > HWRAM
    .func_FUN_0600BB94 0x0600BB94 : SUBALIGN(1)
    {
        *(.text.FUN_0600BB94)
    } > HWRAM
    .func_FUN_0600BFFC 0x0600BFFC : SUBALIGN(1)
    {
        *(.text.FUN_0600BFFC)
    } > HWRAM
    .func_FUN_0600C010 0x0600C010 : SUBALIGN(1)
    {
        *(.text.FUN_0600C010)
    } > HWRAM
    .func_FUN_0600C170 0x0600C170 : SUBALIGN(1)
    {
        *(.text.FUN_0600C170)
    } > HWRAM
    .func_FUN_0600C218 0x0600C218 : SUBALIGN(1)
    {
        *(.text.FUN_0600C218)
    } > HWRAM
    .func_FUN_0600C286 0x0600C286 : SUBALIGN(1)
    {
        *(.text.FUN_0600C286)
    } > HWRAM
    .func_FUN_0600C4F8 0x0600C4F8 : SUBALIGN(1)
    {
        *(.text.FUN_0600C4F8)
    } > HWRAM
    .func_FUN_0600C5D6 0x0600C5D6 : SUBALIGN(1)
    {
        /* overflow: FUN_0600C5D6 goes to catchall */
    } > HWRAM
    .func_FUN_0600C74E 0x0600C74E : SUBALIGN(1)
    {
        /* overflow: FUN_0600C74E goes to catchall */
    } > HWRAM
    .func_FUN_0600C7D4 0x0600C7D4 : SUBALIGN(1)
    {
        /* overflow: FUN_0600C7D4 goes to catchall */
    } > HWRAM
    .func_FUN_0600C7D8 0x0600C7D8 : SUBALIGN(1)
    {
        *(.text.FUN_0600C7D8)
        *(.text.FUN_0600C7D4)
    } > HWRAM
    .func_FUN_0600C8CC 0x0600C8CC : SUBALIGN(1)
    {
        /* overflow: FUN_0600C8CC goes to catchall */
    } > HWRAM
    .func_FUN_0600C8D0 0x0600C8D0 : SUBALIGN(1)
    {
        *(.text.FUN_0600C8D0)
        *(.text.FUN_0600C8CC)
    } > HWRAM
    .func_FUN_0600C994 0x0600C994 : SUBALIGN(1)
    {
        *(.text.FUN_0600C994)
    } > HWRAM
    .func_FUN_0600CB90 0x0600CB90 : SUBALIGN(1)
    {
        *(.text.FUN_0600CB90)
    } > HWRAM
    .func_FUN_0600CC38 0x0600CC38 : SUBALIGN(1)
    {
        *(.text.FUN_0600CC38)
    } > HWRAM
    .func_FUN_0600CD40 0x0600CD40 : SUBALIGN(1)
    {
        *(.text.FUN_0600CD40)
    } > HWRAM
    .func_FUN_0600CDD0 0x0600CDD0 : SUBALIGN(1)
    {
        *(.text.FUN_0600CDD0)
    } > HWRAM
    .func_FUN_0600CE66 0x0600CE66 : SUBALIGN(1)
    {
        *(.text.trampoline_FUN_0600CE66)
    } > HWRAM
    .func_FUN_0600CEBA 0x0600CEBA : SUBALIGN(1)
    {
        *(.text.FUN_0600CEBA)
    } > HWRAM
    .func_FUN_0600CF58 0x0600CF58 : SUBALIGN(1)
    {
        /* overflow: FUN_0600CF58 goes to catchall */
    } > HWRAM
    .func_FUN_0600D12C 0x0600D12C : SUBALIGN(1)
    {
        *(.text.FUN_0600D12C)
    } > HWRAM
    .func_FUN_0600D31C 0x0600D31C : SUBALIGN(1)
    {
        *(.text.FUN_0600D31C)
    } > HWRAM
    .func_FUN_0600D41C 0x0600D41C : SUBALIGN(1)
    {
        *(.text.FUN_0600D41C)
    } > HWRAM
    .func_FUN_0600D50C 0x0600D50C : SUBALIGN(1)
    {
        *(.text.FUN_0600D50C)
    } > HWRAM
    .func_FUN_0600D780 0x0600D780 : SUBALIGN(1)
    {
        *(.text.FUN_0600D780)
    } > HWRAM
    .func_FUN_0600D8A4 0x0600D8A4 : SUBALIGN(1)
    {
        *(.text.FUN_0600D8A4)
    } > HWRAM
    .func_FUN_0600D92C 0x0600D92C : SUBALIGN(1)
    {
        *(.text.FUN_0600D92C)
    } > HWRAM
    .func_FUN_0600D9BC 0x0600D9BC : SUBALIGN(1)
    {
        *(.text.FUN_0600D9BC)
    } > HWRAM
    .func_FUN_0600DA7C 0x0600DA7C : SUBALIGN(1)
    {
        *(.text.FUN_0600DA7C)
    } > HWRAM
    .func_FUN_0600DBA0 0x0600DBA0 : SUBALIGN(1)
    {
        *(.text.FUN_0600DBA0)
    } > HWRAM
    .func_FUN_0600DC74 0x0600DC74 : SUBALIGN(1)
    {
        *(.text.FUN_0600DC74)
    } > HWRAM
    .func_FUN_0600DCC8 0x0600DCC8 : SUBALIGN(1)
    {
        *(.text.FUN_0600DCC8)
    } > HWRAM
    .func_FUN_0600DD88 0x0600DD88 : SUBALIGN(1)
    {
        *(.text.FUN_0600DD88)
    } > HWRAM
    .func_FUN_0600DE40 0x0600DE40 : SUBALIGN(1)
    {
        /* overflow: FUN_0600DE40 goes to catchall */
    } > HWRAM
    .func_FUN_0600DE54 0x0600DE54 : SUBALIGN(1)
    {
        /* overflow: FUN_0600DE54 goes to catchall */
    } > HWRAM
    .func_FUN_0600DE70 0x0600DE70 : SUBALIGN(1)
    {
        *(.text.FUN_0600DE70)
    } > HWRAM
    .func_FUN_0600DF66 0x0600DF66 : SUBALIGN(1)
    {
        *(.text.FUN_0600DF66)
    } > HWRAM
    .func_FUN_0600DFD0 0x0600DFD0 : SUBALIGN(1)
    {
        *(.text.trampoline_FUN_0600DFD0)
    } > HWRAM
    .func_FUN_0600E060 0x0600E060 : SUBALIGN(1)
    {
        *(.text.trampoline_FUN_0600E060)
    } > HWRAM
    .func_FUN_0600E0C0 0x0600E0C0 : SUBALIGN(1)
    {
        *(.text.FUN_0600E0C0)
    } > HWRAM
    .func_FUN_0600E1D4 0x0600E1D4 : SUBALIGN(1)
    {
        *(.text.FUN_0600E1D4)
    } > HWRAM
    .func_FUN_0600E410 0x0600E410 : SUBALIGN(1)
    {
        /* overflow: FUN_0600E410 goes to catchall */
    } > HWRAM
    .func_FUN_0600E47C 0x0600E47C : SUBALIGN(1)
    {
        /* overflow: FUN_0600E47C goes to catchall */
    } > HWRAM
    .func_FUN_0600E4F2 0x0600E4F2 : SUBALIGN(1)
    {
        *(.text.FUN_0600E4F2)
    } > HWRAM
    .func_FUN_0600E71A 0x0600E71A : SUBALIGN(1)
    {
        *(.text.FUN_0600E71A)
    } > HWRAM
    .func_FUN_0600E7C8 0x0600E7C8 : SUBALIGN(1)
    {
        /* overflow: FUN_0600E7C8 goes to catchall */
    } > HWRAM
    .func_FUN_0600E906 0x0600E906 : SUBALIGN(1)
    {
        /* overflow: FUN_0600E906 goes to catchall */
    } > HWRAM
    .func_FUN_0600E99C 0x0600E99C : SUBALIGN(1)
    {
        *(.text.FUN_0600E99C)
    } > HWRAM
    .func_FUN_0600EB14 0x0600EB14 : SUBALIGN(1)
    {
        *(.text.FUN_0600EB14)
    } > HWRAM
    .func_FUN_0600EC78 0x0600EC78 : SUBALIGN(1)
    {
        *(.text.FUN_0600EC78)
    } > HWRAM
    .func_FUN_0600F424 0x0600F424 : SUBALIGN(1)
    {
        *(.text.FUN_0600F424)
    } > HWRAM
    .func_FUN_0600F650 0x0600F650 : SUBALIGN(1)
    {
        *(.text.FUN_0600F650)
    } > HWRAM
    .func_FUN_0600F794 0x0600F794 : SUBALIGN(1)
    {
        *(.text.FUN_0600F794)
    } > HWRAM
    .func_FUN_0600F822 0x0600F822 : SUBALIGN(1)
    {
        *(.text.FUN_0600F822)
    } > HWRAM
    .func_FUN_0600F870 0x0600F870 : SUBALIGN(1)
    {
        *(.text.FUN_0600F870)
    } > HWRAM
    .func_FUN_0600F898 0x0600F898 : SUBALIGN(1)
    {
        *(.text.trampoline_FUN_0600F898)
    } > HWRAM
    .func_FUN_0600F8BE 0x0600F8BE : SUBALIGN(1)
    {
        *(.text.FUN_0600F8BE)
    } > HWRAM
    .func_FUN_0600F914 0x0600F914 : SUBALIGN(1)
    {
        *(.text.FUN_0600F914)
    } > HWRAM
    .func_FUN_0600F98C 0x0600F98C : SUBALIGN(1)
    {
        *(.text.trampoline_FUN_0600F98C)
    } > HWRAM
    .func_FUN_0600F990 0x0600F990 : SUBALIGN(1)
    {
        /* overflow: FUN_0600F990 goes to catchall */
    } > HWRAM
    .func_FUN_0600F9C6 0x0600F9C6 : SUBALIGN(1)
    {
        *(.text.FUN_0600F9C6)
    } > HWRAM
    .func_FUN_0600FB78 0x0600FB78 : SUBALIGN(1)
    {
        *(.text.FUN_0600FB78)
    } > HWRAM
    .func_FUN_0600FD54 0x0600FD54 : SUBALIGN(1)
    {
        *(.text.trampoline_FUN_0600FD54)
    } > HWRAM
    .func_FUN_0600FD8A 0x0600FD8A : SUBALIGN(1)
    {
        *(.text.FUN_0600FD8A)
    } > HWRAM
    .func_FUN_0600FDFE 0x0600FDFE : SUBALIGN(1)
    {
        *(.text.trampoline_FUN_0600FDFE)
    } > HWRAM
    .func_FUN_0600FE38 0x0600FE38 : SUBALIGN(1)
    {
        *(.text.FUN_0600FE38)
    } > HWRAM
    .func_FUN_0600FED0 0x0600FED0 : SUBALIGN(1)
    {
        *(.text.FUN_0600FED0)
    } > HWRAM
    .func_FUN_0600FFD0 0x0600FFD0 : SUBALIGN(1)
    {
        *(.text.FUN_0600FFD0)
    } > HWRAM
    .func_FUN_060100A4 0x060100A4 : SUBALIGN(1)
    {
        *(.text.FUN_060100A4)
    } > HWRAM
    .func_FUN_060102EC 0x060102EC : SUBALIGN(1)
    {
        *(.text.FUN_060102EC)
    } > HWRAM
    .func_FUN_060103B8 0x060103B8 : SUBALIGN(1)
    {
        *(.text.FUN_060103B8)
    } > HWRAM
    .func_FUN_06010470 0x06010470 : SUBALIGN(1)
    {
        /* overflow: FUN_06010470 goes to catchall */
    } > HWRAM
    .func_FUN_060104E0 0x060104E0 : SUBALIGN(1)
    {
        *(.text.FUN_060104E0)
    } > HWRAM
    .func_FUN_06010760 0x06010760 : SUBALIGN(1)
    {
        *(.text.FUN_06010760)
    } > HWRAM
    .func_FUN_06010994 0x06010994 : SUBALIGN(1)
    {
        *(.text.FUN_06010994)
    } > HWRAM
    .func_FUN_06010AA4 0x06010AA4 : SUBALIGN(1)
    {
        *(.text.FUN_06010AA4)
    } > HWRAM
    .func_FUN_06010B54 0x06010B54 : SUBALIGN(1)
    {
        *(.text.FUN_06010B54)
        *(.text.sound_bank_load)
    } > HWRAM
    .func_FUN_06010BC4 0x06010BC4 : SUBALIGN(1)
    {
        *(.text.FUN_06010BC4)
    } > HWRAM
    .func_FUN_06010D94 0x06010D94 : SUBALIGN(1)
    {
        *(.text.FUN_06010D94)
    } > HWRAM
    .func_FUN_06010F04 0x06010F04 : SUBALIGN(1)
    {
        *(.text.FUN_06010F04)
    } > HWRAM
    .func_FUN_06011094 0x06011094 : SUBALIGN(1)
    {
        *(.text.trampoline_FUN_06011094)
    } > HWRAM
    .func_FUN_060111E2 0x060111E2 : SUBALIGN(1)
    {
        *(.text.FUN_060111E2)
    } > HWRAM
    .func_FUN_06011310 0x06011310 : SUBALIGN(1)
    {
        *(.text.FUN_06011310)
    } > HWRAM
    .func_FUN_060114AC 0x060114AC : SUBALIGN(1)
    {
        *(.text.FUN_060114AC)
    } > HWRAM
    .func_FUN_060114B8 0x060114B8 : SUBALIGN(1)
    {
        *(.text.FUN_060114B8)
    } > HWRAM
    .func_FUN_0601155E 0x0601155E : SUBALIGN(1)
    {
        *(.text.FUN_0601155E)
    } > HWRAM
    .func_FUN_060115F0 0x060115F0 : SUBALIGN(1)
    {
        *(.text.FUN_060115F0)
    } > HWRAM
    .func_FUN_06011678 0x06011678 : SUBALIGN(1)
    {
        *(.text.FUN_06011678)
    } > HWRAM
    .func_FUN_060116A8 0x060116A8 : SUBALIGN(1)
    {
        *(.text.FUN_060116A8)
    } > HWRAM
    .func_FUN_060116BC 0x060116BC : SUBALIGN(1)
    {
        *(.text.FUN_060116BC)
    } > HWRAM
    .func_FUN_06011978 0x06011978 : SUBALIGN(1)
    {
        /* overflow: FUN_06011978 goes to catchall */
    } > HWRAM
    .func_FUN_0601198C 0x0601198C : SUBALIGN(1)
    {
        *(.text.FUN_0601198C)
    } > HWRAM
    .func_FUN_06011AF4 0x06011AF4 : SUBALIGN(1)
    {
        *(.text.FUN_06011AF4)
    } > HWRAM
    .func_FUN_06011B08 0x06011B08 : SUBALIGN(1)
    {
        *(.text.FUN_06011B08)
    } > HWRAM
    .func_FUN_06011DC0 0x06011DC0 : SUBALIGN(1)
    {
        *(.text.FUN_06011DC0)
    } > HWRAM
    .func_FUN_06011E7C 0x06011E7C : SUBALIGN(1)
    {
        *(.text.FUN_06011E7C)
    } > HWRAM
    .func_FUN_06011F92 0x06011F92 : SUBALIGN(1)
    {
        *(.text.FUN_06011F92)
    } > HWRAM
    .func_FUN_06012050 0x06012050 : SUBALIGN(1)
    {
        *(.text.trampoline_FUN_06012050)
    } > HWRAM
    .func_FUN_06012054 0x06012054 : SUBALIGN(1)
    {
        /* overflow: FUN_06012054 goes to catchall */
    } > HWRAM
    .func_FUN_06012080 0x06012080 : SUBALIGN(1)
    {
        /* overflow: FUN_06012080 goes to catchall */
    } > HWRAM
    .func_FUN_06012084 0x06012084 : SUBALIGN(1)
    {
        /* overflow: FUN_06012084 goes to catchall */
    } > HWRAM
    .func_FUN_060120A0 0x060120A0 : SUBALIGN(1)
    {
        /* overflow: FUN_060120A0 goes to catchall */
    } > HWRAM
    .func_FUN_060120C8 0x060120C8 : SUBALIGN(1)
    {
        *(.text.FUN_060120C8)
    } > HWRAM
    .func_FUN_060120CC 0x060120CC : SUBALIGN(1)
    {
        *(.text.FUN_060120CC)
    } > HWRAM
    .func_FUN_060121A8 0x060121A8 : SUBALIGN(1)
    {
        *(.text.FUN_060121A8)
    } > HWRAM
    .func_FUN_0601228C 0x0601228C : SUBALIGN(1)
    {
        *(.text.FUN_0601228C)
    } > HWRAM
    .func_FUN_06012344 0x06012344 : SUBALIGN(1)
    {
        /* overflow: FUN_06012344 goes to catchall */
    } > HWRAM
    .func_FUN_06012400 0x06012400 : SUBALIGN(1)
    {
        /* overflow: FUN_06012400 goes to catchall */
    } > HWRAM
    .func_FUN_06012450 0x06012450 : SUBALIGN(1)
    {
        *(.text.FUN_06012450)
    } > HWRAM
    .func_FUN_06012454 0x06012454 : SUBALIGN(1)
    {
        *(.text.FUN_06012454)
    } > HWRAM
    .func_FUN_0601250C 0x0601250C : SUBALIGN(1)
    {
        *(.text.FUN_0601250C)
        *(.text.background_render_pipeline)
    } > HWRAM
    .func_FUN_060125D0 0x060125D0 : SUBALIGN(1)
    {
        *(.text.FUN_060125D0)
        *(.text.camera_sweep_render)
    } > HWRAM
    .func_FUN_06012710 0x06012710 : SUBALIGN(1)
    {
        *(.text.FUN_06012710)
        *(.text.attract_sound_dispatch)
    } > HWRAM
    .func_FUN_060127E0 0x060127E0 : SUBALIGN(1)
    {
        *(.text.FUN_060127E0)
    } > HWRAM
    .func_FUN_06012AC4 0x06012AC4 : SUBALIGN(1)
    {
        *(.text.trampoline_FUN_06012AC4)
    } > HWRAM
    .func_FUN_06012AFA 0x06012AFA : SUBALIGN(1)
    {
        *(.text.FUN_06012AFA)
    } > HWRAM
    .func_FUN_06012B58 0x06012B58 : SUBALIGN(1)
    {
        *(.text.FUN_06012B58)
    } > HWRAM
    .func_FUN_06012BDC 0x06012BDC : SUBALIGN(1)
    {
        *(.text.FUN_06012BDC)
    } > HWRAM
    .func_FUN_06012BE4 0x06012BE4 : SUBALIGN(1)
    {
        *(.text.FUN_06012BE4)
    } > HWRAM
    .func_FUN_06012C3C 0x06012C3C : SUBALIGN(1)
    {
        *(.text.FUN_06012C3C)
    } > HWRAM
    .func_FUN_06012CF4 0x06012CF4 : SUBALIGN(1)
    {
        *(.text.FUN_06012CF4)
    } > HWRAM
    .func_FUN_06012D7C 0x06012D7C : SUBALIGN(1)
    {
        *(.text.FUN_06012D7C)
        *(.text.bg_tilemap_load)
    } > HWRAM
    .func_FUN_06012DB4 0x06012DB4 : SUBALIGN(1)
    {
        /* overflow: FUN_06012DB4 goes to catchall */
    } > HWRAM
    .func_FUN_06012E08 0x06012E08 : SUBALIGN(1)
    {
        *(.text.FUN_06012E08)
        *(.text.bg_pattern_load)
    } > HWRAM
    .func_FUN_06012E6A 0x06012E6A : SUBALIGN(1)
    {
        *(.text.FUN_06012E6A)
    } > HWRAM
    .func_FUN_06012F80 0x06012F80 : SUBALIGN(1)
    {
        *(.text.FUN_06012F80)
    } > HWRAM
    .func_FUN_0601389E 0x0601389E : SUBALIGN(1)
    {
        *(.text.FUN_0601389E)
    } > HWRAM
    .func_FUN_060138BE 0x060138BE : SUBALIGN(1)
    {
        *(.text.FUN_060138BE)
    } > HWRAM
    .func_FUN_06013948 0x06013948 : SUBALIGN(1)
    {
        *(.text.FUN_06013948)
    } > HWRAM
    .func_FUN_06013A74 0x06013A74 : SUBALIGN(1)
    {
        *(.text.trampoline_FUN_06013A74)
    } > HWRAM
    .func_FUN_06013B04 0x06013B04 : SUBALIGN(1)
    {
        *(.text.FUN_06013B04)
    } > HWRAM
    .func_FUN_06013C20 0x06013C20 : SUBALIGN(1)
    {
        *(.text.FUN_06013C20)
    } > HWRAM
    .func_FUN_06013C58 0x06013C58 : SUBALIGN(1)
    {
        *(.text.FUN_06013C58)
    } > HWRAM
    .func_FUN_06013E14 0x06013E14 : SUBALIGN(1)
    {
        *(.text.FUN_06013E14)
    } > HWRAM
    .func_FUN_06013E3C 0x06013E3C : SUBALIGN(1)
    {
        *(.text.FUN_06013E3C)
    } > HWRAM
    .func_FUN_06013E7A 0x06013E7A : SUBALIGN(1)
    {
        *(.text.FUN_06013E7A)
    } > HWRAM
    .func_FUN_06013FC4 0x06013FC4 : SUBALIGN(1)
    {
        *(.text.FUN_06013FC4)
    } > HWRAM
    .func_FUN_060140C4 0x060140C4 : SUBALIGN(1)
    {
        *(.text.FUN_060140C4)
    } > HWRAM
    .func_FUN_060140C8 0x060140C8 : SUBALIGN(1)
    {
        *(.text.FUN_060140C8)
    } > HWRAM
    .func_FUN_0601416C 0x0601416C : SUBALIGN(1)
    {
        *(.text.FUN_0601416C)
    } > HWRAM
    .func_FUN_0601424C 0x0601424C : SUBALIGN(1)
    {
        *(.text.FUN_0601424C)
    } > HWRAM
    .func_FUN_06014360 0x06014360 : SUBALIGN(1)
    {
        *(.text.FUN_06014360)
    } > HWRAM
    .func_FUN_0601444C 0x0601444C : SUBALIGN(1)
    {
        /* overflow: FUN_0601444C goes to catchall */
    } > HWRAM
    .func_FUN_06014468 0x06014468 : SUBALIGN(1)
    {
        *(.text.FUN_06014468)
    } > HWRAM
    .func_FUN_0601450C 0x0601450C : SUBALIGN(1)
    {
        *(.text.FUN_0601450C)
    } > HWRAM
    .func_FUN_060145BC 0x060145BC : SUBALIGN(1)
    {
        *(.text.FUN_060145BC)
    } > HWRAM
    .func_FUN_060146D4 0x060146D4 : SUBALIGN(1)
    {
        *(.text.FUN_060146D4)
    } > HWRAM
    .func_FUN_0601476C 0x0601476C : SUBALIGN(1)
    {
        *(.text.FUN_0601476C)
    } > HWRAM
    .func_FUN_06014868 0x06014868 : SUBALIGN(1)
    {
        *(.text.FUN_06014868)
    } > HWRAM
    .func_FUN_06014884 0x06014884 : SUBALIGN(1)
    {
        *(.text.FUN_06014884)
    } > HWRAM
    .func_FUN_060148A2 0x060148A2 : SUBALIGN(1)
    {
        /* overflow: FUN_060148A2 goes to catchall */
    } > HWRAM
    .func_FUN_060148FC 0x060148FC : SUBALIGN(1)
    {
        /* overflow: FUN_060148FC goes to catchall */
    } > HWRAM
    .func_FUN_0601492C 0x0601492C : SUBALIGN(1)
    {
        *(.text.FUN_0601492C)
    } > HWRAM
    .func_FUN_06014964 0x06014964 : SUBALIGN(1)
    {
        /* overflow: FUN_06014964 goes to catchall */
    } > HWRAM
    .func_FUN_06014994 0x06014994 : SUBALIGN(1)
    {
        *(.text.FUN_06014994)
    } > HWRAM
    .func_FUN_06014A04 0x06014A04 : SUBALIGN(1)
    {
        *(.text.FUN_06014A04)
    } > HWRAM
    .func_FUN_06014A42 0x06014A42 : SUBALIGN(1)
    {
        *(.text.FUN_06014A42)
    } > HWRAM
    .func_FUN_06014A74 0x06014A74 : SUBALIGN(1)
    {
        *(.text.FUN_06014A74)
    } > HWRAM
    .func_FUN_06014D2C 0x06014D2C : SUBALIGN(1)
    {
        *(.text.FUN_06014D2C)
    } > HWRAM
    .func_FUN_06014F34 0x06014F34 : SUBALIGN(1)
    {
        *(.text.FUN_06014F34)
    } > HWRAM
    .func_FUN_0601503A 0x0601503A : SUBALIGN(1)
    {
        *(.text.FUN_0601503A)
    } > HWRAM
    .func_FUN_06015150 0x06015150 : SUBALIGN(1)
    {
        *(.text.FUN_06015150)
    } > HWRAM
    .func_FUN_06015338 0x06015338 : SUBALIGN(1)
    {
        /* overflow: FUN_06015338 goes to catchall */
    } > HWRAM
    .func_FUN_06015482 0x06015482 : SUBALIGN(1)
    {
        *(.text.FUN_06015482)
    } > HWRAM
    .func_FUN_0601550C 0x0601550C : SUBALIGN(1)
    {
        *(.text.trampoline_FUN_0601550C)
    } > HWRAM
    .func_FUN_060155A4 0x060155A4 : SUBALIGN(1)
    {
        *(.text.FUN_060155A4)
    } > HWRAM
    .func_FUN_060156A6 0x060156A6 : SUBALIGN(1)
    {
        *(.text.FUN_060156A6)
    } > HWRAM
    .func_FUN_060156AC 0x060156AC : SUBALIGN(1)
    {
        *(.text.FUN_060156AC)
    } > HWRAM
    .func_FUN_0601574C 0x0601574C : SUBALIGN(1)
    {
        *(.text.FUN_0601574C)
    } > HWRAM
    .func_FUN_06015754 0x06015754 : SUBALIGN(1)
    {
        *(.text.FUN_06015754)
    } > HWRAM
    .func_FUN_060158DE 0x060158DE : SUBALIGN(1)
    {
        *(.text.FUN_060158DE)
    } > HWRAM
    .func_FUN_06015954 0x06015954 : SUBALIGN(1)
    {
        *(.text.FUN_06015954)
    } > HWRAM
    .func_FUN_06015AA4 0x06015AA4 : SUBALIGN(1)
    {
        *(.text.FUN_06015AA4)
    } > HWRAM
    .func_FUN_06015B48 0x06015B48 : SUBALIGN(1)
    {
        *(.text.FUN_06015B48)
    } > HWRAM
    .func_FUN_06015C5E 0x06015C5E : SUBALIGN(1)
    {
        *(.text.FUN_06015C5E)
    } > HWRAM
    .func_FUN_06015CAC 0x06015CAC : SUBALIGN(1)
    {
        *(.text.FUN_06015CAC)
    } > HWRAM
    .func_FUN_06015D30 0x06015D30 : SUBALIGN(1)
    {
        *(.text.FUN_06015D30)
    } > HWRAM
    .func_FUN_06015D94 0x06015D94 : SUBALIGN(1)
    {
        *(.text.FUN_06015D94)
    } > HWRAM
    .func_FUN_06015E26 0x06015E26 : SUBALIGN(1)
    {
        *(.text.FUN_06015E26)
    } > HWRAM
    .func_FUN_06015E78 0x06015E78 : SUBALIGN(1)
    {
        *(.text.FUN_06015E78)
    } > HWRAM
    .func_FUN_06015EB8 0x06015EB8 : SUBALIGN(1)
    {
        *(.text.FUN_06015EB8)
    } > HWRAM
    .func_FUN_06015FB0 0x06015FB0 : SUBALIGN(1)
    {
        *(.text.FUN_06015FB0)
    } > HWRAM
    .func_FUN_06015FC2 0x06015FC2 : SUBALIGN(1)
    {
        *(.text.FUN_06015FC2)
    } > HWRAM
    .func_FUN_06016228 0x06016228 : SUBALIGN(1)
    {
        *(.text.FUN_06016228)
    } > HWRAM
    .func_FUN_06016230 0x06016230 : SUBALIGN(1)
    {
        *(.text.FUN_06016230)
    } > HWRAM
    .func_FUN_06016298 0x06016298 : SUBALIGN(1)
    {
        *(.text.FUN_06016298)
    } > HWRAM
    .func_FUN_060162AC 0x060162AC : SUBALIGN(1)
    {
        *(.text.FUN_060162AC)
    } > HWRAM
    .func_FUN_06016410 0x06016410 : SUBALIGN(1)
    {
        *(.text.FUN_06016410)
    } > HWRAM
    .func_FUN_06016468 0x06016468 : SUBALIGN(1)
    {
        *(.text.FUN_06016468)
    } > HWRAM
    .func_FUN_06016470 0x06016470 : SUBALIGN(1)
    {
        *(.text.FUN_06016470)
    } > HWRAM
    .func_FUN_060164CE 0x060164CE : SUBALIGN(1)
    {
        *(.text.FUN_060164CE)
    } > HWRAM
    .func_FUN_06016630 0x06016630 : SUBALIGN(1)
    {
        *(.text.FUN_06016630)
    } > HWRAM
    .func_FUN_06016634 0x06016634 : SUBALIGN(1)
    {
        *(.text.FUN_06016634)
    } > HWRAM
    .func_FUN_0601667A 0x0601667A : SUBALIGN(1)
    {
        *(.text.FUN_0601667A)
    } > HWRAM
    .func_FUN_06016750 0x06016750 : SUBALIGN(1)
    {
        *(.text.FUN_06016750)
    } > HWRAM
    .func_FUN_060167C8 0x060167C8 : SUBALIGN(1)
    {
        *(.text.FUN_060167C8)
    } > HWRAM
    .func_FUN_060167DC 0x060167DC : SUBALIGN(1)
    {
        *(.text.FUN_060167DC)
    } > HWRAM
    .func_FUN_06016940 0x06016940 : SUBALIGN(1)
    {
        *(.text.FUN_06016940)
    } > HWRAM
    .func_FUN_06016950 0x06016950 : SUBALIGN(1)
    {
        *(.text.FUN_06016950)
    } > HWRAM
    .func_FUN_06016A18 0x06016A18 : SUBALIGN(1)
    {
        *(.text.FUN_06016A18)
    } > HWRAM
    .func_FUN_06016A1C 0x06016A1C : SUBALIGN(1)
    {
        *(.text.FUN_06016A1C)
    } > HWRAM
    .func_FUN_06016A60 0x06016A60 : SUBALIGN(1)
    {
        *(.text.FUN_06016A60)
    } > HWRAM
    .func_FUN_06016C6A 0x06016C6A : SUBALIGN(1)
    {
        *(.text.FUN_06016C6A)
    } > HWRAM
    .func_FUN_06016CDC 0x06016CDC : SUBALIGN(1)
    {
        *(.text.FUN_06016CDC)
    } > HWRAM
    .func_FUN_06016CE6 0x06016CE6 : SUBALIGN(1)
    {
        *(.text.FUN_06016CE6)
    } > HWRAM
    .func_FUN_06016DD8 0x06016DD8 : SUBALIGN(1)
    {
        *(.text.FUN_06016DD8)
    } > HWRAM
    .func_FUN_060170FC 0x060170FC : SUBALIGN(1)
    {
        *(.text.FUN_060170FC)
    } > HWRAM
    .func_FUN_06017116 0x06017116 : SUBALIGN(1)
    {
        *(.text.FUN_06017116)
    } > HWRAM
    .func_FUN_0601712C 0x0601712C : SUBALIGN(1)
    {
        *(.text.FUN_0601712C)
    } > HWRAM
    .func_FUN_060171AC 0x060171AC : SUBALIGN(1)
    {
        *(.text.FUN_060171AC)
    } > HWRAM
    .func_FUN_060172BC 0x060172BC : SUBALIGN(1)
    {
        *(.text.FUN_060172BC)
    } > HWRAM
    .func_FUN_060173AC 0x060173AC : SUBALIGN(1)
    {
        *(.text.FUN_060173AC)
    } > HWRAM
    .func_FUN_0601772E 0x0601772E : SUBALIGN(1)
    {
        *(.text.FUN_0601772E)
    } > HWRAM
    .func_FUN_06017740 0x06017740 : SUBALIGN(1)
    {
        *(.text.FUN_06017740)
    } > HWRAM
    .func_FUN_06017784 0x06017784 : SUBALIGN(1)
    {
        *(.text.FUN_06017784)
    } > HWRAM
    .func_FUN_06017814 0x06017814 : SUBALIGN(1)
    {
        *(.text.FUN_06017814)
    } > HWRAM
    .func_FUN_06017C9C 0x06017C9C : SUBALIGN(1)
    {
        *(.text.FUN_06017C9C)
    } > HWRAM
    .func_FUN_06017CEC 0x06017CEC : SUBALIGN(1)
    {
        *(.text.FUN_06017CEC)
    } > HWRAM
    .func_FUN_06018166 0x06018166 : SUBALIGN(1)
    {
        *(.text.FUN_06018166)
    } > HWRAM
    .func_FUN_06018278 0x06018278 : SUBALIGN(1)
    {
        *(.text.FUN_06018278)
    } > HWRAM
    .func_FUN_06018320 0x06018320 : SUBALIGN(1)
    {
        *(.text.FUN_06018320)
    } > HWRAM
    .func_FUN_060185D8 0x060185D8 : SUBALIGN(1)
    {
        *(.text.FUN_060185D8)
    } > HWRAM
    .func_FUN_06018738 0x06018738 : SUBALIGN(1)
    {
        *(.text.FUN_06018738)
    } > HWRAM
    .func_FUN_06018834 0x06018834 : SUBALIGN(1)
    {
        *(.text.FUN_06018834)
    } > HWRAM
    .func_FUN_06018938 0x06018938 : SUBALIGN(1)
    {
        *(.text.FUN_06018938)
    } > HWRAM
    .func_FUN_06018A3C 0x06018A3C : SUBALIGN(1)
    {
        *(.text.FUN_06018A3C)
    } > HWRAM
    .func_FUN_06018DDC 0x06018DDC : SUBALIGN(1)
    {
        *(.text.FUN_06018DDC)
    } > HWRAM
    .func_FUN_06018E22 0x06018E22 : SUBALIGN(1)
    {
        *(.text.FUN_06018E22)
    } > HWRAM
    .func_FUN_06018E4C 0x06018E4C : SUBALIGN(1)
    {
        *(.text.FUN_06018E4C)
    } > HWRAM
    .func_FUN_06018E70 0x06018E70 : SUBALIGN(1)
    {
        *(.text.trampoline_FUN_06018E70)
    } > HWRAM
    .func_FUN_06018E88 0x06018E88 : SUBALIGN(1)
    {
        *(.text.FUN_06018E88)
    } > HWRAM
    .func_FUN_06018EAC 0x06018EAC : SUBALIGN(1)
    {
        *(.text.FUN_06018EAC)
        *(.text.cd_status_read)
    } > HWRAM
    .func_FUN_06018EE4 0x06018EE4 : SUBALIGN(1)
    {
        *(.text.FUN_06018EE4)
    } > HWRAM
    .func_FUN_06018FA4 0x06018FA4 : SUBALIGN(1)
    {
        *(.text.FUN_06018FA4)
    } > HWRAM
    .func_FUN_06018FA8 0x06018FA8 : SUBALIGN(1)
    {
        *(.text.FUN_06018FA8)
    } > HWRAM
    .func_FUN_06018FF8 0x06018FF8 : SUBALIGN(1)
    {
        /* overflow: FUN_06018FF8 goes to catchall */
    } > HWRAM
    .func_FUN_06018FFC 0x06018FFC : SUBALIGN(1)
    {
        /* overflow: FUN_06018FFC goes to catchall */
    } > HWRAM
    .func_FUN_06019058 0x06019058 : SUBALIGN(1)
    {
        *(.text.trampoline_FUN_06019058)
    } > HWRAM
    .func_FUN_0601905C 0x0601905C : SUBALIGN(1)
    {
        *(.text.FUN_0601905C)
    } > HWRAM
    .func_FUN_060190B8 0x060190B8 : SUBALIGN(1)
    {
        *(.text.FUN_060190B8)
    } > HWRAM
    .func_FUN_060190BC 0x060190BC : SUBALIGN(1)
    {
        *(.text.FUN_060190BC)
    } > HWRAM
    .func_FUN_060190F4 0x060190F4 : SUBALIGN(1)
    {
        *(.text.FUN_060190F4)
    } > HWRAM
    .func_FUN_060190F8 0x060190F8 : SUBALIGN(1)
    {
        *(.text.FUN_060190F8)
    } > HWRAM
    .func_FUN_0601914C 0x0601914C : SUBALIGN(1)
    {
        *(.text.FUN_0601914C)
    } > HWRAM
    .func_FUN_06019150 0x06019150 : SUBALIGN(1)
    {
        *(.text.FUN_06019150)
    } > HWRAM
    .func_FUN_06019188 0x06019188 : SUBALIGN(1)
    {
        *(.text.trampoline_FUN_06019188)
    } > HWRAM
    .func_FUN_0601918C 0x0601918C : SUBALIGN(1)
    {
        *(.text.FUN_0601918C)
    } > HWRAM
    .func_FUN_060191E0 0x060191E0 : SUBALIGN(1)
    {
        *(.text.FUN_060191E0)
    } > HWRAM
    .func_FUN_060191E4 0x060191E4 : SUBALIGN(1)
    {
        *(.text.FUN_060191E4)
    } > HWRAM
    .func_FUN_06019248 0x06019248 : SUBALIGN(1)
    {
        /* overflow: FUN_06019248 goes to catchall */
    } > HWRAM
    .func_FUN_0601924C 0x0601924C : SUBALIGN(1)
    {
        *(.text.FUN_0601924C)
    } > HWRAM
    .func_FUN_060192CC 0x060192CC : SUBALIGN(1)
    {
        *(.text.FUN_060192CC)
    } > HWRAM
    .func_FUN_06019324 0x06019324 : SUBALIGN(1)
    {
        *(.text.trampoline_FUN_06019324)
    } > HWRAM
    .func_FUN_0601935E 0x0601935E : SUBALIGN(1)
    {
        *(.text.FUN_0601935E)
    } > HWRAM
    .func_FUN_0601938C 0x0601938C : SUBALIGN(1)
    {
        *(.text.FUN_0601938C)
    } > HWRAM
    .func_FUN_060193F4 0x060193F4 : SUBALIGN(1)
    {
        *(.text.FUN_060193F4)
    } > HWRAM
    .func_FUN_060193FE 0x060193FE : SUBALIGN(1)
    {
        *(.text.FUN_060193FE)
    } > HWRAM
    .func_FUN_0601950C 0x0601950C : SUBALIGN(1)
    {
        *(.text.FUN_0601950C)
    } > HWRAM
    .func_FUN_060196A4 0x060196A4 : SUBALIGN(1)
    {
        *(.text.FUN_060196A4)
    } > HWRAM
    .func_FUN_060196B0 0x060196B0 : SUBALIGN(1)
    {
        *(.text.FUN_060196B0)
    } > HWRAM
    .func_FUN_060197F4 0x060197F4 : SUBALIGN(1)
    {
        *(.text.FUN_060197F4)
    } > HWRAM
    .func_FUN_060198E0 0x060198E0 : SUBALIGN(1)
    {
        /* overflow: FUN_060198E0 goes to catchall */
    } > HWRAM
    .func_FUN_06019928 0x06019928 : SUBALIGN(1)
    {
        /* overflow: FUN_06019928 goes to catchall */
    } > HWRAM
    .func_FUN_06019A48 0x06019A48 : SUBALIGN(1)
    {
        *(.text.FUN_06019A48)
    } > HWRAM
    .func_FUN_06019BC8 0x06019BC8 : SUBALIGN(1)
    {
        *(.text.FUN_06019BC8)
    } > HWRAM
    .func_FUN_06019D14 0x06019D14 : SUBALIGN(1)
    {
        *(.text.FUN_06019D14)
    } > HWRAM
    .func_FUN_06019DB8 0x06019DB8 : SUBALIGN(1)
    {
        *(.text.FUN_06019DB8)
    } > HWRAM
    .func_FUN_06019EF0 0x06019EF0 : SUBALIGN(1)
    {
        *(.text.FUN_06019EF0)
    } > HWRAM
    .func_FUN_06019FB2 0x06019FB2 : SUBALIGN(1)
    {
        *(.text.FUN_06019FB2)
    } > HWRAM
    .func_FUN_0601A0F0 0x0601A0F0 : SUBALIGN(1)
    {
        *(.text.FUN_0601A0F0)
    } > HWRAM
    .func_FUN_0601A1BA 0x0601A1BA : SUBALIGN(1)
    {
        *(.text.FUN_0601A1BA)
    } > HWRAM
    .func_FUN_0601A2BC 0x0601A2BC : SUBALIGN(1)
    {
        *(.text.FUN_0601A2BC)
    } > HWRAM
    .func_FUN_0601A344 0x0601A344 : SUBALIGN(1)
    {
        *(.text.FUN_0601A344)
    } > HWRAM
    .func_FUN_0601A348 0x0601A348 : SUBALIGN(1)
    {
        *(.text.FUN_0601A348)
    } > HWRAM
    .func_FUN_0601A3F4 0x0601A3F4 : SUBALIGN(1)
    {
        *(.text.FUN_0601A3F4)
    } > HWRAM
    .func_FUN_0601A574 0x0601A574 : SUBALIGN(1)
    {
        *(.text.FUN_0601A574)
    } > HWRAM
    .func_FUN_0601A578 0x0601A578 : SUBALIGN(1)
    {
        *(.text.FUN_0601A578)
    } > HWRAM
    .func_FUN_0601A65E 0x0601A65E : SUBALIGN(1)
    {
        *(.text.FUN_0601A65E)
    } > HWRAM
    .func_FUN_0601A770 0x0601A770 : SUBALIGN(1)
    {
        *(.text.FUN_0601A770)
    } > HWRAM
    .func_FUN_0601A7AC 0x0601A7AC : SUBALIGN(1)
    {
        *(.text.FUN_0601A7AC)
    } > HWRAM
    .func_FUN_0601A80C 0x0601A80C : SUBALIGN(1)
    {
        *(.text.FUN_0601A80C)
    } > HWRAM
    .func_FUN_0601A940 0x0601A940 : SUBALIGN(1)
    {
        *(.text.FUN_0601A940)
    } > HWRAM
    .func_FUN_0601AAE8 0x0601AAE8 : SUBALIGN(1)
    {
        *(.text.FUN_0601AAE8)
    } > HWRAM
    .func_FUN_0601ABC8 0x0601ABC8 : SUBALIGN(1)
    {
        *(.text.FUN_0601ABC8)
    } > HWRAM
    .func_FUN_0601AC7C 0x0601AC7C : SUBALIGN(1)
    {
        *(.text.FUN_0601AC7C)
    } > HWRAM
    .func_FUN_0601AC88 0x0601AC88 : SUBALIGN(1)
    {
        *(.text.FUN_0601AC88)
    } > HWRAM
    .func_FUN_0601AE80 0x0601AE80 : SUBALIGN(1)
    {
        *(.text.FUN_0601AE80)
    } > HWRAM
    .func_FUN_0601AF1E 0x0601AF1E : SUBALIGN(1)
    {
        *(.text.FUN_0601AF1E)
    } > HWRAM
    .func_FUN_0601AF8C 0x0601AF8C : SUBALIGN(1)
    {
        *(.text.FUN_0601AF8C)
    } > HWRAM
    .func_FUN_0601AFA4 0x0601AFA4 : SUBALIGN(1)
    {
        *(.text.FUN_0601AFA4)
    } > HWRAM
    .func_FUN_0601AFD8 0x0601AFD8 : SUBALIGN(1)
    {
        *(.text.FUN_0601AFD8)
    } > HWRAM
    .func_FUN_0601AFDE 0x0601AFDE : SUBALIGN(1)
    {
        *(.text.FUN_0601AFDE)
    } > HWRAM
    .func_FUN_0601B020 0x0601B020 : SUBALIGN(1)
    {
        *(.text.FUN_0601B020)
    } > HWRAM
    .func_FUN_0601B024 0x0601B024 : SUBALIGN(1)
    {
        *(.text.FUN_0601B024)
    } > HWRAM
    .func_FUN_0601B074 0x0601B074 : SUBALIGN(1)
    {
        *(.text.FUN_0601B074)
    } > HWRAM
    .func_FUN_0601B0D8 0x0601B0D8 : SUBALIGN(1)
    {
        *(.text.FUN_0601B0D8)
    } > HWRAM
    .func_FUN_0601B160 0x0601B160 : SUBALIGN(1)
    {
        *(.text.FUN_0601B160)
    } > HWRAM
    .func_FUN_0601B170 0x0601B170 : SUBALIGN(1)
    {
        *(.text.FUN_0601B170)
    } > HWRAM
    .func_FUN_0601B418 0x0601B418 : SUBALIGN(1)
    {
        *(.text.FUN_0601B418)
    } > HWRAM
    .func_FUN_0601B48C 0x0601B48C : SUBALIGN(1)
    {
        *(.text.FUN_0601B48C)
    } > HWRAM
    .func_FUN_0601B4D6 0x0601B4D6 : SUBALIGN(1)
    {
        *(.text.FUN_0601B4D6)
    } > HWRAM
    .func_FUN_0601B584 0x0601B584 : SUBALIGN(1)
    {
        *(.text.FUN_0601B584)
    } > HWRAM
    .func_FUN_0601B644 0x0601B644 : SUBALIGN(1)
    {
        *(.text.FUN_0601B644)
    } > HWRAM
    .func_FUN_0601B6DC 0x0601B6DC : SUBALIGN(1)
    {
        *(.text.FUN_0601B6DC)
    } > HWRAM
    .func_FUN_0601B6F0 0x0601B6F0 : SUBALIGN(1)
    {
        *(.text.FUN_0601B6F0)
    } > HWRAM
    .func_FUN_0601B7F4 0x0601B7F4 : SUBALIGN(1)
    {
        *(.text.FUN_0601B7F4)
    } > HWRAM
    .func_FUN_0601BA50 0x0601BA50 : SUBALIGN(1)
    {
        *(.text.FUN_0601BA50)
    } > HWRAM
    .func_FUN_0601BBCC 0x0601BBCC : SUBALIGN(1)
    {
        *(.text.FUN_0601BBCC)
    } > HWRAM
    .func_FUN_0601BBDC 0x0601BBDC : SUBALIGN(1)
    {
        *(.text.FUN_0601BBDC)
    } > HWRAM
    .func_FUN_0601BDEC 0x0601BDEC : SUBALIGN(1)
    {
        *(.text.FUN_0601BDEC)
    } > HWRAM
    .func_FUN_0601BE64 0x0601BE64 : SUBALIGN(1)
    {
        *(.text.FUN_0601BE64)
    } > HWRAM
    .func_FUN_0601C3E4 0x0601C3E4 : SUBALIGN(1)
    {
        *(.text.FUN_0601C3E4)
    } > HWRAM
    .func_FUN_0601C978 0x0601C978 : SUBALIGN(1)
    {
        *(.text.FUN_0601C978)
    } > HWRAM
    .func_FUN_0601CAEE 0x0601CAEE : SUBALIGN(1)
    {
        *(.text.FUN_0601CAEE)
    } > HWRAM
    .func_FUN_0601CDC0 0x0601CDC0 : SUBALIGN(1)
    {
        *(.text.FUN_0601CDC0)
    } > HWRAM
    .func_FUN_0601CEFC 0x0601CEFC : SUBALIGN(1)
    {
        *(.text.FUN_0601CEFC)
    } > HWRAM
    .func_FUN_0601D014 0x0601D014 : SUBALIGN(1)
    {
        *(.text.FUN_0601D014)
    } > HWRAM
    .func_FUN_0601D074 0x0601D074 : SUBALIGN(1)
    {
        *(.text.FUN_0601D074)
    } > HWRAM
    .func_FUN_0601D12C 0x0601D12C : SUBALIGN(1)
    {
        *(.text.FUN_0601D12C)
    } > HWRAM
    .func_FUN_0601D2DC 0x0601D2DC : SUBALIGN(1)
    {
        *(.text.FUN_0601D2DC)
    } > HWRAM
    .func_FUN_0601D3C0 0x0601D3C0 : SUBALIGN(1)
    {
        *(.text.FUN_0601D3C0)
    } > HWRAM
    .func_FUN_0601D478 0x0601D478 : SUBALIGN(1)
    {
        *(.text.trampoline_FUN_0601D478)
    } > HWRAM
    .func_FUN_0601D4A8 0x0601D4A8 : SUBALIGN(1)
    {
        *(.text.FUN_0601D4A8)
    } > HWRAM
    .func_FUN_0601D57C 0x0601D57C : SUBALIGN(1)
    {
        *(.text.FUN_0601D57C)
    } > HWRAM
    .func_FUN_0601D5F4 0x0601D5F4 : SUBALIGN(1)
    {
        *(.text.FUN_0601D5F4)
    } > HWRAM
    .func_FUN_0601D6B2 0x0601D6B2 : SUBALIGN(1)
    {
        *(.text.FUN_0601D6B2)
    } > HWRAM
    .func_FUN_0601D6D4 0x0601D6D4 : SUBALIGN(1)
    {
        *(.text.FUN_0601D6D4)
    } > HWRAM
    .func_FUN_0601D6D8 0x0601D6D8 : SUBALIGN(1)
    {
        *(.text.FUN_0601D6D8)
    } > HWRAM
    .func_FUN_0601D6F8 0x0601D6F8 : SUBALIGN(1)
    {
        *(.text.FUN_0601D6F8)
    } > HWRAM
    .func_FUN_0601D6FC 0x0601D6FC : SUBALIGN(1)
    {
        *(.text.FUN_0601D6FC)
    } > HWRAM
    .func_FUN_0601D72C 0x0601D72C : SUBALIGN(1)
    {
        *(.text.FUN_0601D72C)
    } > HWRAM
    .func_FUN_0601D730 0x0601D730 : SUBALIGN(1)
    {
        *(.text.FUN_0601D730)
    } > HWRAM
    .func_FUN_0601D750 0x0601D750 : SUBALIGN(1)
    {
        *(.text.FUN_0601D750)
    } > HWRAM
    .func_FUN_0601D778 0x0601D778 : SUBALIGN(1)
    {
        *(.text.FUN_0601D778)
    } > HWRAM
    .func_FUN_0601D77C 0x0601D77C : SUBALIGN(1)
    {
        *(.text.FUN_0601D77C)
    } > HWRAM
    .func_FUN_0601D79C 0x0601D79C : SUBALIGN(1)
    {
        *(.text.FUN_0601D79C)
    } > HWRAM
    .func_FUN_0601D7A0 0x0601D7A0 : SUBALIGN(1)
    {
        *(.text.FUN_0601D7A0)
    } > HWRAM
    .func_FUN_0601D7D0 0x0601D7D0 : SUBALIGN(1)
    {
        *(.text.FUN_0601D7D0)
    } > HWRAM
    .func_FUN_0601D9B0 0x0601D9B0 : SUBALIGN(1)
    {
        *(.text.FUN_0601D9B0)
    } > HWRAM
    .func_FUN_0601DBB8 0x0601DBB8 : SUBALIGN(1)
    {
        *(.text.FUN_0601DBB8)
    } > HWRAM
    .func_FUN_0601DDF6 0x0601DDF6 : SUBALIGN(1)
    {
        *(.text.FUN_0601DDF6)
    } > HWRAM
    .func_FUN_0601DE50 0x0601DE50 : SUBALIGN(1)
    {
        *(.text.FUN_0601DE50)
    } > HWRAM
    .func_FUN_0601DF88 0x0601DF88 : SUBALIGN(1)
    {
        *(.text.FUN_0601DF88)
    } > HWRAM
    .func_FUN_0601E100 0x0601E100 : SUBALIGN(1)
    {
        *(.text.FUN_0601E100)
    } > HWRAM
    .func_FUN_0601E26C 0x0601E26C : SUBALIGN(1)
    {
        *(.text.FUN_0601E26C)
        *(.text.input_state_copy)
    } > HWRAM
    .func_FUN_0601E2B4 0x0601E2B4 : SUBALIGN(1)
    {
        *(.text.FUN_0601E2B4)
    } > HWRAM
    .func_FUN_0601E37C 0x0601E37C : SUBALIGN(1)
    {
        *(.text.FUN_0601E37C)
        *(.text.backup_device_enumerate)
    } > HWRAM
    .func_FUN_0601E488 0x0601E488 : SUBALIGN(1)
    {
        /* overflow: FUN_0601E488 goes to catchall */
    } > HWRAM
    .func_FUN_0601E48C 0x0601E48C : SUBALIGN(1)
    {
        *(.text.FUN_0601E48C)
    } > HWRAM
    .func_FUN_0601E4D4 0x0601E4D4 : SUBALIGN(1)
    {
        *(.text.FUN_0601E4D4)
        *(.text.backup_mem_write_all)
    } > HWRAM
    .func_FUN_0601E636 0x0601E636 : SUBALIGN(1)
    {
        *(.text.FUN_0601E636)
    } > HWRAM
    .func_FUN_0601E6A4 0x0601E6A4 : SUBALIGN(1)
    {
        *(.text.FUN_0601E6A4)
        *(.text.bios_sound_poll)
    } > HWRAM
    .func_FUN_0601E6E0 0x0601E6E0 : SUBALIGN(1)
    {
        *(.text.FUN_0601E6E0)
    } > HWRAM
    .func_FUN_0601E764 0x0601E764 : SUBALIGN(1)
    {
        /* overflow: FUN_0601E764 goes to catchall */
    } > HWRAM
    .func_FUN_0601E770 0x0601E770 : SUBALIGN(1)
    {
        *(.text.FUN_0601E770)
    } > HWRAM
    .func_FUN_0601E810 0x0601E810 : SUBALIGN(1)
    {
        *(.text.FUN_0601E810)
        *(.text.backup_mem_read)
    } > HWRAM
    .func_FUN_0601E958 0x0601E958 : SUBALIGN(1)
    {
        *(.text.trampoline_FUN_0601E958)
    } > HWRAM
    .func_FUN_0601EAA0 0x0601EAA0 : SUBALIGN(1)
    {
        /* overflow: FUN_0601EAA0 goes to catchall */
    } > HWRAM
    .func_FUN_0601EB1C 0x0601EB1C : SUBALIGN(1)
    {
        /* overflow: FUN_0601EB1C goes to catchall */
    } > HWRAM
    .func_FUN_0601EB70 0x0601EB70 : SUBALIGN(1)
    {
        *(.text.FUN_0601EB70)
    } > HWRAM
    .func_FUN_0601EBDA 0x0601EBDA : SUBALIGN(1)
    {
        *(.text.FUN_0601EBDA)
    } > HWRAM
    .func_FUN_0601EFC4 0x0601EFC4 : SUBALIGN(1)
    {
        *(.text.FUN_0601EFC4)
    } > HWRAM
    .func_FUN_0601F40C 0x0601F40C : SUBALIGN(1)
    {
        /* overflow: FUN_0601F40C goes to catchall */
    } > HWRAM
    .func_FUN_0601F464 0x0601F464 : SUBALIGN(1)
    {
        *(.text.FUN_0601F464)
    } > HWRAM
    .func_FUN_0601F4B4 0x0601F4B4 : SUBALIGN(1)
    {
        *(.text.FUN_0601F4B4)
        *(.text.bcd_timestamp_decode)
    } > HWRAM
    .func_FUN_0601F5D0 0x0601F5D0 : SUBALIGN(1)
    {
        *(.text.FUN_0601F5D0)
    } > HWRAM
    .func_FUN_0601F5E0 0x0601F5E0 : SUBALIGN(1)
    {
        *(.text.trampoline_FUN_0601F5E0)
    } > HWRAM
    .func_FUN_0601F784 0x0601F784 : SUBALIGN(1)
    {
        *(.text.FUN_0601F784)
    } > HWRAM
    .func_FUN_0601F8C0 0x0601F8C0 : SUBALIGN(1)
    {
        /* overflow: FUN_0601F8C0 goes to catchall */
    } > HWRAM
    .func_FUN_0601F900 0x0601F900 : SUBALIGN(1)
    {
        /* overflow: FUN_0601F900 goes to catchall */
    } > HWRAM
    .func_FUN_0601F938 0x0601F938 : SUBALIGN(1)
    {
        *(.text.FUN_0601F938)
    } > HWRAM
    .func_FUN_0601F9CC 0x0601F9CC : SUBALIGN(1)
    {
        /* overflow: FUN_0601F9CC goes to catchall */
    } > HWRAM
    .func_FUN_0601FD20 0x0601FD20 : SUBALIGN(1)
    {
        *(.text.FUN_0601FD20)
        *(.text.mode_transition_vdp_reset)
    } > HWRAM
    .func_FUN_0601FD74 0x0601FD74 : SUBALIGN(1)
    {
        /* overflow: FUN_0601FD74 goes to catchall */
    } > HWRAM
    .func_FUN_0601FD9C 0x0601FD9C : SUBALIGN(1)
    {
        *(.text.FUN_0601FD9C)
    } > HWRAM
    .func_FUN_0601FE20 0x0601FE20 : SUBALIGN(1)
    {
        *(.text.FUN_0601FE20)
        *(.text.replay_car_state_load)
    } > HWRAM
    .func_FUN_0601FEC0 0x0601FEC0 : SUBALIGN(1)
    {
        *(.text.FUN_0601FEC0)
        *(.text.car_replay_state_init)
    } > HWRAM
    .func_FUN_0601FFA8 0x0601FFA8 : SUBALIGN(1)
    {
        *(.text.FUN_0601FFA8)
    } > HWRAM
    .func_FUN_0601FFB8 0x0601FFB8 : SUBALIGN(1)
    {
        *(.text.FUN_0601FFB8)
    } > HWRAM
    .func_FUN_060200A4 0x060200A4 : SUBALIGN(1)
    {
        *(.text.FUN_060200A4)
    } > HWRAM
    .func_FUN_060201B8 0x060201B8 : SUBALIGN(1)
    {
        *(.text.FUN_060201B8)
    } > HWRAM
    .func_FUN_06020284 0x06020284 : SUBALIGN(1)
    {
        *(.text.FUN_06020284)
    } > HWRAM
    .func_FUN_06020330 0x06020330 : SUBALIGN(1)
    {
        *(.text.trampoline_FUN_06020330)
    } > HWRAM
    .func_FUN_06020366 0x06020366 : SUBALIGN(1)
    {
        *(.text.FUN_06020366)
    } > HWRAM
    .func_FUN_06020414 0x06020414 : SUBALIGN(1)
    {
        *(.text.FUN_06020414)
    } > HWRAM
    .func_FUN_06020430 0x06020430 : SUBALIGN(1)
    {
        *(.text.FUN_06020430)
    } > HWRAM
    .func_FUN_060204B4 0x060204B4 : SUBALIGN(1)
    {
        *(.text.FUN_060204B4)
    } > HWRAM
    .func_FUN_060204D0 0x060204D0 : SUBALIGN(1)
    {
        *(.text.FUN_060204D0)
    } > HWRAM
    .func_FUN_0602052C 0x0602052C : SUBALIGN(1)
    {
        *(.text.FUN_0602052C)
    } > HWRAM
    .func_FUN_0602070C 0x0602070C : SUBALIGN(1)
    {
        *(.text.FUN_0602070C)
    } > HWRAM
    .func_FUN_06020814 0x06020814 : SUBALIGN(1)
    {
        *(.text.FUN_06020814)
    } > HWRAM
    .func_FUN_06020946 0x06020946 : SUBALIGN(1)
    {
        /* overflow: FUN_06020946 goes to catchall */
    } > HWRAM
    .func_FUN_06020950 0x06020950 : SUBALIGN(1)
    {
        *(.text.FUN_06020950)
    } > HWRAM
    .func_FUN_060209AC 0x060209AC : SUBALIGN(1)
    {
        *(.text.FUN_060209AC)
    } > HWRAM
    .func_FUN_06020B58 0x06020B58 : SUBALIGN(1)
    {
        *(.text.FUN_06020B58)
    } > HWRAM
    .func_FUN_06020BCE 0x06020BCE : SUBALIGN(1)
    {
        *(.text.FUN_06020BCE)
    } > HWRAM
    .func_FUN_06020C3C 0x06020C3C : SUBALIGN(1)
    {
        *(.text.FUN_06020C3C)
    } > HWRAM
    .func_FUN_06020CF4 0x06020CF4 : SUBALIGN(1)
    {
        *(.text.FUN_06020CF4)
    } > HWRAM
    .func_FUN_06020D46 0x06020D46 : SUBALIGN(1)
    {
        *(.text.FUN_06020D46)
    } > HWRAM
    .func_FUN_06020D50 0x06020D50 : SUBALIGN(1)
    {
        *(.text.FUN_06020D50)
    } > HWRAM
    .func_FUN_06020DD0 0x06020DD0 : SUBALIGN(1)
    {
        *(.text.FUN_06020DD0)
    } > HWRAM
    .func_FUN_06020E74 0x06020E74 : SUBALIGN(1)
    {
        *(.text.FUN_06020E74)
    } > HWRAM
    .func_FUN_06020E84 0x06020E84 : SUBALIGN(1)
    {
        *(.text.FUN_06020E84)
    } > HWRAM
    .func_FUN_060210B8 0x060210B8 : SUBALIGN(1)
    {
        *(.text.FUN_060210B8)
    } > HWRAM
    .func_FUN_060210F6 0x060210F6 : SUBALIGN(1)
    {
        *(.text.FUN_060210F6)
    } > HWRAM
    .func_FUN_06021128 0x06021128 : SUBALIGN(1)
    {
        /* overflow: FUN_06021128 goes to catchall */
    } > HWRAM
    .func_FUN_06021178 0x06021178 : SUBALIGN(1)
    {
        *(.text.FUN_06021178)
    } > HWRAM
    .func_FUN_06021450 0x06021450 : SUBALIGN(1)
    {
        *(.text.FUN_06021450)
    } > HWRAM
    .func_FUN_06022140 0x06022140 : SUBALIGN(1)
    {
        *(.text.FUN_06022140)
    } > HWRAM
    .func_FUN_06022820 0x06022820 : SUBALIGN(1)
    {
        *(.text.FUN_06022820)
    } > HWRAM
    .func_FUN_06022AE0 0x06022AE0 : SUBALIGN(1)
    {
        *(.text.FUN_06022AE0)
    } > HWRAM
    .func_FUN_0602304C 0x0602304C : SUBALIGN(1)
    {
        *(.text.FUN_0602304C)
    } > HWRAM
    .func_FUN_06023290 0x06023290 : SUBALIGN(1)
    {
        *(.text.FUN_06023290)
    } > HWRAM
    .func_FUN_06023574 0x06023574 : SUBALIGN(1)
    {
        *(.text.FUN_06023574)
    } > HWRAM
    .func_FUN_06023584 0x06023584 : SUBALIGN(1)
    {
        *(.text.FUN_06023584)
    } > HWRAM
    .func_FUN_0602382C 0x0602382C : SUBALIGN(1)
    {
        *(.text.FUN_0602382C)
    } > HWRAM
    .func_FUN_06024D14 0x06024D14 : SUBALIGN(1)
    {
        *(.text.FUN_06024D14)
    } > HWRAM
    .func_FUN_06024D24 0x06024D24 : SUBALIGN(1)
    {
        *(.text.FUN_06024D24)
    } > HWRAM
    .func_FUN_06025070 0x06025070 : SUBALIGN(1)
    {
        *(.text.FUN_06025070)
    } > HWRAM
    .func_FUN_06025148 0x06025148 : SUBALIGN(1)
    {
        *(.text.FUN_06025148)
    } > HWRAM
    .func_FUN_06025224 0x06025224 : SUBALIGN(1)
    {
        *(.text.FUN_06025224)
    } > HWRAM
    .func_FUN_06025478 0x06025478 : SUBALIGN(1)
    {
        *(.text.FUN_06025478)
    } > HWRAM
    .func_FUN_060256CC 0x060256CC : SUBALIGN(1)
    {
        *(.text.FUN_060256CC)
    } > HWRAM
    .func_FUN_06025BF4 0x06025BF4 : SUBALIGN(1)
    {
        *(.text.FUN_06025BF4)
    } > HWRAM
    .func_FUN_06026110 0x06026110 : SUBALIGN(1)
    {
        *(.text.FUN_06026110)
    } > HWRAM
    .func_FUN_060262C0 0x060262C0 : SUBALIGN(1)
    {
        *(.text.FUN_060262C0)
    } > HWRAM
    .func_FUN_06026362 0x06026362 : SUBALIGN(1)
    {
        /* overflow: FUN_06026362 goes to catchall */
    } > HWRAM
    .func_FUN_060263EC 0x060263EC : SUBALIGN(1)
    {
        *(.text.FUN_060263EC)
    } > HWRAM
    .func_FUN_0602648E 0x0602648E : SUBALIGN(1)
    {
        *(.text.FUN_0602648E)
    } > HWRAM
    .func_FUN_06026518 0x06026518 : SUBALIGN(1)
    {
        *(.text.trampoline_FUN_06026518)
    } > HWRAM
    .func_FUN_06026590 0x06026590 : SUBALIGN(1)
    {
        *(.text.FUN_06026590)
    } > HWRAM
    .func_FUN_060266CC 0x060266CC : SUBALIGN(1)
    {
        *(.text.FUN_060266CC)
    } > HWRAM
    .func_FUN_060268B0 0x060268B0 : SUBALIGN(1)
    {
        *(.text.FUN_060268B0)
    } > HWRAM
    .func_FUN_06026CA4 0x06026CA4 : SUBALIGN(1)
    {
        *(.text.FUN_06026CA4)
    } > HWRAM
    .func_FUN_06026E94 0x06026E94 : SUBALIGN(1)
    {
        *(.text.FUN_06026E94)
    } > HWRAM
    .func_FUN_06026EDE 0x06026EDE : SUBALIGN(1)
    {
        *(.text.trampoline_FUN_06026EDE)
    } > HWRAM
    .func_FUN_06026F2A 0x06026F2A : SUBALIGN(1)
    {
        *(.text.FUN_06026F2A)
    } > HWRAM
    .func_FUN_06026FFC 0x06026FFC : SUBALIGN(1)
    {
        *(.text.FUN_06026FFC)
    } > HWRAM
    .func_FUN_06027158 0x06027158 : SUBALIGN(1)
    {
        *(.text.trampoline_FUN_06027158)
    } > HWRAM
    .func_FUN_060271A2 0x060271A2 : SUBALIGN(1)
    {
        *(.text.FUN_060271A2)
    } > HWRAM
    .func_FUN_060271EE 0x060271EE : SUBALIGN(1)
    {
        *(.text.FUN_060271EE)
    } > HWRAM
    .func_FUN_060272C0 0x060272C0 : SUBALIGN(1)
    {
        *(.text.FUN_060272C0)
    } > HWRAM
    .func_FUN_0602745C 0x0602745C : SUBALIGN(1)
    {
        *(.text.FUN_0602745C)
    } > HWRAM
    .func_FUN_06027498 0x06027498 : SUBALIGN(1)
    {
        *(.text.FUN_06027498)
    } > HWRAM
    .func_FUN_060276CC 0x060276CC : SUBALIGN(1)
    {
        *(.text.FUN_060276CC)
    } > HWRAM
    .func_FUN_060279B0 0x060279B0 : SUBALIGN(1)
    {
        *(.text.FUN_060279B0)
    } > HWRAM
    .func_FUN_06027CA4 0x06027CA4 : SUBALIGN(1)
    {
        *(.text.FUN_06027CA4)
    } > HWRAM
    .func_FUN_06027EDE 0x06027EDE : SUBALIGN(1)
    {
        *(.text.FUN_06027EDE)
    } > HWRAM
    .func_FUN_0602834A 0x0602834A : SUBALIGN(1)
    {
        *(.text.FUN_0602834A)
    } > HWRAM
    .func_FUN_06028368 0x06028368 : SUBALIGN(1)
    {
        *(.text.FUN_06028368)
    } > HWRAM
    .func_FUN_06028384 0x06028384 : SUBALIGN(1)
    {
        *(.text.FUN_06028384)
    } > HWRAM
    .func_FUN_0602843A 0x0602843A : SUBALIGN(1)
    {
        *(.text.FUN_0602843A)
    } > HWRAM
    .func_FUN_060284BA 0x060284BA : SUBALIGN(1)
    {
        *(.text.FUN_060284BA)
    } > HWRAM
    .func_FUN_06028580 0x06028580 : SUBALIGN(1)
    {
        *(.text.FUN_06028580)
    } > HWRAM
    .func_FUN_06028598 0x06028598 : SUBALIGN(1)
    {
        *(.text.FUN_06028598)
    } > HWRAM
    .func_FUN_06028654 0x06028654 : SUBALIGN(1)
    {
        *(.text.FUN_06028654)
    } > HWRAM
    .func_FUN_06029740 0x06029740 : SUBALIGN(1)
    {
        *(.text.FUN_06029740)
    } > HWRAM
    .func_FUN_0602A840 0x0602A840 : SUBALIGN(1)
    {
        *(.text.FUN_0602A840)
    } > HWRAM
    .func_FUN_0602ABC4 0x0602ABC4 : SUBALIGN(1)
    {
        *(.text.FUN_0602ABC4)
    } > HWRAM
    .func_FUN_0602AF48 0x0602AF48 : SUBALIGN(1)
    {
        *(.text.FUN_0602AF48)
    } > HWRAM
    .func_FUN_0602B334 0x0602B334 : SUBALIGN(1)
    {
        *(.text.FUN_0602B334)
    } > HWRAM
    .func_FUN_0602B9EC 0x0602B9EC : SUBALIGN(1)
    {
        *(.text.FUN_0602B9EC)
    } > HWRAM
    .func_FUN_0602BDD8 0x0602BDD8 : SUBALIGN(1)
    {
        *(.text.FUN_0602BDD8)
    } > HWRAM
    .func_FUN_0602C690 0x0602C690 : SUBALIGN(1)
    {
        *(.text.FUN_0602C690)
    } > HWRAM
    .func_FUN_0602C884 0x0602C884 : SUBALIGN(1)
    {
        *(.text.FUN_0602C884)
    } > HWRAM
    .func_FUN_0602C8E2 0x0602C8E2 : SUBALIGN(1)
    {
        *(.text.FUN_0602C8E2)
    } > HWRAM
    .func_FUN_0602CA84 0x0602CA84 : SUBALIGN(1)
    {
        *(.text.FUN_0602CA84)
    } > HWRAM
    .func_FUN_0602CCEC 0x0602CCEC : SUBALIGN(1)
    {
        *(.text.FUN_0602CCEC)
    } > HWRAM
    .func_FUN_0602CDF6 0x0602CDF6 : SUBALIGN(1)
    {
        *(.text.FUN_0602CDF6)
    } > HWRAM
    .func_FUN_0602D08A 0x0602D08A : SUBALIGN(1)
    {
        *(.text.FUN_0602D08A)
    } > HWRAM
    .func_FUN_0602D43C 0x0602D43C : SUBALIGN(1)
    {
        *(.text.FUN_0602D43C)
    } > HWRAM
    .func_FUN_0602D89A 0x0602D89A : SUBALIGN(1)
    {
        *(.text.FUN_0602D89A)
    } > HWRAM
    .func_FUN_0602D8C6 0x0602D8C6 : SUBALIGN(1)
    {
        *(.text.FUN_0602D8C6)
    } > HWRAM
    .func_FUN_0602D924 0x0602D924 : SUBALIGN(1)
    {
        *(.text.FUN_0602D924)
    } > HWRAM
    .func_FUN_0602D934 0x0602D934 : SUBALIGN(1)
    {
        *(.text.FUN_0602D934)
    } > HWRAM
    .func_FUN_0602DB0C 0x0602DB0C : SUBALIGN(1)
    {
        *(.text.FUN_0602DB0C)
    } > HWRAM
    .func_FUN_0602DB14 0x0602DB14 : SUBALIGN(1)
    {
        *(.text.FUN_0602DB14)
    } > HWRAM
    .func_FUN_0602DB22 0x0602DB22 : SUBALIGN(1)
    {
        *(.text.FUN_0602DB22)
    } > HWRAM
    .func_FUN_0602DC24 0x0602DC24 : SUBALIGN(1)
    {
        *(.text.FUN_0602DC24)
    } > HWRAM
    .func_FUN_0602DC30 0x0602DC30 : SUBALIGN(1)
    {
        *(.text.FUN_0602DC30)
    } > HWRAM
    .func_FUN_0602DC68 0x0602DC68 : SUBALIGN(1)
    {
        *(.text.FUN_0602DC68)
    } > HWRAM
    .func_FUN_0602DDA0 0x0602DDA0 : SUBALIGN(1)
    {
        *(.text.FUN_0602DDA0)
    } > HWRAM
    .func_FUN_0602DDCA 0x0602DDCA : SUBALIGN(1)
    {
        *(.text.FUN_0602DDCA)
    } > HWRAM
    .func_FUN_0602DDF8 0x0602DDF8 : SUBALIGN(1)
    {
        *(.text.FUN_0602DDF8)
    } > HWRAM
    .func_FUN_0602DE22 0x0602DE22 : SUBALIGN(1)
    {
        *(.text.FUN_0602DE22)
    } > HWRAM
    .func_FUN_0602DE4C 0x0602DE4C : SUBALIGN(1)
    {
        *(.text.FUN_0602DE4C)
    } > HWRAM
    .func_FUN_0602DE62 0x0602DE62 : SUBALIGN(1)
    {
        *(.text.FUN_0602DE62)
    } > HWRAM
    .func_FUN_0602E07A 0x0602E07A : SUBALIGN(1)
    {
        *(.text.FUN_0602E07A)
    } > HWRAM
    .func_FUN_0602E18A 0x0602E18A : SUBALIGN(1)
    {
        *(.text.FUN_0602E18A)
    } > HWRAM
    .func_FUN_0602E214 0x0602E214 : SUBALIGN(1)
    {
        *(.text.FUN_0602E214)
    } > HWRAM
    .func_FUN_0602E220 0x0602E220 : SUBALIGN(1)
    {
        *(.text.FUN_0602E220)
    } > HWRAM
    .func_FUN_0602E22C 0x0602E22C : SUBALIGN(1)
    {
        *(.text.FUN_0602E22C)
    } > HWRAM
    .func_FUN_0602E236 0x0602E236 : SUBALIGN(1)
    {
        *(.text.FUN_0602E236)
    } > HWRAM
    .func_FUN_0602E240 0x0602E240 : SUBALIGN(1)
    {
        *(.text.FUN_0602E240)
    } > HWRAM
    .func_FUN_0602E24A 0x0602E24A : SUBALIGN(1)
    {
        *(.text.FUN_0602E24A)
    } > HWRAM
    .func_FUN_0602E25A 0x0602E25A : SUBALIGN(1)
    {
        *(.text.FUN_0602E25A)
    } > HWRAM
    .func_FUN_0602E264 0x0602E264 : SUBALIGN(1)
    {
        *(.text.FUN_0602E264)
    } > HWRAM
    .func_FUN_0602E2E0 0x0602E2E0 : SUBALIGN(1)
    {
        *(.text.FUN_0602E2E0)
    } > HWRAM
    .func_FUN_0602E30C 0x0602E30C : SUBALIGN(1)
    {
        *(.text.FUN_0602E30C)
    } > HWRAM
    .func_FUN_0602E320 0x0602E320 : SUBALIGN(1)
    {
        *(.text.FUN_0602E320)
    } > HWRAM
    .func_FUN_0602E32C 0x0602E32C : SUBALIGN(1)
    {
        *(.text.FUN_0602E32C)
    } > HWRAM
    .func_FUN_0602E338 0x0602E338 : SUBALIGN(1)
    {
        *(.text.FUN_0602E338)
    } > HWRAM
    .func_FUN_0602E344 0x0602E344 : SUBALIGN(1)
    {
        *(.text.FUN_0602E344)
    } > HWRAM
    .func_FUN_0602E350 0x0602E350 : SUBALIGN(1)
    {
        *(.text.FUN_0602E350)
    } > HWRAM
    .func_FUN_0602E42E 0x0602E42E : SUBALIGN(1)
    {
        *(.text.FUN_0602E42E)
    } > HWRAM
    .func_FUN_0602E462 0x0602E462 : SUBALIGN(1)
    {
        *(.text.FUN_0602E462)
    } > HWRAM
    .func_FUN_0602E4F4 0x0602E4F4 : SUBALIGN(1)
    {
        *(.text.FUN_0602E4F4)
    } > HWRAM
    .func_FUN_0602E578 0x0602E578 : SUBALIGN(1)
    {
        *(.text.FUN_0602E578)
    } > HWRAM
    .func_FUN_0602E61C 0x0602E61C : SUBALIGN(1)
    {
        *(.text.FUN_0602E61C)
    } > HWRAM
    .func_FUN_0602E678 0x0602E678 : SUBALIGN(1)
    {
        *(.text.FUN_0602E678)
    } > HWRAM
    .func_FUN_0602E68A 0x0602E68A : SUBALIGN(1)
    {
        *(.text.FUN_0602E68A)
    } > HWRAM
    .func_FUN_0602E69E 0x0602E69E : SUBALIGN(1)
    {
        *(.text.FUN_0602E69E)
    } > HWRAM
    .func_FUN_0602E6C4 0x0602E6C4 : SUBALIGN(1)
    {
        *(.text.FUN_0602E6C4)
    } > HWRAM
    .func_FUN_0602E714 0x0602E714 : SUBALIGN(1)
    {
        *(.text.FUN_0602E714)
    } > HWRAM
    .func_FUN_0602E726 0x0602E726 : SUBALIGN(1)
    {
        *(.text.FUN_0602E726)
    } > HWRAM
    .func_FUN_0602E73A 0x0602E73A : SUBALIGN(1)
    {
        *(.text.FUN_0602E73A)
    } > HWRAM
    .func_FUN_0602E768 0x0602E768 : SUBALIGN(1)
    {
        *(.text.FUN_0602E768)
    } > HWRAM
    .func_FUN_0602E7D4 0x0602E7D4 : SUBALIGN(1)
    {
        *(.text.FUN_0602E7D4)
    } > HWRAM
    .func_FUN_0602E826 0x0602E826 : SUBALIGN(1)
    {
        *(.text.FUN_0602E826)
    } > HWRAM
    .func_FUN_0602E84A 0x0602E84A : SUBALIGN(1)
    {
        *(.text.FUN_0602E84A)
    } > HWRAM
    .func_FUN_0602E870 0x0602E870 : SUBALIGN(1)
    {
        *(.text.FUN_0602E870)
    } > HWRAM
    .func_FUN_0602E892 0x0602E892 : SUBALIGN(1)
    {
        *(.text.FUN_0602E892)
    } > HWRAM
    .func_FUN_0602EDA2 0x0602EDA2 : SUBALIGN(1)
    {
        *(.text.FUN_0602EDA2)
    } > HWRAM
    .func_FUN_0602EEB8 0x0602EEB8 : SUBALIGN(1)
    {
        *(.text.FUN_0602EEB8)
    } > HWRAM
    .func_FUN_0602EFDA 0x0602EFDA : SUBALIGN(1)
    {
        *(.text.FUN_0602EFDA)
    } > HWRAM
    .func_FUN_0602EFF0 0x0602EFF0 : SUBALIGN(1)
    {
        *(.text.FUN_0602EFF0)
    } > HWRAM
    .func_FUN_0602F214 0x0602F214 : SUBALIGN(1)
    {
        *(.text.FUN_0602F214)
    } > HWRAM
    .func_FUN_0602F270 0x0602F270 : SUBALIGN(1)
    {
        *(.text.FUN_0602F270)
    } > HWRAM
    .func_FUN_0602F550 0x0602F550 : SUBALIGN(1)
    {
        *(.text.FUN_0602F550)
    } > HWRAM
    .func_FUN_0602F5B6 0x0602F5B6 : SUBALIGN(1)
    {
        *(.text.FUN_0602F5B6)
    } > HWRAM
    .func_FUN_0602F7EA 0x0602F7EA : SUBALIGN(1)
    {
        *(.text.FUN_0602F7EA)
    } > HWRAM
    .func_FUN_0602F7F2 0x0602F7F2 : SUBALIGN(1)
    {
        *(.text.FUN_0602F7F2)
    } > HWRAM
    .func_FUN_0602F99C 0x0602F99C : SUBALIGN(1)
    {
        *(.text.FUN_0602F99C)
    } > HWRAM
    .func_FUN_0602F9A6 0x0602F9A6 : SUBALIGN(1)
    {
        *(.text.FUN_0602F9A6)
    } > HWRAM
    .func_FUN_0602FDB0 0x0602FDB0 : SUBALIGN(1)
    {
        *(.text.FUN_0602FDB0)
    } > HWRAM
    .func_FUN_060302D2 0x060302D2 : SUBALIGN(1)
    {
        *(.text.FUN_060302D2)
    } > HWRAM
    .func_FUN_06030540 0x06030540 : SUBALIGN(1)
    {
        *(.text.FUN_06030540)
    } > HWRAM
    .func_FUN_06030548 0x06030548 : SUBALIGN(1)
    {
        *(.text.FUN_06030548)
    } > HWRAM
    .func_FUN_06030E64 0x06030E64 : SUBALIGN(1)
    {
        *(.text.FUN_06030E64)
    } > HWRAM
    .func_FUN_06030E72 0x06030E72 : SUBALIGN(1)
    {
        *(.text.FUN_06030E72)
    } > HWRAM
    .func_FUN_06030FCC 0x06030FCC : SUBALIGN(1)
    {
        *(.text.FUN_06030FCC)
    } > HWRAM
    .func_FUN_06030FFC 0x06030FFC : SUBALIGN(1)
    {
        *(.text.FUN_06030FFC)
    } > HWRAM
    .func_FUN_0603101E 0x0603101E : SUBALIGN(1)
    {
        *(.text.FUN_0603101E)
    } > HWRAM
    .func_FUN_0603137A 0x0603137A : SUBALIGN(1)
    {
        *(.text.FUN_0603137A)
    } > HWRAM
    .func_FUN_0603139C 0x0603139C : SUBALIGN(1)
    {
        *(.text.FUN_0603139C)
    } > HWRAM
    .func_FUN_060316D0 0x060316D0 : SUBALIGN(1)
    {
        /* overflow: FUN_060316D0 goes to catchall */
    } > HWRAM
    .func_FUN_06031700 0x06031700 : SUBALIGN(1)
    {
        *(.text.FUN_06031700)
    } > HWRAM
    .func_FUN_06031898 0x06031898 : SUBALIGN(1)
    {
        *(.text.FUN_06031898)
    } > HWRAM
    .func_FUN_06031A34 0x06031A34 : SUBALIGN(1)
    {
        *(.text.FUN_06031A34)
    } > HWRAM
    .func_FUN_06031E00 0x06031E00 : SUBALIGN(1)
    {
        *(.text.FUN_06031E00)
    } > HWRAM
    .func_FUN_060321C0 0x060321C0 : SUBALIGN(1)
    {
        *(.text.FUN_060321C0)
    } > HWRAM
    .func_FUN_060321DC 0x060321DC : SUBALIGN(1)
    {
        *(.text.FUN_060321DC)
    } > HWRAM
    .func_FUN_060321EE 0x060321EE : SUBALIGN(1)
    {
        *(.text.FUN_060321EE)
    } > HWRAM
    .func_FUN_0603226C 0x0603226C : SUBALIGN(1)
    {
        *(.text.FUN_0603226C)
    } > HWRAM
    .func_FUN_0603227C 0x0603227C : SUBALIGN(1)
    {
        *(.text.FUN_0603227C)
    } > HWRAM
    .func_FUN_06032286 0x06032286 : SUBALIGN(1)
    {
        *(.text.FUN_06032286)
    } > HWRAM
    .func_FUN_06032290 0x06032290 : SUBALIGN(1)
    {
        *(.text.FUN_06032290)
    } > HWRAM
    .func_FUN_0603229A 0x0603229A : SUBALIGN(1)
    {
        *(.text.FUN_0603229A)
    } > HWRAM
    .func_FUN_060322A4 0x060322A4 : SUBALIGN(1)
    {
        *(.text.FUN_060322A4)
    } > HWRAM
    .func_FUN_060322AE 0x060322AE : SUBALIGN(1)
    {
        *(.text.FUN_060322AE)
    } > HWRAM
    .func_FUN_060322B6 0x060322B6 : SUBALIGN(1)
    {
        *(.text.FUN_060322B6)
    } > HWRAM
    .func_FUN_060323B2 0x060323B2 : SUBALIGN(1)
    {
        *(.text.FUN_060323B2)
    } > HWRAM
    .func_FUN_060323E4 0x060323E4 : SUBALIGN(1)
    {
        *(.text.FUN_060323E4)
    } > HWRAM
    .func_FUN_0603242A 0x0603242A : SUBALIGN(1)
    {
        *(.text.FUN_0603242A)
    } > HWRAM
    .func_FUN_060324EC 0x060324EC : SUBALIGN(1)
    {
        *(.text.FUN_060324EC)
    } > HWRAM
    .func_FUN_060324F4 0x060324F4 : SUBALIGN(1)
    {
        *(.text.FUN_060324F4)
    } > HWRAM
    .func_FUN_060324FC 0x060324FC : SUBALIGN(1)
    {
        *(.text.FUN_060324FC)
    } > HWRAM
    .func_FUN_06032504 0x06032504 : SUBALIGN(1)
    {
        *(.text.FUN_06032504)
    } > HWRAM
    .func_FUN_06032510 0x06032510 : SUBALIGN(1)
    {
        *(.text.FUN_06032510)
    } > HWRAM
    .func_FUN_06032518 0x06032518 : SUBALIGN(1)
    {
        *(.text.FUN_06032518)
    } > HWRAM
    .func_FUN_06032520 0x06032520 : SUBALIGN(1)
    {
        *(.text.FUN_06032520)
    } > HWRAM
    .func_FUN_06032528 0x06032528 : SUBALIGN(1)
    {
        *(.text.FUN_06032528)
    } > HWRAM
    .func_FUN_06032530 0x06032530 : SUBALIGN(1)
    {
        *(.text.FUN_06032530)
    } > HWRAM
    .func_FUN_06032586 0x06032586 : SUBALIGN(1)
    {
        *(.text.FUN_06032586)
    } > HWRAM
    .func_FUN_060325A0 0x060325A0 : SUBALIGN(1)
    {
        *(.text.FUN_060325A0)
    } > HWRAM
    .func_FUN_060325AE 0x060325AE : SUBALIGN(1)
    {
        *(.text.FUN_060325AE)
    } > HWRAM
    .func_FUN_06032604 0x06032604 : SUBALIGN(1)
    {
        *(.text.FUN_06032604)
    } > HWRAM
    .func_FUN_06032618 0x06032618 : SUBALIGN(1)
    {
        *(.text.FUN_06032618)
    } > HWRAM
    .func_FUN_0603262E 0x0603262E : SUBALIGN(1)
    {
        *(.text.FUN_0603262E)
    } > HWRAM
    .func_FUN_06032642 0x06032642 : SUBALIGN(1)
    {
        *(.text.FUN_06032642)
    } > HWRAM
    .func_FUN_06032656 0x06032656 : SUBALIGN(1)
    {
        *(.text.FUN_06032656)
    } > HWRAM
    .func_FUN_06032694 0x06032694 : SUBALIGN(1)
    {
        *(.text.FUN_06032694)
    } > HWRAM
    .func_FUN_060326A2 0x060326A2 : SUBALIGN(1)
    {
        *(.text.FUN_060326A2)
    } > HWRAM
    .func_FUN_060326BC 0x060326BC : SUBALIGN(1)
    {
        *(.text.FUN_060326BC)
    } > HWRAM
    .func_FUN_060326CA 0x060326CA : SUBALIGN(1)
    {
        *(.text.FUN_060326CA)
    } > HWRAM
    .func_FUN_060326D8 0x060326D8 : SUBALIGN(1)
    {
        *(.text.FUN_060326D8)
    } > HWRAM
    .func_FUN_060326E6 0x060326E6 : SUBALIGN(1)
    {
        *(.text.FUN_060326E6)
    } > HWRAM
    .func_FUN_06032726 0x06032726 : SUBALIGN(1)
    {
        *(.text.FUN_06032726)
    } > HWRAM
    .func_FUN_0603273E 0x0603273E : SUBALIGN(1)
    {
        *(.text.FUN_0603273E)
    } > HWRAM
    .func_FUN_0603274C 0x0603274C : SUBALIGN(1)
    {
        *(.text.FUN_0603274C)
    } > HWRAM
    .func_FUN_0603275A 0x0603275A : SUBALIGN(1)
    {
        *(.text.FUN_0603275A)
    } > HWRAM
    .func_FUN_06032768 0x06032768 : SUBALIGN(1)
    {
        *(.text.FUN_06032768)
    } > HWRAM
    .func_FUN_060327FE 0x060327FE : SUBALIGN(1)
    {
        *(.text.FUN_060327FE)
    } > HWRAM
    .func_FUN_06032816 0x06032816 : SUBALIGN(1)
    {
        *(.text.FUN_06032816)
    } > HWRAM
    .func_FUN_06032824 0x06032824 : SUBALIGN(1)
    {
        *(.text.FUN_06032824)
    } > HWRAM
    .func_FUN_06032832 0x06032832 : SUBALIGN(1)
    {
        *(.text.FUN_06032832)
    } > HWRAM
    .func_FUN_06032840 0x06032840 : SUBALIGN(1)
    {
        *(.text.FUN_06032840)
    } > HWRAM
    .func_FUN_0603288A 0x0603288A : SUBALIGN(1)
    {
        *(.text.FUN_0603288A)
    } > HWRAM
    .func_FUN_06032898 0x06032898 : SUBALIGN(1)
    {
        *(.text.FUN_06032898)
    } > HWRAM
    .func_FUN_060328E2 0x060328E2 : SUBALIGN(1)
    {
        *(.text.FUN_060328E2)
    } > HWRAM
    .func_FUN_060328F0 0x060328F0 : SUBALIGN(1)
    {
        *(.text.FUN_060328F0)
    } > HWRAM
    .func_FUN_06032930 0x06032930 : SUBALIGN(1)
    {
        *(.text.FUN_06032930)
    } > HWRAM
    .func_FUN_06032948 0x06032948 : SUBALIGN(1)
    {
        *(.text.FUN_06032948)
    } > HWRAM
    .func_FUN_06032956 0x06032956 : SUBALIGN(1)
    {
        *(.text.FUN_06032956)
    } > HWRAM
    .func_FUN_06032964 0x06032964 : SUBALIGN(1)
    {
        *(.text.FUN_06032964)
    } > HWRAM
    .func_FUN_06032972 0x06032972 : SUBALIGN(1)
    {
        *(.text.FUN_06032972)
    } > HWRAM
    .func_FUN_060329BC 0x060329BC : SUBALIGN(1)
    {
        *(.text.FUN_060329BC)
    } > HWRAM
    .func_FUN_060329CA 0x060329CA : SUBALIGN(1)
    {
        *(.text.FUN_060329CA)
    } > HWRAM
    .func_FUN_06032A14 0x06032A14 : SUBALIGN(1)
    {
        *(.text.FUN_06032A14)
    } > HWRAM
    .func_FUN_06032A22 0x06032A22 : SUBALIGN(1)
    {
        *(.text.FUN_06032A22)
    } > HWRAM
    .func_FUN_06032A62 0x06032A62 : SUBALIGN(1)
    {
        *(.text.FUN_06032A62)
    } > HWRAM
    .func_FUN_06032AF0 0x06032AF0 : SUBALIGN(1)
    {
        *(.text.FUN_06032AF0)
    } > HWRAM
    .func_FUN_06032AFE 0x06032AFE : SUBALIGN(1)
    {
        *(.text.FUN_06032AFE)
    } > HWRAM
    .func_FUN_06032B0C 0x06032B0C : SUBALIGN(1)
    {
        *(.text.FUN_06032B0C)
    } > HWRAM
    .func_FUN_06032B1A 0x06032B1A : SUBALIGN(1)
    {
        *(.text.FUN_06032B1A)
    } > HWRAM
    .func_FUN_06032B5A 0x06032B5A : SUBALIGN(1)
    {
        *(.text.FUN_06032B5A)
    } > HWRAM
    .func_FUN_06032B72 0x06032B72 : SUBALIGN(1)
    {
        *(.text.FUN_06032B72)
    } > HWRAM
    .func_FUN_06032B80 0x06032B80 : SUBALIGN(1)
    {
        *(.text.FUN_06032B80)
    } > HWRAM
    .func_FUN_06032B8E 0x06032B8E : SUBALIGN(1)
    {
        *(.text.FUN_06032B8E)
    } > HWRAM
    .func_FUN_06032B9C 0x06032B9C : SUBALIGN(1)
    {
        *(.text.FUN_06032B9C)
    } > HWRAM
    .func_FUN_06032BE6 0x06032BE6 : SUBALIGN(1)
    {
        *(.text.FUN_06032BE6)
    } > HWRAM
    .func_FUN_06032BF4 0x06032BF4 : SUBALIGN(1)
    {
        *(.text.FUN_06032BF4)
    } > HWRAM
    .func_FUN_06032C34 0x06032C34 : SUBALIGN(1)
    {
        *(.text.FUN_06032C34)
    } > HWRAM
    .func_FUN_06032C4C 0x06032C4C : SUBALIGN(1)
    {
        *(.text.FUN_06032C4C)
    } > HWRAM
    .func_FUN_06032C5A 0x06032C5A : SUBALIGN(1)
    {
        *(.text.FUN_06032C5A)
    } > HWRAM
    .func_FUN_06032C68 0x06032C68 : SUBALIGN(1)
    {
        *(.text.FUN_06032C68)
    } > HWRAM
    .func_FUN_06032C76 0x06032C76 : SUBALIGN(1)
    {
        *(.text.FUN_06032C76)
    } > HWRAM
    .func_FUN_06032CC0 0x06032CC0 : SUBALIGN(1)
    {
        *(.text.FUN_06032CC0)
    } > HWRAM
    .func_FUN_06032CCE 0x06032CCE : SUBALIGN(1)
    {
        *(.text.FUN_06032CCE)
    } > HWRAM
    .func_FUN_06032D0E 0x06032D0E : SUBALIGN(1)
    {
        *(.text.FUN_06032D0E)
    } > HWRAM
    .func_FUN_06032EBE 0x06032EBE : SUBALIGN(1)
    {
        *(.text.FUN_06032EBE)
    } > HWRAM
    .func_FUN_06032ED8 0x06032ED8 : SUBALIGN(1)
    {
        *(.text.FUN_06032ED8)
    } > HWRAM
    .func_FUN_06032EE6 0x06032EE6 : SUBALIGN(1)
    {
        *(.text.FUN_06032EE6)
    } > HWRAM
    .func_FUN_06032EFC 0x06032EFC : SUBALIGN(1)
    {
        *(.text.FUN_06032EFC)
    } > HWRAM
    .func_FUN_06032F12 0x06032F12 : SUBALIGN(1)
    {
        *(.text.FUN_06032F12)
    } > HWRAM
    .func_FUN_06032F20 0x06032F20 : SUBALIGN(1)
    {
        *(.text.FUN_06032F20)
    } > HWRAM
    .func_FUN_06032F2A 0x06032F2A : SUBALIGN(1)
    {
        *(.text.FUN_06032F2A)
    } > HWRAM
    .func_FUN_06032F34 0x06032F34 : SUBALIGN(1)
    {
        *(.text.FUN_06032F34)
    } > HWRAM
    .func_FUN_06032F4C 0x06032F4C : SUBALIGN(1)
    {
        *(.text.FUN_06032F4C)
    } > HWRAM
    .func_FUN_06032F62 0x06032F62 : SUBALIGN(1)
    {
        *(.text.FUN_06032F62)
    } > HWRAM
    .func_FUN_06032F70 0x06032F70 : SUBALIGN(1)
    {
        *(.text.FUN_06032F70)
    } > HWRAM
    .func_FUN_06032F7A 0x06032F7A : SUBALIGN(1)
    {
        *(.text.FUN_06032F7A)
    } > HWRAM
    .func_FUN_06032F84 0x06032F84 : SUBALIGN(1)
    {
        *(.text.FUN_06032F84)
    } > HWRAM
    .func_FUN_06032F9A 0x06032F9A : SUBALIGN(1)
    {
        *(.text.FUN_06032F9A)
    } > HWRAM
    .func_FUN_06032FB0 0x06032FB0 : SUBALIGN(1)
    {
        *(.text.FUN_06032FB0)
    } > HWRAM
    .func_FUN_06032FBC 0x06032FBC : SUBALIGN(1)
    {
        *(.text.FUN_06032FBC)
    } > HWRAM
    .func_FUN_06032FC6 0x06032FC6 : SUBALIGN(1)
    {
        *(.text.FUN_06032FC6)
    } > HWRAM
    .func_FUN_06032FD4 0x06032FD4 : SUBALIGN(1)
    {
        *(.text.FUN_06032FD4)
    } > HWRAM
    .func_FUN_06033020 0x06033020 : SUBALIGN(1)
    {
        *(.text.FUN_06033020)
    } > HWRAM
    .func_FUN_06033086 0x06033086 : SUBALIGN(1)
    {
        *(.text.FUN_06033086)
    } > HWRAM
    .func_FUN_0603308E 0x0603308E : SUBALIGN(1)
    {
        *(.text.FUN_0603308E)
    } > HWRAM
    .func_FUN_060330A4 0x060330A4 : SUBALIGN(1)
    {
        *(.text.FUN_060330A4)
    } > HWRAM
    .func_FUN_06033100 0x06033100 : SUBALIGN(1)
    {
        *(.text.FUN_06033100)
    } > HWRAM
    .func_FUN_0603312C 0x0603312C : SUBALIGN(1)
    {
        *(.text.FUN_0603312C)
    } > HWRAM
    .func_FUN_0603319C 0x0603319C : SUBALIGN(1)
    {
        *(.text.FUN_0603319C)
    } > HWRAM
    .func_FUN_060331AA 0x060331AA : SUBALIGN(1)
    {
        *(.text.FUN_060331AA)
    } > HWRAM
    .func_FUN_060331BA 0x060331BA : SUBALIGN(1)
    {
        *(.text.FUN_060331BA)
    } > HWRAM
    .func_FUN_060331CA 0x060331CA : SUBALIGN(1)
    {
        *(.text.FUN_060331CA)
    } > HWRAM
    .func_FUN_060331DA 0x060331DA : SUBALIGN(1)
    {
        *(.text.FUN_060331DA)
    } > HWRAM
    .func_FUN_06033230 0x06033230 : SUBALIGN(1)
    {
        *(.text.FUN_06033230)
    } > HWRAM
    .func_FUN_06033240 0x06033240 : SUBALIGN(1)
    {
        *(.text.FUN_06033240)
    } > HWRAM
    .func_FUN_06033338 0x06033338 : SUBALIGN(1)
    {
        *(.text.FUN_06033338)
    } > HWRAM
    .func_FUN_0603338E 0x0603338E : SUBALIGN(1)
    {
        *(.text.FUN_0603338E)
    } > HWRAM
    .func_FUN_060333A4 0x060333A4 : SUBALIGN(1)
    {
        *(.text.FUN_060333A4)
    } > HWRAM
    .func_FUN_060333E4 0x060333E4 : SUBALIGN(1)
    {
        *(.text.FUN_060333E4)
    } > HWRAM
    .func_FUN_060333F4 0x060333F4 : SUBALIGN(1)
    {
        *(.text.FUN_060333F4)
    } > HWRAM
    .func_FUN_06033402 0x06033402 : SUBALIGN(1)
    {
        *(.text.FUN_06033402)
    } > HWRAM
    .func_FUN_0603340A 0x0603340A : SUBALIGN(1)
    {
        *(.text.FUN_0603340A)
    } > HWRAM
    .func_FUN_06033428 0x06033428 : SUBALIGN(1)
    {
        *(.text.FUN_06033428)
    } > HWRAM
    .func_FUN_06033432 0x06033432 : SUBALIGN(1)
    {
        *(.text.FUN_06033432)
    } > HWRAM
    .func_FUN_0603343A 0x0603343A : SUBALIGN(1)
    {
        *(.text.FUN_0603343A)
    } > HWRAM
    .func_FUN_060334D2 0x060334D2 : SUBALIGN(1)
    {
        *(.text.FUN_060334D2)
    } > HWRAM
    .func_FUN_060334DA 0x060334DA : SUBALIGN(1)
    {
        *(.text.FUN_060334DA)
    } > HWRAM
    .func_FUN_06033578 0x06033578 : SUBALIGN(1)
    {
        *(.text.FUN_06033578)
    } > HWRAM
    .func_FUN_0603358E 0x0603358E : SUBALIGN(1)
    {
        *(.text.FUN_0603358E)
    } > HWRAM
    .func_FUN_0603359E 0x0603359E : SUBALIGN(1)
    {
        *(.text.FUN_0603359E)
    } > HWRAM
    .func_FUN_060335AE 0x060335AE : SUBALIGN(1)
    {
        *(.text.FUN_060335AE)
    } > HWRAM
    .func_FUN_060335BE 0x060335BE : SUBALIGN(1)
    {
        *(.text.FUN_060335BE)
    } > HWRAM
    .func_FUN_06033606 0x06033606 : SUBALIGN(1)
    {
        *(.text.FUN_06033606)
    } > HWRAM
    .func_FUN_06033614 0x06033614 : SUBALIGN(1)
    {
        *(.text.FUN_06033614)
    } > HWRAM
    .func_FUN_0603367A 0x0603367A : SUBALIGN(1)
    {
        *(.text.FUN_0603367A)
    } > HWRAM
    .func_FUN_060336AC 0x060336AC : SUBALIGN(1)
    {
        *(.text.FUN_060336AC)
    } > HWRAM
    .func_FUN_06033726 0x06033726 : SUBALIGN(1)
    {
        *(.text.FUN_06033726)
    } > HWRAM
    .func_FUN_06033738 0x06033738 : SUBALIGN(1)
    {
        *(.text.FUN_06033738)
    } > HWRAM
    .func_FUN_060337AE 0x060337AE : SUBALIGN(1)
    {
        *(.text.FUN_060337AE)
    } > HWRAM
    .func_FUN_060337BE 0x060337BE : SUBALIGN(1)
    {
        *(.text.FUN_060337BE)
    } > HWRAM
    .func_FUN_060337C6 0x060337C6 : SUBALIGN(1)
    {
        *(.text.FUN_060337C6)
    } > HWRAM
    .func_FUN_06033AAC 0x06033AAC : SUBALIGN(1)
    {
        *(.text.FUN_06033AAC)
    } > HWRAM
    .func_FUN_06033BC8 0x06033BC8 : SUBALIGN(1)
    {
        *(.text.FUN_06033BC8)
    } > HWRAM
    .func_FUN_06033C08 0x06033C08 : SUBALIGN(1)
    {
        *(.text.FUN_06033C08)
    } > HWRAM
    .func_FUN_06033C14 0x06033C14 : SUBALIGN(1)
    {
        *(.text.FUN_06033C14)
    } > HWRAM
    .func_FUN_06033C20 0x06033C20 : SUBALIGN(1)
    {
        *(.text.FUN_06033C20)
    } > HWRAM
    .func_FUN_06033C32 0x06033C32 : SUBALIGN(1)
    {
        *(.text.FUN_06033C32)
    } > HWRAM
    .func_FUN_06033C6E 0x06033C6E : SUBALIGN(1)
    {
        *(.text.FUN_06033C6E)
    } > HWRAM
    .func_FUN_06033C78 0x06033C78 : SUBALIGN(1)
    {
        *(.text.FUN_06033C78)
    } > HWRAM
    .func_FUN_06033C82 0x06033C82 : SUBALIGN(1)
    {
        *(.text.FUN_06033C82)
    } > HWRAM
    .func_FUN_06033C8C 0x06033C8C : SUBALIGN(1)
    {
        *(.text.FUN_06033C8C)
    } > HWRAM
    .func_FUN_06033C96 0x06033C96 : SUBALIGN(1)
    {
        *(.text.FUN_06033C96)
    } > HWRAM
    .func_FUN_06033CA0 0x06033CA0 : SUBALIGN(1)
    {
        *(.text.FUN_06033CA0)
    } > HWRAM
    .func_FUN_06033CAA 0x06033CAA : SUBALIGN(1)
    {
        *(.text.FUN_06033CAA)
    } > HWRAM
    .func_FUN_06033CB4 0x06033CB4 : SUBALIGN(1)
    {
        *(.text.FUN_06033CB4)
    } > HWRAM
    .func_FUN_06033CBE 0x06033CBE : SUBALIGN(1)
    {
        *(.text.FUN_06033CBE)
    } > HWRAM
    .func_FUN_06033CC8 0x06033CC8 : SUBALIGN(1)
    {
        *(.text.FUN_06033CC8)
    } > HWRAM
    .func_FUN_06033CD2 0x06033CD2 : SUBALIGN(1)
    {
        *(.text.FUN_06033CD2)
    } > HWRAM
    .func_FUN_06033CDC 0x06033CDC : SUBALIGN(1)
    {
        *(.text.FUN_06033CDC)
    } > HWRAM
    .func_FUN_06033CE6 0x06033CE6 : SUBALIGN(1)
    {
        *(.text.FUN_06033CE6)
    } > HWRAM
    .func_FUN_06033CF0 0x06033CF0 : SUBALIGN(1)
    {
        *(.text.FUN_06033CF0)
    } > HWRAM
    .func_FUN_06033CFA 0x06033CFA : SUBALIGN(1)
    {
        *(.text.FUN_06033CFA)
    } > HWRAM
    .func_FUN_06033D04 0x06033D04 : SUBALIGN(1)
    {
        *(.text.FUN_06033D04)
    } > HWRAM
    .func_FUN_06033D0E 0x06033D0E : SUBALIGN(1)
    {
        *(.text.FUN_06033D0E)
    } > HWRAM
    .func_FUN_06033D18 0x06033D18 : SUBALIGN(1)
    {
        *(.text.FUN_06033D18)
    } > HWRAM
    .func_FUN_06033D22 0x06033D22 : SUBALIGN(1)
    {
        *(.text.FUN_06033D22)
    } > HWRAM
    .func_FUN_06033D2C 0x06033D2C : SUBALIGN(1)
    {
        *(.text.FUN_06033D2C)
    } > HWRAM
    .func_FUN_06033D76 0x06033D76 : SUBALIGN(1)
    {
        *(.text.FUN_06033D76)
    } > HWRAM
    .func_FUN_06033D8A 0x06033D8A : SUBALIGN(1)
    {
        *(.text.FUN_06033D8A)
    } > HWRAM
    .func_FUN_06033D94 0x06033D94 : SUBALIGN(1)
    {
        *(.text.FUN_06033D94)
    } > HWRAM
    .func_FUN_06033D9E 0x06033D9E : SUBALIGN(1)
    {
        *(.text.FUN_06033D9E)
    } > HWRAM
    .func_FUN_06033DA8 0x06033DA8 : SUBALIGN(1)
    {
        *(.text.FUN_06033DA8)
    } > HWRAM
    .func_FUN_06033DB8 0x06033DB8 : SUBALIGN(1)
    {
        *(.text.FUN_06033DB8)
    } > HWRAM
    .func_FUN_06033DC2 0x06033DC2 : SUBALIGN(1)
    {
        *(.text.FUN_06033DC2)
    } > HWRAM
    .func_FUN_06033DCC 0x06033DCC : SUBALIGN(1)
    {
        *(.text.FUN_06033DCC)
    } > HWRAM
    .func_FUN_06033DD6 0x06033DD6 : SUBALIGN(1)
    {
        *(.text.FUN_06033DD6)
    } > HWRAM
    .func_FUN_06033DE0 0x06033DE0 : SUBALIGN(1)
    {
        *(.text.FUN_06033DE0)
    } > HWRAM
    .func_FUN_06033DF0 0x06033DF0 : SUBALIGN(1)
    {
        *(.text.FUN_06033DF0)
    } > HWRAM
    .func_FUN_06033DFA 0x06033DFA : SUBALIGN(1)
    {
        *(.text.FUN_06033DFA)
    } > HWRAM
    .func_FUN_06033E04 0x06033E04 : SUBALIGN(1)
    {
        *(.text.FUN_06033E04)
    } > HWRAM
    .func_FUN_06033E0E 0x06033E0E : SUBALIGN(1)
    {
        *(.text.FUN_06033E0E)
    } > HWRAM
    .func_FUN_06033E18 0x06033E18 : SUBALIGN(1)
    {
        *(.text.FUN_06033E18)
    } > HWRAM
    .func_FUN_06033E22 0x06033E22 : SUBALIGN(1)
    {
        *(.text.FUN_06033E22)
    } > HWRAM
    .func_FUN_06033E2C 0x06033E2C : SUBALIGN(1)
    {
        *(.text.FUN_06033E2C)
    } > HWRAM
    .func_FUN_06033E36 0x06033E36 : SUBALIGN(1)
    {
        *(.text.FUN_06033E36)
    } > HWRAM
    .func_FUN_06033E40 0x06033E40 : SUBALIGN(1)
    {
        *(.text.FUN_06033E40)
    } > HWRAM
    .func_FUN_06033E4A 0x06033E4A : SUBALIGN(1)
    {
        *(.text.FUN_06033E4A)
    } > HWRAM
    .func_FUN_06033EA8 0x06033EA8 : SUBALIGN(1)
    {
        *(.text.FUN_06033EA8)
    } > HWRAM
    .func_FUN_06033ED2 0x06033ED2 : SUBALIGN(1)
    {
        *(.text.FUN_06033ED2)
    } > HWRAM
    .func_FUN_06033EDE 0x06033EDE : SUBALIGN(1)
    {
        *(.text.FUN_06033EDE)
    } > HWRAM
    .func_FUN_06033EEA 0x06033EEA : SUBALIGN(1)
    {
        *(.text.FUN_06033EEA)
    } > HWRAM
    .func_FUN_06033EF6 0x06033EF6 : SUBALIGN(1)
    {
        *(.text.FUN_06033EF6)
    } > HWRAM
    .func_FUN_06033F80 0x06033F80 : SUBALIGN(1)
    {
        *(.text.FUN_06033F80)
    } > HWRAM
    .func_FUN_06033F88 0x06033F88 : SUBALIGN(1)
    {
        *(.text.FUN_06033F88)
    } > HWRAM
    .func_FUN_06033F90 0x06033F90 : SUBALIGN(1)
    {
        *(.text.FUN_06033F90)
    } > HWRAM
    .func_FUN_06033FB0 0x06033FB0 : SUBALIGN(1)
    {
        *(.text.FUN_06033FB0)
    } > HWRAM
    .func_FUN_06033FB8 0x06033FB8 : SUBALIGN(1)
    {
        *(.text.FUN_06033FB8)
    } > HWRAM
    .func_FUN_06033FC0 0x06033FC0 : SUBALIGN(1)
    {
        *(.text.FUN_06033FC0)
    } > HWRAM
    .func_FUN_06033FC8 0x06033FC8 : SUBALIGN(1)
    {
        *(.text.FUN_06033FC8)
    } > HWRAM
    .func_FUN_06033FD4 0x06033FD4 : SUBALIGN(1)
    {
        *(.text.FUN_06033FD4)
    } > HWRAM
    .func_FUN_06033FDC 0x06033FDC : SUBALIGN(1)
    {
        *(.text.FUN_06033FDC)
    } > HWRAM
    .func_FUN_06033FE4 0x06033FE4 : SUBALIGN(1)
    {
        *(.text.FUN_06033FE4)
    } > HWRAM
    .func_FUN_06033FEC 0x06033FEC : SUBALIGN(1)
    {
        *(.text.FUN_06033FEC)
    } > HWRAM
    .func_FUN_06033FF4 0x06033FF4 : SUBALIGN(1)
    {
        *(.text.FUN_06033FF4)
    } > HWRAM
    .func_FUN_06034036 0x06034036 : SUBALIGN(1)
    {
        *(.text.FUN_06034036)
    } > HWRAM
    .func_FUN_0603405A 0x0603405A : SUBALIGN(1)
    {
        *(.text.FUN_0603405A)
    } > HWRAM
    .func_FUN_060340C0 0x060340C0 : SUBALIGN(1)
    {
        *(.text.FUN_060340C0)
    } > HWRAM
    .func_FUN_060340CE 0x060340CE : SUBALIGN(1)
    {
        *(.text.FUN_060340CE)
    } > HWRAM
    .func_FUN_060340DC 0x060340DC : SUBALIGN(1)
    {
        *(.text.FUN_060340DC)
    } > HWRAM
    .func_FUN_0603411E 0x0603411E : SUBALIGN(1)
    {
        *(.text.FUN_0603411E)
    } > HWRAM
    .func_FUN_0603412E 0x0603412E : SUBALIGN(1)
    {
        *(.text.FUN_0603412E)
    } > HWRAM
    .func_FUN_06034172 0x06034172 : SUBALIGN(1)
    {
        *(.text.FUN_06034172)
    } > HWRAM
    .func_FUN_0603418C 0x0603418C : SUBALIGN(1)
    {
        *(.text.FUN_0603418C)
    } > HWRAM
    .func_FUN_0603419A 0x0603419A : SUBALIGN(1)
    {
        *(.text.FUN_0603419A)
    } > HWRAM
    .func_FUN_060341A8 0x060341A8 : SUBALIGN(1)
    {
        *(.text.FUN_060341A8)
    } > HWRAM
    .func_FUN_060341B2 0x060341B2 : SUBALIGN(1)
    {
        *(.text.FUN_060341B2)
    } > HWRAM
    .func_FUN_060341FA 0x060341FA : SUBALIGN(1)
    {
        *(.text.FUN_060341FA)
    } > HWRAM
    .func_FUN_06034214 0x06034214 : SUBALIGN(1)
    {
        *(.text.FUN_06034214)
    } > HWRAM
    .func_FUN_06034228 0x06034228 : SUBALIGN(1)
    {
        *(.text.FUN_06034228)
    } > HWRAM
    .func_FUN_06034236 0x06034236 : SUBALIGN(1)
    {
        *(.text.FUN_06034236)
    } > HWRAM
    .func_FUN_06034240 0x06034240 : SUBALIGN(1)
    {
        *(.text.FUN_06034240)
    } > HWRAM
    .func_FUN_06034286 0x06034286 : SUBALIGN(1)
    {
        *(.text.FUN_06034286)
    } > HWRAM
    .func_FUN_060342A0 0x060342A0 : SUBALIGN(1)
    {
        *(.text.FUN_060342A0)
    } > HWRAM
    .func_FUN_060342AE 0x060342AE : SUBALIGN(1)
    {
        *(.text.FUN_060342AE)
    } > HWRAM
    .func_FUN_060342BC 0x060342BC : SUBALIGN(1)
    {
        *(.text.FUN_060342BC)
    } > HWRAM
    .func_FUN_060342C6 0x060342C6 : SUBALIGN(1)
    {
        *(.text.FUN_060342C6)
    } > HWRAM
    .func_FUN_0603430E 0x0603430E : SUBALIGN(1)
    {
        *(.text.FUN_0603430E)
    } > HWRAM
    .func_FUN_06034328 0x06034328 : SUBALIGN(1)
    {
        *(.text.FUN_06034328)
    } > HWRAM
    .func_FUN_06034336 0x06034336 : SUBALIGN(1)
    {
        *(.text.FUN_06034336)
    } > HWRAM
    .func_FUN_06034344 0x06034344 : SUBALIGN(1)
    {
        *(.text.FUN_06034344)
    } > HWRAM
    .func_FUN_0603434E 0x0603434E : SUBALIGN(1)
    {
        *(.text.FUN_0603434E)
    } > HWRAM
    .func_FUN_06034366 0x06034366 : SUBALIGN(1)
    {
        *(.text.FUN_06034366)
    } > HWRAM
    .func_FUN_06034388 0x06034388 : SUBALIGN(1)
    {
        *(.text.FUN_06034388)
    } > HWRAM
    .func_FUN_06034396 0x06034396 : SUBALIGN(1)
    {
        *(.text.FUN_06034396)
    } > HWRAM
    .func_FUN_060343A4 0x060343A4 : SUBALIGN(1)
    {
        *(.text.FUN_060343A4)
    } > HWRAM
    .func_FUN_060343AE 0x060343AE : SUBALIGN(1)
    {
        *(.text.FUN_060343AE)
    } > HWRAM
    .func_FUN_060343C6 0x060343C6 : SUBALIGN(1)
    {
        *(.text.FUN_060343C6)
    } > HWRAM
    .func_FUN_060343E8 0x060343E8 : SUBALIGN(1)
    {
        *(.text.FUN_060343E8)
    } > HWRAM
    .func_FUN_060343F8 0x060343F8 : SUBALIGN(1)
    {
        *(.text.FUN_060343F8)
    } > HWRAM
    .func_FUN_06034406 0x06034406 : SUBALIGN(1)
    {
        *(.text.FUN_06034406)
    } > HWRAM
    .func_FUN_06034410 0x06034410 : SUBALIGN(1)
    {
        *(.text.FUN_06034410)
    } > HWRAM
    .func_FUN_060344FC 0x060344FC : SUBALIGN(1)
    {
        *(.text.FUN_060344FC)
    } > HWRAM
    .func_FUN_06034526 0x06034526 : SUBALIGN(1)
    {
        *(.text.FUN_06034526)
    } > HWRAM
    .func_FUN_0603459C 0x0603459C : SUBALIGN(1)
    {
        *(.text.FUN_0603459C)
    } > HWRAM
    .func_FUN_060345B8 0x060345B8 : SUBALIGN(1)
    {
        *(.text.FUN_060345B8)
    } > HWRAM
    .func_FUN_060345E2 0x060345E2 : SUBALIGN(1)
    {
        *(.text.FUN_060345E2)
    } > HWRAM
    .func_FUN_060345F2 0x060345F2 : SUBALIGN(1)
    {
        *(.text.FUN_060345F2)
    } > HWRAM
    .func_FUN_06034642 0x06034642 : SUBALIGN(1)
    {
        *(.text.FUN_06034642)
    } > HWRAM
    .func_FUN_0603465C 0x0603465C : SUBALIGN(1)
    {
        *(.text.FUN_0603465C)
    } > HWRAM
    .func_FUN_0603466A 0x0603466A : SUBALIGN(1)
    {
        *(.text.FUN_0603466A)
    } > HWRAM
    .func_FUN_06034678 0x06034678 : SUBALIGN(1)
    {
        *(.text.FUN_06034678)
    } > HWRAM
    .func_FUN_06034682 0x06034682 : SUBALIGN(1)
    {
        *(.text.FUN_06034682)
    } > HWRAM
    .func_FUN_06034708 0x06034708 : SUBALIGN(1)
    {
        *(.text.trampoline_FUN_06034708)
    } > HWRAM
    .func_FUN_06034720 0x06034720 : SUBALIGN(1)
    {
        *(.text.FUN_06034720)
    } > HWRAM
    .func_FUN_06034728 0x06034728 : SUBALIGN(1)
    {
        *(.text.FUN_06034728)
    } > HWRAM
    .func_FUN_06034730 0x06034730 : SUBALIGN(1)
    {
        *(.text.FUN_06034730)
    } > HWRAM
    .func_FUN_06034762 0x06034762 : SUBALIGN(1)
    {
        *(.text.FUN_06034762)
    } > HWRAM
    .func_FUN_060348E6 0x060348E6 : SUBALIGN(1)
    {
        *(.text.FUN_060348E6)
    } > HWRAM
    .func_FUN_06034900 0x06034900 : SUBALIGN(1)
    {
        *(.text.FUN_06034900)
    } > HWRAM
    .func_FUN_0603493A 0x0603493A : SUBALIGN(1)
    {
        *(.text.FUN_0603493A)
    } > HWRAM
    .func_FUN_0603495C 0x0603495C : SUBALIGN(1)
    {
        *(.text.FUN_0603495C)
    } > HWRAM
    .func_FUN_06034984 0x06034984 : SUBALIGN(1)
    {
        *(.text.trampoline_FUN_06034984)
    } > HWRAM
    .func_FUN_060349B6 0x060349B6 : SUBALIGN(1)
    {
        *(.text.trampoline_FUN_060349B6)
    } > HWRAM
    .func_FUN_060349C4 0x060349C4 : SUBALIGN(1)
    {
        *(.text.FUN_060349C4)
    } > HWRAM
    .func_FUN_06034A10 0x06034A10 : SUBALIGN(1)
    {
        *(.text.FUN_06034A10)
    } > HWRAM
    .func_FUN_06034A9C 0x06034A9C : SUBALIGN(1)
    {
        *(.text.FUN_06034A9C)
    } > HWRAM
    .func_FUN_06034AA0 0x06034AA0 : SUBALIGN(1)
    {
        *(.text.FUN_06034AA0)
    } > HWRAM
    .func_FUN_06034AEE 0x06034AEE : SUBALIGN(1)
    {
        *(.text.FUN_06034AEE)
    } > HWRAM
    .func_FUN_06034B54 0x06034B54 : SUBALIGN(1)
    {
        *(.text.FUN_06034B54)
    } > HWRAM
    .func_FUN_06034B5C 0x06034B5C : SUBALIGN(1)
    {
        *(.text.FUN_06034B5C)
    } > HWRAM
    .func_FUN_06034B9A 0x06034B9A : SUBALIGN(1)
    {
        *(.text.FUN_06034B9A)
    } > HWRAM
    .func_FUN_06034BA8 0x06034BA8 : SUBALIGN(1)
    {
        *(.text.FUN_06034BA8)
    } > HWRAM
    .func_FUN_06034C48 0x06034C48 : SUBALIGN(1)
    {
        /* overflow: FUN_06034C48 goes to catchall */
    } > HWRAM
    .func_FUN_06034C68 0x06034C68 : SUBALIGN(1)
    {
        *(.text.FUN_06034C68)
    } > HWRAM
    .func_FUN_06034CC8 0x06034CC8 : SUBALIGN(1)
    {
        *(.text.FUN_06034CC8)
    } > HWRAM
    .func_FUN_06034CCC 0x06034CCC : SUBALIGN(1)
    {
        *(.text.FUN_06034CCC)
    } > HWRAM
    .func_FUN_06034D1C 0x06034D1C : SUBALIGN(1)
    {
        *(.text.FUN_06034D1C)
    } > HWRAM
    .func_FUN_06034D20 0x06034D20 : SUBALIGN(1)
    {
        *(.text.FUN_06034D20)
    } > HWRAM
    .func_FUN_06034D5E 0x06034D5E : SUBALIGN(1)
    {
        *(.text.FUN_06034D5E)
    } > HWRAM
    .func_FUN_06034DEA 0x06034DEA : SUBALIGN(1)
    {
        *(.text.FUN_06034DEA)
    } > HWRAM
    .func_FUN_06034E20 0x06034E20 : SUBALIGN(1)
    {
        *(.text.FUN_06034E20)
    } > HWRAM
    .func_FUN_06034E24 0x06034E24 : SUBALIGN(1)
    {
        *(.text.FUN_06034E24)
    } > HWRAM
    .func_FUN_06034F08 0x06034F08 : SUBALIGN(1)
    {
        *(.text.FUN_06034F08)
    } > HWRAM
    .func_FUN_06035A08 0x06035A08 : SUBALIGN(1)
    {
        *(.text.FUN_06035A08)
    } > HWRAM
    .func_FUN_06035C08 0x06035C08 : SUBALIGN(1)
    {
        *(.text.FUN_06035C08)
    } > HWRAM
    .func_FUN_06035C54 0x06035C54 : SUBALIGN(1)
    {
        *(.text.FUN_06035C54)
    } > HWRAM
    .func_FUN_06035C80 0x06035C80 : SUBALIGN(1)
    {
        *(.text.FUN_06035C80)
    } > HWRAM
    .func_FUN_06035CBC 0x06035CBC : SUBALIGN(1)
    {
        *(.text.FUN_06035CBC)
    } > HWRAM
    .func_FUN_06035D22 0x06035D22 : SUBALIGN(1)
    {
        *(.text.FUN_06035D22)
    } > HWRAM
    .func_FUN_06035D5A 0x06035D5A : SUBALIGN(1)
    {
        *(.text.FUN_06035D5A)
    } > HWRAM
    .func_FUN_06035E00 0x06035E00 : SUBALIGN(1)
    {
        *(.text.FUN_06035E00)
    } > HWRAM
    .func_FUN_06035E90 0x06035E90 : SUBALIGN(1)
    {
        *(.text.FUN_06035E90)
    } > HWRAM
    .func_FUN_06035EA2 0x06035EA2 : SUBALIGN(1)
    {
        *(.text.FUN_06035EA2)
    } > HWRAM
    .func_FUN_06035EC8 0x06035EC8 : SUBALIGN(1)
    {
        *(.text.FUN_06035EC8)
    } > HWRAM
    .func_FUN_06035F04 0x06035F04 : SUBALIGN(1)
    {
        *(.text.FUN_06035F04)
    } > HWRAM
    .func_FUN_06036144 0x06036144 : SUBALIGN(1)
    {
        /* overflow: FUN_06036144 goes to catchall */
    } > HWRAM
    .func_FUN_06036148 0x06036148 : SUBALIGN(1)
    {
        *(.text.FUN_06036148)
    } > HWRAM
    .func_FUN_06036172 0x06036172 : SUBALIGN(1)
    {
        *(.text.FUN_06036172)
    } > HWRAM
    .func_FUN_060361B8 0x060361B8 : SUBALIGN(1)
    {
        *(.text.FUN_060361B8)
    } > HWRAM
    .func_FUN_060361BC 0x060361BC : SUBALIGN(1)
    {
        *(.text.FUN_060361BC)
    } > HWRAM
    .func_FUN_060361FC 0x060361FC : SUBALIGN(1)
    {
        *(.text.FUN_060361FC)
    } > HWRAM
    .func_FUN_06036208 0x06036208 : SUBALIGN(1)
    {
        *(.text.FUN_06036208)
    } > HWRAM
    .func_FUN_0603623E 0x0603623E : SUBALIGN(1)
    {
        *(.text.FUN_0603623E)
    } > HWRAM
    .func_FUN_06036248 0x06036248 : SUBALIGN(1)
    {
        *(.text.FUN_06036248)
    } > HWRAM
    .func_FUN_060362A8 0x060362A8 : SUBALIGN(1)
    {
        *(.text.FUN_060362A8)
    } > HWRAM
    .func_FUN_060362B0 0x060362B0 : SUBALIGN(1)
    {
        *(.text.FUN_060362B0)
    } > HWRAM
    .func_FUN_06036308 0x06036308 : SUBALIGN(1)
    {
        *(.text.FUN_06036308)
    } > HWRAM
    .func_FUN_06036310 0x06036310 : SUBALIGN(1)
    {
        *(.text.FUN_06036310)
    } > HWRAM
    .func_FUN_06036380 0x06036380 : SUBALIGN(1)
    {
        /* overflow: FUN_06036380 goes to catchall */
    } > HWRAM
    .func_FUN_06036388 0x06036388 : SUBALIGN(1)
    {
        *(.text.FUN_06036388)
    } > HWRAM
    .func_FUN_060363BC 0x060363BC : SUBALIGN(1)
    {
        *(.text.FUN_060363BC)
    } > HWRAM
    .func_FUN_060363C4 0x060363C4 : SUBALIGN(1)
    {
        *(.text.FUN_060363C4)
    } > HWRAM
    .func_FUN_06036414 0x06036414 : SUBALIGN(1)
    {
        /* overflow: FUN_06036414 goes to catchall */
    } > HWRAM
    .func_FUN_06036424 0x06036424 : SUBALIGN(1)
    {
        *(.text.FUN_06036424)
    } > HWRAM
    .func_FUN_0603646C 0x0603646C : SUBALIGN(1)
    {
        *(.text.FUN_0603646C)
    } > HWRAM
    .func_FUN_06036478 0x06036478 : SUBALIGN(1)
    {
        *(.text.FUN_06036478)
    } > HWRAM
    .func_FUN_060364D4 0x060364D4 : SUBALIGN(1)
    {
        *(.text.FUN_060364D4)
    } > HWRAM
    .func_FUN_060364DC 0x060364DC : SUBALIGN(1)
    {
        *(.text.FUN_060364DC)
    } > HWRAM
    .func_FUN_06036518 0x06036518 : SUBALIGN(1)
    {
        /* overflow: FUN_06036518 goes to catchall */
    } > HWRAM
    .func_FUN_06036524 0x06036524 : SUBALIGN(1)
    {
        *(.text.FUN_06036524)
    } > HWRAM
    .func_FUN_06036572 0x06036572 : SUBALIGN(1)
    {
        /* overflow: FUN_06036572 goes to catchall */
    } > HWRAM
    .func_FUN_06036578 0x06036578 : SUBALIGN(1)
    {
        *(.text.FUN_06036578)
    } > HWRAM
    .func_FUN_060365C4 0x060365C4 : SUBALIGN(1)
    {
        *(.text.FUN_060365C4)
    } > HWRAM
    .func_FUN_060365D0 0x060365D0 : SUBALIGN(1)
    {
        *(.text.FUN_060365D0)
    } > HWRAM
    .func_FUN_0603660E 0x0603660E : SUBALIGN(1)
    {
        *(.text.FUN_0603660E)
    } > HWRAM
    .func_FUN_06036650 0x06036650 : SUBALIGN(1)
    {
        /* overflow: FUN_06036650 goes to catchall */
    } > HWRAM
    .func_FUN_0603667E 0x0603667E : SUBALIGN(1)
    {
        *(.text.FUN_0603667E)
    } > HWRAM
    .func_FUN_06036688 0x06036688 : SUBALIGN(1)
    {
        *(.text.FUN_06036688)
    } > HWRAM
    .func_FUN_06036704 0x06036704 : SUBALIGN(1)
    {
        *(.text.FUN_06036704)
    } > HWRAM
    .func_FUN_06036710 0x06036710 : SUBALIGN(1)
    {
        *(.text.FUN_06036710)
    } > HWRAM
    .func_FUN_0603674A 0x0603674A : SUBALIGN(1)
    {
        *(.text.FUN_0603674A)
    } > HWRAM
    .func_FUN_06036754 0x06036754 : SUBALIGN(1)
    {
        *(.text.FUN_06036754)
    } > HWRAM
    .func_FUN_060367AC 0x060367AC : SUBALIGN(1)
    {
        *(.text.FUN_060367AC)
    } > HWRAM
    .func_FUN_060367B4 0x060367B4 : SUBALIGN(1)
    {
        *(.text.FUN_060367B4)
    } > HWRAM
    .func_FUN_060367E8 0x060367E8 : SUBALIGN(1)
    {
        *(.text.FUN_060367E8)
    } > HWRAM
    .func_FUN_060367F4 0x060367F4 : SUBALIGN(1)
    {
        *(.text.FUN_060367F4)
    } > HWRAM
    .func_FUN_0603683C 0x0603683C : SUBALIGN(1)
    {
        *(.text.FUN_0603683C)
    } > HWRAM
    .func_FUN_06036848 0x06036848 : SUBALIGN(1)
    {
        *(.text.FUN_06036848)
    } > HWRAM
    .func_FUN_06036886 0x06036886 : SUBALIGN(1)
    {
        *(.text.FUN_06036886)
    } > HWRAM
    .func_FUN_06036890 0x06036890 : SUBALIGN(1)
    {
        *(.text.FUN_06036890)
    } > HWRAM
    .func_FUN_060368DC 0x060368DC : SUBALIGN(1)
    {
        *(.text.FUN_060368DC)
    } > HWRAM
    .func_FUN_060368E4 0x060368E4 : SUBALIGN(1)
    {
        *(.text.FUN_060368E4)
    } > HWRAM
    .func_FUN_06036918 0x06036918 : SUBALIGN(1)
    {
        *(.text.FUN_06036918)
    } > HWRAM
    .func_FUN_06036928 0x06036928 : SUBALIGN(1)
    {
        *(.text.FUN_06036928)
    } > HWRAM
    .func_FUN_0603697C 0x0603697C : SUBALIGN(1)
    {
        *(.text.FUN_0603697C)
    } > HWRAM
    .func_FUN_0603698C 0x0603698C : SUBALIGN(1)
    {
        *(.text.FUN_0603698C)
    } > HWRAM
    .func_FUN_060369D4 0x060369D4 : SUBALIGN(1)
    {
        *(.text.FUN_060369D4)
    } > HWRAM
    .func_FUN_060369D8 0x060369D8 : SUBALIGN(1)
    {
        *(.text.FUN_060369D8)
    } > HWRAM
    .func_FUN_06036A1C 0x06036A1C : SUBALIGN(1)
    {
        *(.text.FUN_06036A1C)
    } > HWRAM
    .func_FUN_06036A24 0x06036A24 : SUBALIGN(1)
    {
        *(.text.FUN_06036A24)
    } > HWRAM
    .func_FUN_06036A54 0x06036A54 : SUBALIGN(1)
    {
        *(.text.FUN_06036A54)
    } > HWRAM
    .func_FUN_06036A5C 0x06036A5C : SUBALIGN(1)
    {
        *(.text.FUN_06036A5C)
    } > HWRAM
    .func_FUN_06036A98 0x06036A98 : SUBALIGN(1)
    {
        *(.text.FUN_06036A98)
    } > HWRAM
    .func_FUN_06036AA4 0x06036AA4 : SUBALIGN(1)
    {
        *(.text.FUN_06036AA4)
    } > HWRAM
    .func_FUN_06036AF2 0x06036AF2 : SUBALIGN(1)
    {
        *(.text.FUN_06036AF2)
    } > HWRAM
    .func_FUN_06036AF8 0x06036AF8 : SUBALIGN(1)
    {
        *(.text.FUN_06036AF8)
    } > HWRAM
    .func_FUN_06036B64 0x06036B64 : SUBALIGN(1)
    {
        *(.text.FUN_06036B64)
    } > HWRAM
    .func_FUN_06036B70 0x06036B70 : SUBALIGN(1)
    {
        *(.text.FUN_06036B70)
    } > HWRAM
    .func_FUN_06036BA6 0x06036BA6 : SUBALIGN(1)
    {
        *(.text.FUN_06036BA6)
    } > HWRAM
    .func_FUN_06036DDC 0x06036DDC : SUBALIGN(1)
    {
        *(.text.FUN_06036DDC)
    } > HWRAM
    .func_FUN_06036E90 0x06036E90 : SUBALIGN(1)
    {
        *(.text.FUN_06036E90)
    } > HWRAM
    .func_FUN_06036F0C 0x06036F0C : SUBALIGN(1)
    {
        *(.text.FUN_06036F0C)
    } > HWRAM
    .func_FUN_060370E4 0x060370E4 : SUBALIGN(1)
    {
        *(.text.FUN_060370E4)
    } > HWRAM
    .func_FUN_06037660 0x06037660 : SUBALIGN(1)
    {
        *(.text.FUN_06037660)
    } > HWRAM
    .func_FUN_0603806C 0x0603806C : SUBALIGN(1)
    {
        *(.text.FUN_0603806C)
    } > HWRAM
    .func_FUN_06038120 0x06038120 : SUBALIGN(1)
    {
        *(.text.FUN_06038120)
    } > HWRAM
    .func_FUN_06038300 0x06038300 : SUBALIGN(1)
    {
        *(.text.FUN_06038300)
    } > HWRAM
    .func_FUN_0603836C 0x0603836C : SUBALIGN(1)
    {
        *(.text.FUN_0603836C)
    } > HWRAM
    .func_FUN_0603853C 0x0603853C : SUBALIGN(1)
    {
        *(.text.FUN_0603853C)
    } > HWRAM
    .func_FUN_06038642 0x06038642 : SUBALIGN(1)
    {
        *(.text.FUN_06038642)
    } > HWRAM
    .func_FUN_06038794 0x06038794 : SUBALIGN(1)
    {
        *(.text.FUN_06038794)
    } > HWRAM
    .func_FUN_060388C0 0x060388C0 : SUBALIGN(1)
    {
        *(.text.FUN_060388C0)
    } > HWRAM
    .func_FUN_060389A6 0x060389A6 : SUBALIGN(1)
    {
        *(.text.FUN_060389A6)
    } > HWRAM
    .func_FUN_06038AC8 0x06038AC8 : SUBALIGN(1)
    {
        *(.text.FUN_06038AC8)
    } > HWRAM
    .func_FUN_06038BD4 0x06038BD4 : SUBALIGN(1)
    {
        *(.text.FUN_06038BD4)
    } > HWRAM
    .func_FUN_06038E54 0x06038E54 : SUBALIGN(1)
    {
        *(.text.FUN_06038E54)
    } > HWRAM
    .func_FUN_06038F6C 0x06038F6C : SUBALIGN(1)
    {
        *(.text.FUN_06038F6C)
    } > HWRAM
    .func_FUN_06038F78 0x06038F78 : SUBALIGN(1)
    {
        *(.text.FUN_06038F78)
    } > HWRAM
    .func_FUN_06039050 0x06039050 : SUBALIGN(1)
    {
        *(.text.FUN_06039050)
    } > HWRAM
    .func_FUN_06039100 0x06039100 : SUBALIGN(1)
    {
        *(.text.FUN_06039100)
    } > HWRAM
    .func_FUN_06039250 0x06039250 : SUBALIGN(1)
    {
        *(.text.FUN_06039250)
    } > HWRAM
    .func_FUN_0603931C 0x0603931C : SUBALIGN(1)
    {
        *(.text.FUN_0603931C)
    } > HWRAM
    .func_FUN_0603950C 0x0603950C : SUBALIGN(1)
    {
        *(.text.FUN_0603950C)
    } > HWRAM
    .func_FUN_06039808 0x06039808 : SUBALIGN(1)
    {
        *(.text.FUN_06039808)
    } > HWRAM
    .func_FUN_0603990E 0x0603990E : SUBALIGN(1)
    {
        *(.text.FUN_0603990E)
    } > HWRAM
    .func_FUN_0603A01C 0x0603A01C : SUBALIGN(1)
    {
        *(.text.FUN_0603A01C)
    } > HWRAM
    .func_FUN_0603A0B0 0x0603A0B0 : SUBALIGN(1)
    {
        *(.text.FUN_0603A0B0)
    } > HWRAM
    .func_FUN_0603A766 0x0603A766 : SUBALIGN(1)
    {
        *(.text.FUN_0603A766)
    } > HWRAM
    .func_FUN_0603A7B0 0x0603A7B0 : SUBALIGN(1)
    {
        *(.text.FUN_0603A7B0)
    } > HWRAM
    .func_FUN_0603AA82 0x0603AA82 : SUBALIGN(1)
    {
        *(.text.FUN_0603AA82)
    } > HWRAM
    .func_FUN_0603AC1C 0x0603AC1C : SUBALIGN(1)
    {
        *(.text.FUN_0603AC1C)
    } > HWRAM
    .func_FUN_0603ACEA 0x0603ACEA : SUBALIGN(1)
    {
        *(.text.FUN_0603ACEA)
    } > HWRAM
    .func_FUN_0603ADAC 0x0603ADAC : SUBALIGN(1)
    {
        *(.text.FUN_0603ADAC)
    } > HWRAM
    .func_FUN_0603AE08 0x0603AE08 : SUBALIGN(1)
    {
        *(.text.FUN_0603AE08)
    } > HWRAM
    .func_FUN_0603AE74 0x0603AE74 : SUBALIGN(1)
    {
        *(.text.FUN_0603AE74)
    } > HWRAM
    .func_FUN_0603AEE8 0x0603AEE8 : SUBALIGN(1)
    {
        *(.text.FUN_0603AEE8)
    } > HWRAM
    .func_FUN_0603AF94 0x0603AF94 : SUBALIGN(1)
    {
        *(.text.FUN_0603AF94)
    } > HWRAM
    .func_FUN_0603AFD0 0x0603AFD0 : SUBALIGN(1)
    {
        *(.text.FUN_0603AFD0)
    } > HWRAM
    .func_FUN_0603AFDC 0x0603AFDC : SUBALIGN(1)
    {
        *(.text.FUN_0603AFDC)
    } > HWRAM
    .func_FUN_0603B058 0x0603B058 : SUBALIGN(1)
    {
        *(.text.FUN_0603B058)
    } > HWRAM
    .func_FUN_0603B08E 0x0603B08E : SUBALIGN(1)
    {
        *(.text.FUN_0603B08E)
    } > HWRAM
    .func_FUN_0603B0C0 0x0603B0C0 : SUBALIGN(1)
    {
        *(.text.FUN_0603B0C0)
    } > HWRAM
    .func_FUN_0603B118 0x0603B118 : SUBALIGN(1)
    {
        *(.text.FUN_0603B118)
    } > HWRAM
    .func_FUN_0603B11C 0x0603B11C : SUBALIGN(1)
    {
        *(.text.FUN_0603B11C)
    } > HWRAM
    .func_FUN_0603B130 0x0603B130 : SUBALIGN(1)
    {
        *(.text.FUN_0603B130)
    } > HWRAM
    .func_FUN_0603B168 0x0603B168 : SUBALIGN(1)
    {
        *(.text.FUN_0603B168)
    } > HWRAM
    .func_FUN_0603B1B6 0x0603B1B6 : SUBALIGN(1)
    {
        *(.text.FUN_0603B1B6)
    } > HWRAM
    .func_FUN_0603B21C 0x0603B21C : SUBALIGN(1)
    {
        *(.text.FUN_0603B21C)
    } > HWRAM
    .func_FUN_0603B290 0x0603B290 : SUBALIGN(1)
    {
        *(.text.FUN_0603B290)
    } > HWRAM
    .func_FUN_0603B31C 0x0603B31C : SUBALIGN(1)
    {
        *(.text.FUN_0603B31C)
    } > HWRAM
    .func_FUN_0603B324 0x0603B324 : SUBALIGN(1)
    {
        *(.text.FUN_0603B324)
    } > HWRAM
    .func_FUN_0603B392 0x0603B392 : SUBALIGN(1)
    {
        *(.text.FUN_0603B392)
    } > HWRAM
    .func_FUN_0603B3CA 0x0603B3CA : SUBALIGN(1)
    {
        *(.text.FUN_0603B3CA)
    } > HWRAM
    .func_FUN_0603B3D0 0x0603B3D0 : SUBALIGN(1)
    {
        *(.text.FUN_0603B3D0)
    } > HWRAM
    .func_FUN_0603B3FE 0x0603B3FE : SUBALIGN(1)
    {
        *(.text.FUN_0603B3FE)
    } > HWRAM
    .func_FUN_0603B424 0x0603B424 : SUBALIGN(1)
    {
        *(.text.FUN_0603B424)
    } > HWRAM
    .func_FUN_0603B53C 0x0603B53C : SUBALIGN(1)
    {
        *(.text.FUN_0603B53C)
    } > HWRAM
    .func_FUN_0603B598 0x0603B598 : SUBALIGN(1)
    {
        *(.text.FUN_0603B598)
    } > HWRAM
    .func_FUN_0603B5D0 0x0603B5D0 : SUBALIGN(1)
    {
        *(.text.FUN_0603B5D0)
    } > HWRAM
    .func_FUN_0603B5F2 0x0603B5F2 : SUBALIGN(1)
    {
        *(.text.FUN_0603B5F2)
    } > HWRAM
    .func_FUN_0603B60C 0x0603B60C : SUBALIGN(1)
    {
        *(.text.FUN_0603B60C)
    } > HWRAM
    .func_FUN_0603B630 0x0603B630 : SUBALIGN(1)
    {
        *(.text.FUN_0603B630)
    } > HWRAM
    .func_FUN_0603B634 0x0603B634 : SUBALIGN(1)
    {
        *(.text.FUN_0603B634)
    } > HWRAM
    .func_FUN_0603B680 0x0603B680 : SUBALIGN(1)
    {
        *(.text.FUN_0603B680)
    } > HWRAM
    .func_FUN_0603B6A8 0x0603B6A8 : SUBALIGN(1)
    {
        *(.text.FUN_0603B6A8)
    } > HWRAM
    .func_FUN_0603B74C 0x0603B74C : SUBALIGN(1)
    {
        *(.text.FUN_0603B74C)
    } > HWRAM
    .func_FUN_0603B7C0 0x0603B7C0 : SUBALIGN(1)
    {
        *(.text.FUN_0603B7C0)
    } > HWRAM
    .func_FUN_0603B8B4 0x0603B8B4 : SUBALIGN(1)
    {
        *(.text.FUN_0603B8B4)
    } > HWRAM
    .func_FUN_0603B92C 0x0603B92C : SUBALIGN(1)
    {
        *(.text.FUN_0603B92C)
    } > HWRAM
    .func_FUN_0603B93C 0x0603B93C : SUBALIGN(1)
    {
        *(.text.FUN_0603B93C)
    } > HWRAM
    .func_FUN_0603B9A4 0x0603B9A4 : SUBALIGN(1)
    {
        *(.text.FUN_0603B9A4)
    } > HWRAM
    .func_FUN_0603B9D6 0x0603B9D6 : SUBALIGN(1)
    {
        *(.text.FUN_0603B9D6)
    } > HWRAM
    .func_FUN_0603BA2C 0x0603BA2C : SUBALIGN(1)
    {
        *(.text.FUN_0603BA2C)
    } > HWRAM
    .func_FUN_0603BAC6 0x0603BAC6 : SUBALIGN(1)
    {
        *(.text.FUN_0603BAC6)
    } > HWRAM
    .func_FUN_0603BB86 0x0603BB86 : SUBALIGN(1)
    {
        *(.text.FUN_0603BB86)
    } > HWRAM
    .func_FUN_0603BC12 0x0603BC12 : SUBALIGN(1)
    {
        *(.text.FUN_0603BC12)
    } > HWRAM
    .func_FUN_0603BC86 0x0603BC86 : SUBALIGN(1)
    {
        *(.text.FUN_0603BC86)
    } > HWRAM
    .func_FUN_0603BD1C 0x0603BD1C : SUBALIGN(1)
    {
        *(.text.FUN_0603BD1C)
    } > HWRAM
    .func_FUN_0603BDAC 0x0603BDAC : SUBALIGN(1)
    {
        *(.text.FUN_0603BDAC)
    } > HWRAM
    .func_FUN_0603BE9C 0x0603BE9C : SUBALIGN(1)
    {
        *(.text.FUN_0603BE9C)
    } > HWRAM
    .func_FUN_0603BEB8 0x0603BEB8 : SUBALIGN(1)
    {
        *(.text.FUN_0603BEB8)
    } > HWRAM
    .func_FUN_0603BF22 0x0603BF22 : SUBALIGN(1)
    {
        *(.text.FUN_0603BF22)
    } > HWRAM
    .func_FUN_0603C104 0x0603C104 : SUBALIGN(1)
    {
        *(.text.FUN_0603C104)
    } > HWRAM
    .func_FUN_0603C10C 0x0603C10C : SUBALIGN(1)
    {
        *(.text.FUN_0603C10C)
    } > HWRAM
    .func_FUN_0603C1A8 0x0603C1A8 : SUBALIGN(1)
    {
        *(.text.FUN_0603C1A8)
    } > HWRAM
    .func_FUN_0603C728 0x0603C728 : SUBALIGN(1)
    {
        *(.text.FUN_0603C728)
    } > HWRAM
    .func_FUN_0603CC88 0x0603CC88 : SUBALIGN(1)
    {
        *(.text.FUN_0603CC88)
    } > HWRAM
    .func_FUN_0603CD5C 0x0603CD5C : SUBALIGN(1)
    {
        *(.text.FUN_0603CD5C)
    } > HWRAM
    .func_FUN_0603D2CC 0x0603D2CC : SUBALIGN(1)
    {
        *(.text.FUN_0603D2CC)
    } > HWRAM
    .func_FUN_0603D2D0 0x0603D2D0 : SUBALIGN(1)
    {
        *(.text.FUN_0603D2D0)
    } > HWRAM
    .func_FUN_0603D3A8 0x0603D3A8 : SUBALIGN(1)
    {
        *(.text.FUN_0603D3A8)
    } > HWRAM
    .func_FUN_0603D438 0x0603D438 : SUBALIGN(1)
    {
        *(.text.FUN_0603D438)
    } > HWRAM
    .func_FUN_0603D43C 0x0603D43C : SUBALIGN(1)
    {
        *(.text.FUN_0603D43C)
    } > HWRAM
    .func_FUN_0603D514 0x0603D514 : SUBALIGN(1)
    {
        *(.text.FUN_0603D514)
    } > HWRAM
    .func_FUN_0603D518 0x0603D518 : SUBALIGN(1)
    {
        *(.text.FUN_0603D518)
    } > HWRAM
    .func_FUN_0603D5D0 0x0603D5D0 : SUBALIGN(1)
    {
        *(.text.FUN_0603D5D0)
    } > HWRAM
    .func_FUN_0603D7B0 0x0603D7B0 : SUBALIGN(1)
    {
        *(.text.FUN_0603D7B0)
    } > HWRAM
    .func_FUN_0603D9EC 0x0603D9EC : SUBALIGN(1)
    {
        *(.text.FUN_0603D9EC)
    } > HWRAM
    .func_FUN_0603DA88 0x0603DA88 : SUBALIGN(1)
    {
        *(.text.FUN_0603DA88)
    } > HWRAM
    .func_FUN_0603DB28 0x0603DB28 : SUBALIGN(1)
    {
        *(.text.FUN_0603DB28)
    } > HWRAM
    .func_FUN_0603DDFC 0x0603DDFC : SUBALIGN(1)
    {
        *(.text.FUN_0603DDFC)
    } > HWRAM
    .func_FUN_0603E050 0x0603E050 : SUBALIGN(1)
    {
        *(.text.FUN_0603E050)
    } > HWRAM
    .func_FUN_0603E5BC 0x0603E5BC : SUBALIGN(1)
    {
        *(.text.FUN_0603E5BC)
    } > HWRAM
    .func_FUN_0603EACC 0x0603EACC : SUBALIGN(1)
    {
        *(.text.FUN_0603EACC)
    } > HWRAM
    .func_FUN_0603EC40 0x0603EC40 : SUBALIGN(1)
    {
        *(.text.FUN_0603EC40)
    } > HWRAM
    .func_FUN_0603EF64 0x0603EF64 : SUBALIGN(1)
    {
        *(.text.FUN_0603EF64)
    } > HWRAM
    .func_FUN_0603F0FC 0x0603F0FC : SUBALIGN(1)
    {
        *(.text.FUN_0603F0FC)
    } > HWRAM
    .func_FUN_0603F148 0x0603F148 : SUBALIGN(1)
    {
        *(.text.FUN_0603F148)
    } > HWRAM
    .func_FUN_0603F238 0x0603F238 : SUBALIGN(1)
    {
        *(.text.FUN_0603F238)
    } > HWRAM
    .func_FUN_0603F244 0x0603F244 : SUBALIGN(1)
    {
        *(.text.FUN_0603F244)
    } > HWRAM
    .func_FUN_0603F2E0 0x0603F2E0 : SUBALIGN(1)
    {
        *(.text.FUN_0603F2E0)
    } > HWRAM
    .func_FUN_0603F2EC 0x0603F2EC : SUBALIGN(1)
    {
        *(.text.FUN_0603F2EC)
    } > HWRAM
    .func_FUN_0603F342 0x0603F342 : SUBALIGN(1)
    {
        *(.text.FUN_0603F342)
    } > HWRAM
    .func_FUN_0603F354 0x0603F354 : SUBALIGN(1)
    {
        *(.text.FUN_0603F354)
    } > HWRAM
    .func_FUN_0603F3F6 0x0603F3F6 : SUBALIGN(1)
    {
        *(.text.FUN_0603F3F6)
    } > HWRAM
    .func_FUN_0603F4B0 0x0603F4B0 : SUBALIGN(1)
    {
        *(.text.FUN_0603F4B0)
    } > HWRAM
    .func_FUN_0603F4CC 0x0603F4CC : SUBALIGN(1)
    {
        /* overflow: FUN_0603F4CC goes to catchall */
    } > HWRAM
    .func_FUN_0603F4E0 0x0603F4E0 : SUBALIGN(1)
    {
        *(.text.FUN_0603F4E0)
    } > HWRAM
    .func_FUN_0603F500 0x0603F500 : SUBALIGN(1)
    {
        *(.text.FUN_0603F500)
    } > HWRAM
    .func_FUN_0603F520 0x0603F520 : SUBALIGN(1)
    {
        /* overflow: FUN_0603F520 goes to catchall */
    } > HWRAM
    .func_FUN_0603F534 0x0603F534 : SUBALIGN(1)
    {
        *(.text.FUN_0603F534)
    } > HWRAM
    .func_FUN_0603F538 0x0603F538 : SUBALIGN(1)
    {
        *(.text.FUN_0603F538)
    } > HWRAM
    .func_FUN_0603F582 0x0603F582 : SUBALIGN(1)
    {
        *(.text.FUN_0603F582)
    } > HWRAM
    .func_FUN_0603F93C 0x0603F93C : SUBALIGN(1)
    {
        *(.text.FUN_0603F93C)
    } > HWRAM
    .func_FUN_0603F948 0x0603F948 : SUBALIGN(1)
    {
        *(.text.FUN_0603F948)
    } > HWRAM
    .func_FUN_0603F970 0x0603F970 : SUBALIGN(1)
    {
        *(.text.FUN_0603F970)
    } > HWRAM
    .func_FUN_0603F974 0x0603F974 : SUBALIGN(1)
    {
        *(.text.FUN_0603F974)
    } > HWRAM
    .func_FUN_0603F9B8 0x0603F9B8 : SUBALIGN(1)
    {
        /* overflow: FUN_0603F9B8 goes to catchall */
    } > HWRAM
    .func_FUN_0603F9BC 0x0603F9BC : SUBALIGN(1)
    {
        *(.text.FUN_0603F9BC)
    } > HWRAM
    .func_FUN_0603FA1A 0x0603FA1A : SUBALIGN(1)
    {
        *(.text.FUN_0603FA1A)
    } > HWRAM
    .func_FUN_0603FACE 0x0603FACE : SUBALIGN(1)
    {
        *(.text.FUN_0603FACE)
    } > HWRAM
    .func_FUN_0603FAE4 0x0603FAE4 : SUBALIGN(1)
    {
        *(.text.FUN_0603FAE4)
    } > HWRAM
    .func_FUN_0603FC60 0x0603FC60 : SUBALIGN(1)
    {
        *(.text.FUN_0603FC60)
    } > HWRAM
    .func_FUN_0603FCE4 0x0603FCE4 : SUBALIGN(1)
    {
        *(.text.FUN_0603FCE4)
    } > HWRAM
    .func_FUN_0603FD40 0x0603FD40 : SUBALIGN(1)
    {
        *(.text.FUN_0603FD40)
    } > HWRAM
    .func_FUN_0603FE44 0x0603FE44 : SUBALIGN(1)
    {
        *(.text.FUN_0603FE44)
    } > HWRAM
    .func_FUN_0603FE62 0x0603FE62 : SUBALIGN(1)
    {
        *(.text.FUN_0603FE62)
    } > HWRAM
    .func_FUN_0603FE80 0x0603FE80 : SUBALIGN(1)
    {
        *(.text.FUN_0603FE80)
    } > HWRAM
    .func_FUN_0603FF3A 0x0603FF3A : SUBALIGN(1)
    {
        *(.text.FUN_0603FF3A)
    } > HWRAM
    .func_FUN_0603FF9C 0x0603FF9C : SUBALIGN(1)
    {
        *(.text.FUN_0603FF9C)
    } > HWRAM
    .func_FUN_0604000C 0x0604000C : SUBALIGN(1)
    {
        *(.text.FUN_0604000C)
    } > HWRAM
    .func_FUN_06040010 0x06040010 : SUBALIGN(1)
    {
        *(.text.FUN_06040010)
    } > HWRAM
    .func_FUN_060400D6 0x060400D6 : SUBALIGN(1)
    {
        *(.text.FUN_060400D6)
    } > HWRAM
    .func_FUN_060401F8 0x060401F8 : SUBALIGN(1)
    {
        *(.text.FUN_060401F8)
    } > HWRAM
    .func_FUN_060401FC 0x060401FC : SUBALIGN(1)
    {
        *(.text.FUN_060401FC)
    } > HWRAM
    .func_FUN_060402BC 0x060402BC : SUBALIGN(1)
    {
        *(.text.FUN_060402BC)
    } > HWRAM
    .func_FUN_0604053A 0x0604053A : SUBALIGN(1)
    {
        *(.text.FUN_0604053A)
    } > HWRAM
    .func_FUN_060405B8 0x060405B8 : SUBALIGN(1)
    {
        *(.text.FUN_060405B8)
    } > HWRAM
    .func_FUN_06040668 0x06040668 : SUBALIGN(1)
    {
        *(.text.FUN_06040668)
    } > HWRAM
    .func_FUN_06040680 0x06040680 : SUBALIGN(1)
    {
        *(.text.FUN_06040680)
    } > HWRAM
    .func_FUN_060406B4 0x060406B4 : SUBALIGN(1)
    {
        *(.text.FUN_060406B4)
    } > HWRAM
    .func_FUN_060406BC 0x060406BC : SUBALIGN(1)
    {
        *(.text.FUN_060406BC)
    } > HWRAM
    .func_FUN_06040724 0x06040724 : SUBALIGN(1)
    {
        *(.text.FUN_06040724)
    } > HWRAM
    .func_FUN_0604077C 0x0604077C : SUBALIGN(1)
    {
        *(.text.FUN_0604077C)
    } > HWRAM
    .func_FUN_0604087C 0x0604087C : SUBALIGN(1)
    {
        *(.text.FUN_0604087C)
    } > HWRAM
    .func_FUN_060408B0 0x060408B0 : SUBALIGN(1)
    {
        *(.text.FUN_060408B0)
    } > HWRAM
    .func_FUN_06040954 0x06040954 : SUBALIGN(1)
    {
        /* overflow: FUN_06040954 goes to catchall */
    } > HWRAM
    .func_FUN_06040964 0x06040964 : SUBALIGN(1)
    {
        *(.text.FUN_06040964)
    } > HWRAM
    .func_FUN_0604097C 0x0604097C : SUBALIGN(1)
    {
        *(.text.FUN_0604097C)
    } > HWRAM
    .func_FUN_06040980 0x06040980 : SUBALIGN(1)
    {
        *(.text.FUN_06040980)
    } > HWRAM
    .func_FUN_060409C8 0x060409C8 : SUBALIGN(1)
    {
        *(.text.FUN_060409C8)
    } > HWRAM
    .func_FUN_060409E6 0x060409E6 : SUBALIGN(1)
    {
        *(.text.FUN_060409E6)
    } > HWRAM
    .func_FUN_06040AF8 0x06040AF8 : SUBALIGN(1)
    {
        *(.text.FUN_06040AF8)
    } > HWRAM
    .func_FUN_06040B34 0x06040B34 : SUBALIGN(1)
    {
        *(.text.FUN_06040B34)
    } > HWRAM
    .func_FUN_06040B8E 0x06040B8E : SUBALIGN(1)
    {
        *(.text.FUN_06040B8E)
    } > HWRAM
    .func_FUN_06040B90 0x06040B90 : SUBALIGN(1)
    {
        *(.text.FUN_06040B90)
    } > HWRAM
    .func_FUN_06040C10 0x06040C10 : SUBALIGN(1)
    {
        *(.text.FUN_06040C10)
    } > HWRAM
    .func_FUN_06040C5C 0x06040C5C : SUBALIGN(1)
    {
        *(.text.FUN_06040C5C)
    } > HWRAM
    .func_FUN_06040C60 0x06040C60 : SUBALIGN(1)
    {
        *(.text.FUN_06040C60)
    } > HWRAM
    .func_FUN_06040C98 0x06040C98 : SUBALIGN(1)
    {
        *(.text.FUN_06040C98)
    } > HWRAM
    .func_FUN_06040F16 0x06040F16 : SUBALIGN(1)
    {
        *(.text.FUN_06040F16)
    } > HWRAM
    .func_FUN_06040F1C 0x06040F1C : SUBALIGN(1)
    {
        *(.text.FUN_06040F1C)
    } > HWRAM
    .func_FUN_06040F82 0x06040F82 : SUBALIGN(1)
    {
        *(.text.FUN_06040F82)
    } > HWRAM
    .func_FUN_06041034 0x06041034 : SUBALIGN(1)
    {
        *(.text.FUN_06041034)
    } > HWRAM
    .func_FUN_060410CA 0x060410CA : SUBALIGN(1)
    {
        *(.text.FUN_060410CA)
    } > HWRAM
    .func_FUN_06041128 0x06041128 : SUBALIGN(1)
    {
        *(.text.FUN_06041128)
    } > HWRAM
    .func_FUN_06041180 0x06041180 : SUBALIGN(1)
    {
        *(.text.trampoline_FUN_06041180)
    } > HWRAM
    .func_FUN_060411A0 0x060411A0 : SUBALIGN(1)
    {
        *(.text.FUN_060411A0)
    } > HWRAM
    .func_FUN_06041204 0x06041204 : SUBALIGN(1)
    {
        /* overflow: FUN_06041204 goes to catchall */
    } > HWRAM
    .func_FUN_06041258 0x06041258 : SUBALIGN(1)
    {
        *(.text.FUN_06041258)
    } > HWRAM
    .func_FUN_060412B2 0x060412B2 : SUBALIGN(1)
    {
        *(.text.FUN_060412B2)
    } > HWRAM
    .func_FUN_06041330 0x06041330 : SUBALIGN(1)
    {
        /* overflow: FUN_06041330 goes to catchall */
    } > HWRAM
    .func_FUN_0604134E 0x0604134E : SUBALIGN(1)
    {
        *(.text.FUN_0604134E)
    } > HWRAM
    .func_FUN_06041382 0x06041382 : SUBALIGN(1)
    {
        *(.text.FUN_06041382)
    } > HWRAM
    .func_FUN_0604140E 0x0604140E : SUBALIGN(1)
    {
        *(.text.FUN_0604140E)
    } > HWRAM
    .func_FUN_06041470 0x06041470 : SUBALIGN(1)
    {
        *(.text.FUN_06041470)
    } > HWRAM
    .func_FUN_060414D0 0x060414D0 : SUBALIGN(1)
    {
        *(.text.FUN_060414D0)
    } > HWRAM
    .func_FUN_060415C8 0x060415C8 : SUBALIGN(1)
    {
        *(.text.FUN_060415C8)
    } > HWRAM
    .func_FUN_06041648 0x06041648 : SUBALIGN(1)
    {
        *(.text.FUN_06041648)
    } > HWRAM
    .func_FUN_06041698 0x06041698 : SUBALIGN(1)
    {
        *(.text.trampoline_FUN_06041698)
    } > HWRAM
    .func_FUN_060416A8 0x060416A8 : SUBALIGN(1)
    {
        *(.text.FUN_060416A8)
    } > HWRAM
    .func_FUN_06041826 0x06041826 : SUBALIGN(1)
    {
        /* overflow: FUN_06041826 goes to catchall */
    } > HWRAM
    .func_FUN_0604188C 0x0604188C : SUBALIGN(1)
    {
        *(.text.FUN_0604188C)
    } > HWRAM
    .func_FUN_060418BE 0x060418BE : SUBALIGN(1)
    {
        *(.text.FUN_060418BE)
    } > HWRAM
    .func_FUN_06041AA0 0x06041AA0 : SUBALIGN(1)
    {
        *(.text.FUN_06041AA0)
    } > HWRAM
    .func_FUN_06041B3C 0x06041B3C : SUBALIGN(1)
    {
        *(.text.FUN_06041B3C)
    } > HWRAM
    .func_FUN_06041CC8 0x06041CC8 : SUBALIGN(1)
    {
        *(.text.FUN_06041CC8)
    } > HWRAM
    .func_FUN_06041D6C 0x06041D6C : SUBALIGN(1)
    {
        *(.text.FUN_06041D6C)
    } > HWRAM
    .func_FUN_06041D74 0x06041D74 : SUBALIGN(1)
    {
        *(.text.FUN_06041D74)
    } > HWRAM
    .func_FUN_06041EE8 0x06041EE8 : SUBALIGN(1)
    {
        *(.text.FUN_06041EE8)
    } > HWRAM
    .func_FUN_06042088 0x06042088 : SUBALIGN(1)
    {
        *(.text.FUN_06042088)
    } > HWRAM
    .func_FUN_06042134 0x06042134 : SUBALIGN(1)
    {
        *(.text.FUN_06042134)
    } > HWRAM
    .func_FUN_060422F0 0x060422F0 : SUBALIGN(1)
    {
        *(.text.FUN_060422F0)
    } > HWRAM
    .func_FUN_060423A0 0x060423A0 : SUBALIGN(1)
    {
        *(.text.FUN_060423A0)
    } > HWRAM
    .func_FUN_060423CC 0x060423CC : SUBALIGN(1)
    {
        *(.text.FUN_060423CC)
    } > HWRAM
    .func_FUN_06042418 0x06042418 : SUBALIGN(1)
    {
        *(.text.FUN_06042418)
    } > HWRAM
    .func_FUN_06042458 0x06042458 : SUBALIGN(1)
    {
        *(.text.FUN_06042458)
    } > HWRAM
    .func_FUN_06042634 0x06042634 : SUBALIGN(1)
    {
        *(.text.FUN_06042634)
    } > HWRAM
    .func_FUN_06042646 0x06042646 : SUBALIGN(1)
    {
        *(.text.FUN_06042646)
    } > HWRAM
    .func_FUN_060429EC 0x060429EC : SUBALIGN(1)
    {
        *(.text.FUN_060429EC)
    } > HWRAM
    .func_FUN_06046E48 0x06046E48 : SUBALIGN(1)
    {
        *(.text.FUN_06046E48)
    } > HWRAM

    /* Overflow area for C functions that exceed their original slot */
    .text.overflow :
    {
        *(.text.overflow)
        *(.text.*)
        *(.text)
    } > HWRAM

    .rodata :
    {
        *(.rodata .rodata.*)
    } > HWRAM

    .data :
    {
        *(.data .data.*)
    } > HWRAM

    .bss :
    {
        __bss_start = .;
        *(.bss .bss.*)
        *(COMMON)
        __bss_end = .;
    } > HWRAM

    _end = .;

    /DISCARD/ :
    {
        *(.comment)
        *(.note.*)
        *(.eh_frame)
    }
}
