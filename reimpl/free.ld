/* free.ld -- Free-layout reimplementation linker script (default)
 *
 * Functions can change size without breaking the binary.
 * Optional padding (--defsym __pad_size=N) shifts all FUN_ addresses,
 * validating that every pointer is properly relocated via symbols.
 * Default: no padding. Use `make disc-4shift` to test with +4 shift.
 *
 * No FUN_ PROVIDEs — functions define their own .global labels and are
 * placed by SORT_BY_NAME, so recompiled functions slot in naturally.
 * DAT_/sym_ PROVIDEs: within-binary ones are FUN_-relative (shift correctly).
 * Runtime WRAM ones (>= 0x06063690) are absolute — they're not in the binary.
 */

OUTPUT_FORMAT("elf32-sh")
OUTPUT_ARCH(sh)
ENTRY(_start)

/* Default: no padding. Override with --defsym __pad_size=N */
PROVIDE(__pad_size = 0);

SECTIONS
{
    . = 0x06003000;
    .text : {
        *(.text.startup)
        . = . + __pad_size;
        *(SORT_BY_NAME(.text.FUN_*))
    }

    /DISCARD/ : {
        *(.comment)
        *(.note.*)
        *(.eh_frame)
    }
}
/* DAT_ symbols (1341) */
PROVIDE(DAT_060024d6 = 0x060024D6);
PROVIDE(DAT_06002554 = 0x06002554);
PROVIDE(DAT_06002556 = 0x06002556);
PROVIDE(DAT_060025c6 = 0x060025C6);
PROVIDE(DAT_060026aa = 0x060026AA);
PROVIDE(DAT_060026ac = 0x060026AC);
PROVIDE(DAT_060026ae = 0x060026AE);
PROVIDE(DAT_060026b0 = 0x060026B0);
PROVIDE(DAT_060026b2 = 0x060026B2);
PROVIDE(DAT_06003366 = FUN_0600330A + 0x5C);
PROVIDE(DAT_06003368 = FUN_0600330A + 0x5E);
PROVIDE(DAT_0600336c = FUN_0600330A + 0x62);
PROVIDE(DAT_0600336e = FUN_0600330A + 0x64);
PROVIDE(DAT_06003370 = FUN_0600330A + 0x66);
PROVIDE(DAT_06003372 = FUN_0600330A + 0x68);
PROVIDE(DAT_06003374 = FUN_0600330A + 0x6A);
PROVIDE(DAT_06003376 = FUN_0600330A + 0x6C);
PROVIDE(DAT_06003406 = FUN_0600330A + 0xFC);
PROVIDE(DAT_06003408 = FUN_0600330A + 0xFE);
PROVIDE(DAT_0600340c = FUN_0600330A + 0x102);
PROVIDE(DAT_06003620 = FUN_06003578 + 0xA8);
PROVIDE(DAT_06003622 = FUN_06003578 + 0xAA);
PROVIDE(DAT_06003624 = FUN_06003578 + 0xAC);
PROVIDE(DAT_06003628 = FUN_06003578 + 0xB0);
PROVIDE(DAT_0600362c = FUN_06003578 + 0xB4);
PROVIDE(DAT_06003630 = FUN_06003578 + 0xB8);
PROVIDE(DAT_06003774 = FUN_06003578 + 0x1FC);
PROVIDE(DAT_06003776 = FUN_06003578 + 0x1FE);
PROVIDE(DAT_06003778 = FUN_06003578 + 0x200);
PROVIDE(DAT_0600377a = FUN_06003578 + 0x202);
PROVIDE(DAT_0600377c = FUN_06003578 + 0x204);
PROVIDE(DAT_0600377e = FUN_06003578 + 0x206);
PROVIDE(DAT_06003782 = FUN_06003578 + 0x20A);
PROVIDE(DAT_06003784 = FUN_06003578 + 0x20C);
PROVIDE(DAT_0600378c = FUN_06003578 + 0x214);
PROVIDE(DAT_0600378e = FUN_06003578 + 0x216);
PROVIDE(DAT_06003884 = FUN_06003578 + 0x30C);
PROVIDE(DAT_0600388a = FUN_06003578 + 0x312);
PROVIDE(DAT_0600388c = FUN_06003578 + 0x314);
PROVIDE(DAT_0600388e = FUN_06003578 + 0x316);
PROVIDE(DAT_06003ade = FUN_06003A3C + 0xA2);
PROVIDE(DAT_06003c1a = FUN_06003A3C + 0x1DE);
PROVIDE(DAT_06003d36 = FUN_06003A3C + 0x2FA);
PROVIDE(DAT_06003d3a = FUN_06003A3C + 0x2FE);
PROVIDE(DAT_060040a0 = FUN_06003A3C + 0x664);
PROVIDE(DAT_060040a2 = FUN_06003A3C + 0x666);
PROVIDE(DAT_060041c2 = FUN_06003A3C + 0x786);
PROVIDE(DAT_060041c4 = FUN_06003A3C + 0x788);
PROVIDE(DAT_06004610 = FUN_06003A3C + 0xBD4);
PROVIDE(DAT_06004612 = FUN_06003A3C + 0xBD6);
PROVIDE(DAT_060047d2 = FUN_06004670 + 0x162);
PROVIDE(DAT_060047d4 = FUN_06004670 + 0x164);
PROVIDE(DAT_0600498a = FUN_06004670 + 0x31A);
PROVIDE(DAT_0600498c = FUN_06004670 + 0x31C);
PROVIDE(DAT_0600498e = FUN_06004670 + 0x31E);
PROVIDE(DAT_06004a88 = FUN_06004670 + 0x418);
PROVIDE(DAT_06004a8a = FUN_06004670 + 0x41A);
PROVIDE(DAT_06004a8c = FUN_06004670 + 0x41C);
PROVIDE(DAT_060052f6 = FUN_06005294 + 0x62);
PROVIDE(DAT_0600537a = FUN_06005294 + 0xE6);
PROVIDE(DAT_0600590e = frame_dispatch + 0x14);
PROVIDE(DAT_06005910 = frame_dispatch + 0x16);
PROVIDE(DAT_060059da = FUN_06005928 + 0xB2);
PROVIDE(DAT_060059dc = FUN_06005928 + 0xB4);
PROVIDE(DAT_060059de = FUN_06005928 + 0xB6);
PROVIDE(DAT_060059e0 = FUN_06005928 + 0xB8);
PROVIDE(DAT_060059e2 = FUN_06005928 + 0xBA);
PROVIDE(DAT_060059e4 = FUN_06005928 + 0xBC);
PROVIDE(DAT_060059e6 = FUN_06005928 + 0xBE);
PROVIDE(DAT_06005abc = FUN_06005A22 + 0x9A);
PROVIDE(DAT_06005abe = FUN_06005A22 + 0x9C);
PROVIDE(DAT_06005ac0 = FUN_06005A22 + 0x9E);
PROVIDE(DAT_06005b7c = FUN_06005AE8 + 0x94);
PROVIDE(DAT_06005b80 = FUN_06005AE8 + 0x98);
PROVIDE(DAT_06005b82 = FUN_06005AE8 + 0x9A);
PROVIDE(DAT_06005b84 = FUN_06005AE8 + 0x9C);
PROVIDE(DAT_06005b88 = FUN_06005AE8 + 0xA0);
PROVIDE(DAT_06005b8a = FUN_06005AE8 + 0xA2);
PROVIDE(DAT_06005c74 = FUN_06005AE8 + 0x18C);
PROVIDE(DAT_06005c76 = FUN_06005AE8 + 0x18E);
PROVIDE(DAT_06005d3e = FUN_06005C98 + 0xA6);
PROVIDE(DAT_06005dcc = FUN_06005C98 + 0x134);
PROVIDE(DAT_06005dce = FUN_06005C98 + 0x136);
PROVIDE(DAT_06006116 = FUN_06005ECC + 0x24A);
PROVIDE(DAT_06006360 = FUN_0600629C + 0xC4);
PROVIDE(DAT_06006362 = FUN_0600629C + 0xC6);
PROVIDE(DAT_06006666 = FUN_060064F2 + 0x174);
PROVIDE(DAT_06006668 = FUN_060064F2 + 0x176);
PROVIDE(DAT_06006752 = FUN_060064F2 + 0x260);
PROVIDE(DAT_06006756 = FUN_060064F2 + 0x264);
PROVIDE(DAT_06006758 = FUN_060064F2 + 0x266);
PROVIDE(DAT_06006802 = FUN_060067C8 + 0x3A);
PROVIDE(DAT_06006804 = FUN_060067C8 + 0x3C);
PROVIDE(DAT_06006c1e = FUN_06006A9C + 0x182);
PROVIDE(DAT_06006cca = FUN_06006A9C + 0x22E);
PROVIDE(DAT_06006da6 = FUN_06006CDC + 0xCA);
PROVIDE(DAT_06007412 = FUN_06007370 + 0xA2);
PROVIDE(DAT_06007414 = FUN_06007370 + 0xA4);
PROVIDE(DAT_06007416 = FUN_06007370 + 0xA6);
PROVIDE(DAT_060076e2 = FUN_06007658 + 0x8A);
PROVIDE(DAT_0600777e = FUN_06007658 + 0x126);
PROVIDE(DAT_060078ca = FUN_06007790 + 0x13A);
PROVIDE(DAT_060079ce = FUN_060078DC + 0xF2);
PROVIDE(DAT_06007a92 = FUN_06007A50 + 0x42);
PROVIDE(DAT_06007a94 = FUN_06007A50 + 0x44);
PROVIDE(DAT_06007a96 = FUN_06007A50 + 0x46);
PROVIDE(DAT_060082ac = FUN_060081F4 + 0xB8);
PROVIDE(DAT_060082b2 = FUN_060081F4 + 0xBE);
PROVIDE(DAT_0600835a = FUN_06008318 + 0x42);
PROVIDE(DAT_060083fc = FUN_06008318 + 0xE4);
PROVIDE(DAT_06008400 = FUN_06008318 + 0xE8);
PROVIDE(DAT_06008402 = FUN_06008318 + 0xEA);
PROVIDE(DAT_060084a2 = FUN_06008460 + 0x42);
PROVIDE(DAT_060084a4 = FUN_06008460 + 0x44);
PROVIDE(DAT_060084a6 = FUN_06008460 + 0x46);
PROVIDE(DAT_0600855e = FUN_060084CA + 0x94);
PROVIDE(DAT_06008624 = FUN_060085B8 + 0x6C);
PROVIDE(DAT_06008626 = FUN_060085B8 + 0x6E);
PROVIDE(DAT_0600862a = FUN_060085B8 + 0x72);
PROVIDE(DAT_0600871a = FUN_060086C0 + 0x5A);
PROVIDE(DAT_0600871c = FUN_060086C0 + 0x5C);
PROVIDE(DAT_060087e8 = FUN_060086C0 + 0x128);
PROVIDE(DAT_060087ea = FUN_060086C0 + 0x12A);
PROVIDE(DAT_060087ec = FUN_060086C0 + 0x12C);
PROVIDE(DAT_060087f4 = FUN_060086C0 + 0x134);
PROVIDE(DAT_060088ac = FUN_060086C0 + 0x1EC);
PROVIDE(DAT_060088b0 = FUN_060086C0 + 0x1F0);
PROVIDE(DAT_060088b2 = FUN_060086C0 + 0x1F2);
PROVIDE(DAT_060088b4 = FUN_060086C0 + 0x1F4);
PROVIDE(DAT_060088b6 = FUN_060086C0 + 0x1F6);
PROVIDE(DAT_0600a10c = FUN_0600A0C0 + 0x4C);
PROVIDE(DAT_0600a110 = FUN_0600A0C0 + 0x50);
PROVIDE(DAT_0600a112 = FUN_0600A0C0 + 0x52);
PROVIDE(DAT_0600a224 = FUN_0600A140 + 0xE4);
PROVIDE(DAT_0600a2d8 = FUN_0600A140 + 0x198);
PROVIDE(DAT_0600a2dc = FUN_0600A140 + 0x19C);
PROVIDE(DAT_0600a36c = FUN_0600A140 + 0x22C);
PROVIDE(DAT_0600a36e = FUN_0600A140 + 0x22E);
PROVIDE(DAT_0600a370 = FUN_0600A140 + 0x230);
PROVIDE(DAT_0600a372 = FUN_0600A140 + 0x232);
PROVIDE(DAT_0600a460 = FUN_0600A392 + 0xCE);
PROVIDE(DAT_0600a856 = FUN_0600A76C + 0xEA);
PROVIDE(DAT_0600aa7e = FUN_0600A914 + 0x16A);
PROVIDE(DAT_0600b100 = FUN_0600AFB2 + 0x14E);
PROVIDE(DAT_0600b102 = FUN_0600AFB2 + 0x150);
PROVIDE(DAT_0600b104 = FUN_0600AFB2 + 0x152);
PROVIDE(DAT_0600b106 = FUN_0600AFB2 + 0x154);
PROVIDE(DAT_0600b47a = FUN_0600B340 + 0x13A);
PROVIDE(DAT_0600b47c = FUN_0600B340 + 0x13C);
PROVIDE(DAT_0600b47e = FUN_0600B340 + 0x13E);
PROVIDE(DAT_0600b630 = FUN_0600B4D2 + 0x15E);
PROVIDE(DAT_0600b632 = FUN_0600B4D2 + 0x160);
PROVIDE(DAT_0600b634 = FUN_0600B4D2 + 0x162);
PROVIDE(DAT_0600b636 = FUN_0600B4D2 + 0x164);
PROVIDE(DAT_0600b83a = FUN_0600B6A0 + 0x19A);
PROVIDE(DAT_0600b83c = FUN_0600B6A0 + 0x19C);
PROVIDE(DAT_0600b840 = FUN_0600B6A0 + 0x1A0);
PROVIDE(DAT_0600b90e = FUN_0600B6A0 + 0x26E);
PROVIDE(DAT_0600bab2 = FUN_0600B914 + 0x19E);
PROVIDE(DAT_0600bab4 = FUN_0600B914 + 0x1A0);
PROVIDE(DAT_0600bab8 = FUN_0600B914 + 0x1A4);
PROVIDE(DAT_0600bc2c = FUN_0600BB94 + 0x98);
PROVIDE(DAT_0600bc2e = FUN_0600BB94 + 0x9A);
PROVIDE(DAT_0600bcee = FUN_0600BB94 + 0x15A);
PROVIDE(DAT_0600bdac = FUN_0600BB94 + 0x218);
PROVIDE(DAT_0600bdae = FUN_0600BB94 + 0x21A);
PROVIDE(DAT_0600bf3c = FUN_0600BB94 + 0x3A8);
PROVIDE(DAT_0600bfe2 = FUN_0600BB94 + 0x44E);
PROVIDE(DAT_0600c36a = FUN_0600C286 + 0xE4);
PROVIDE(DAT_0600c36c = FUN_0600C286 + 0xE6);
PROVIDE(DAT_0600c36e = FUN_0600C286 + 0xE8);
PROVIDE(DAT_0600c370 = FUN_0600C286 + 0xEA);
PROVIDE(DAT_0600c372 = FUN_0600C286 + 0xEC);
PROVIDE(DAT_0600c418 = FUN_0600C286 + 0x192);
PROVIDE(DAT_0600c590 = FUN_0600C4F8 + 0x98);
PROVIDE(DAT_0600c594 = FUN_0600C4F8 + 0x9C);
PROVIDE(DAT_0600c596 = FUN_0600C4F8 + 0x9E);
PROVIDE(DAT_0600c598 = FUN_0600C4F8 + 0xA0);
PROVIDE(DAT_0600c59a = FUN_0600C4F8 + 0xA2);
PROVIDE(DAT_0600c616 = FUN_0600C5D6 + 0x40);
PROVIDE(DAT_0600c6f6 = FUN_0600C5D6 + 0x120);
PROVIDE(DAT_0600c6f8 = FUN_0600C5D6 + 0x122);
PROVIDE(DAT_0600c6fa = FUN_0600C5D6 + 0x124);
PROVIDE(DAT_0600c6fc = FUN_0600C5D6 + 0x126);
PROVIDE(DAT_0600c6fe = FUN_0600C5D6 + 0x128);
PROVIDE(DAT_0600c700 = FUN_0600C5D6 + 0x12A);
PROVIDE(DAT_0600c702 = FUN_0600C5D6 + 0x12C);
PROVIDE(DAT_0600c7be = FUN_0600C74E + 0x70);
PROVIDE(DAT_0600c7c0 = FUN_0600C74E + 0x72);
PROVIDE(DAT_0600c8b6 = FUN_0600C7D8 + 0xDE);
PROVIDE(DAT_0600c8bc = FUN_0600C7D8 + 0xE4);
PROVIDE(DAT_0600c8be = FUN_0600C7D8 + 0xE6);
PROVIDE(DAT_0600c8c0 = FUN_0600C7D8 + 0xE8);
PROVIDE(DAT_0600c8c2 = FUN_0600C7D8 + 0xEA);
PROVIDE(DAT_0600c962 = FUN_0600C8D0 + 0x92);
PROVIDE(DAT_0600c964 = FUN_0600C8D0 + 0x94);
PROVIDE(DAT_0600c9e4 = FUN_0600C994 + 0x50);
PROVIDE(DAT_0600c9e6 = FUN_0600C994 + 0x52);
PROVIDE(DAT_0600cac0 = FUN_0600C994 + 0x12C);
PROVIDE(DAT_0600cac2 = FUN_0600C994 + 0x12E);
PROVIDE(DAT_0600cb84 = FUN_0600C994 + 0x1F0);
PROVIDE(DAT_0600cb86 = FUN_0600C994 + 0x1F2);
PROVIDE(DAT_0600ccf6 = FUN_0600CC38 + 0xBE);
PROVIDE(DAT_0600ccf8 = FUN_0600CC38 + 0xC0);
PROVIDE(DAT_0600ccfa = FUN_0600CC38 + 0xC2);
PROVIDE(DAT_0600cdbc = FUN_0600CD40 + 0x7C);
PROVIDE(DAT_0600cdbe = FUN_0600CD40 + 0x7E);
PROVIDE(DAT_0600cdc0 = FUN_0600CD40 + 0x80);
PROVIDE(DAT_0600cdc2 = FUN_0600CD40 + 0x82);
PROVIDE(DAT_0600ce86 = FUN_0600CE66 + 0x20);
PROVIDE(DAT_0600ce88 = FUN_0600CE66 + 0x22);
PROVIDE(DAT_0600ce8a = FUN_0600CE66 + 0x24);
PROVIDE(DAT_0600ce8c = FUN_0600CE66 + 0x26);
PROVIDE(DAT_0600ce8e = FUN_0600CE66 + 0x28);
PROVIDE(DAT_0600cf3a = FUN_0600CEBA + 0x80);
PROVIDE(DAT_0600cf40 = FUN_0600CEBA + 0x86);
PROVIDE(DAT_0600cfe4 = FUN_0600CF58 + 0x8C);
PROVIDE(DAT_0600cfe6 = FUN_0600CF58 + 0x8E);
PROVIDE(DAT_0600d114 = FUN_0600CF58 + 0x1BC);
PROVIDE(DAT_0600d11a = FUN_0600CF58 + 0x1C2);
PROVIDE(DAT_0600d192 = FUN_0600D12C + 0x66);
PROVIDE(DAT_0600d1fa = FUN_0600D12C + 0xCE);
PROVIDE(DAT_0600d1fc = FUN_0600D12C + 0xD0);
PROVIDE(DAT_0600d1fe = FUN_0600D12C + 0xD2);
PROVIDE(DAT_0600d200 = FUN_0600D12C + 0xD4);
PROVIDE(DAT_0600d202 = FUN_0600D12C + 0xD6);
PROVIDE(DAT_0600d204 = FUN_0600D12C + 0xD8);
PROVIDE(DAT_0600d26a = FUN_0600D12C + 0x13E);
PROVIDE(DAT_0600d26c = FUN_0600D12C + 0x140);
PROVIDE(DAT_0600d26e = FUN_0600D12C + 0x142);
PROVIDE(DAT_0600d270 = FUN_0600D12C + 0x144);
PROVIDE(DAT_0600d272 = FUN_0600D12C + 0x146);
PROVIDE(DAT_0600d404 = FUN_0600D31C + 0xE8);
PROVIDE(DAT_0600d406 = FUN_0600D31C + 0xEA);
PROVIDE(DAT_0600d4a6 = FUN_0600D41C + 0x8A);
PROVIDE(DAT_0600d536 = FUN_0600D50C + 0x2A);
PROVIDE(DAT_0600d5d6 = FUN_0600D50C + 0xCA);
PROVIDE(DAT_0600d76a = FUN_0600D50C + 0x25E);
PROVIDE(DAT_0600d82a = FUN_0600D780 + 0xAA);
PROVIDE(DAT_0600d82e = FUN_0600D780 + 0xAE);
PROVIDE(DAT_0600d894 = FUN_0600D780 + 0x114);
PROVIDE(DAT_0600d996 = FUN_0600D92C + 0x6A);
PROVIDE(DAT_0600d998 = FUN_0600D92C + 0x6C);
PROVIDE(DAT_0600d99a = FUN_0600D92C + 0x6E);
PROVIDE(DAT_0600db40 = FUN_0600DA7C + 0xC4);
PROVIDE(DAT_0600db44 = FUN_0600DA7C + 0xC8);
PROVIDE(DAT_0600db46 = FUN_0600DA7C + 0xCA);
PROVIDE(DAT_0600dbda = FUN_0600DBA0 + 0x3A);
PROVIDE(DAT_0600dbdc = FUN_0600DBA0 + 0x3C);
PROVIDE(DAT_0600dc98 = FUN_0600DC74 + 0x24);
PROVIDE(DAT_0600dc9a = FUN_0600DC74 + 0x26);
PROVIDE(DAT_0600dc9c = FUN_0600DC74 + 0x28);
PROVIDE(DAT_0600dc9e = FUN_0600DC74 + 0x2A);
PROVIDE(DAT_0600dd62 = FUN_0600DCC8 + 0x9A);
PROVIDE(DAT_0600de1e = FUN_0600DD88 + 0x96);
PROVIDE(DAT_0600deb2 = FUN_0600DE70 + 0x42);
PROVIDE(DAT_0600e2ba = FUN_0600E1D4 + 0xE6);
PROVIDE(DAT_0600e2be = FUN_0600E1D4 + 0xEA);
PROVIDE(DAT_0600e2c0 = FUN_0600E1D4 + 0xEC);
PROVIDE(DAT_0600e2c2 = FUN_0600E1D4 + 0xEE);
PROVIDE(DAT_0600e2c4 = FUN_0600E1D4 + 0xF0);
PROVIDE(DAT_0600e2c8 = FUN_0600E1D4 + 0xF4);
PROVIDE(DAT_0600e2ca = FUN_0600E1D4 + 0xF6);
PROVIDE(DAT_0600e3e8 = FUN_0600E1D4 + 0x214);
PROVIDE(DAT_0600e3ea = FUN_0600E1D4 + 0x216);
PROVIDE(DAT_0600e3ec = FUN_0600E1D4 + 0x218);
PROVIDE(DAT_0600e3f0 = FUN_0600E1D4 + 0x21C);
PROVIDE(DAT_0600e3f2 = FUN_0600E1D4 + 0x21E);
PROVIDE(DAT_0600e3f4 = FUN_0600E1D4 + 0x220);
PROVIDE(DAT_0600e3f6 = FUN_0600E1D4 + 0x222);
PROVIDE(DAT_0600e456 = FUN_0600E410 + 0x46);
PROVIDE(DAT_0600e522 = FUN_0600E4F2 + 0x30);
PROVIDE(DAT_0600e69c = FUN_0600E4F2 + 0x1AA);
PROVIDE(DAT_0600e79c = FUN_0600E71A + 0x82);
PROVIDE(DAT_0600e79e = FUN_0600E71A + 0x84);
PROVIDE(DAT_0600e86c = FUN_0600E7C8 + 0xA4);
PROVIDE(DAT_0600e86e = FUN_0600E7C8 + 0xA6);
PROVIDE(DAT_0600e870 = FUN_0600E7C8 + 0xA8);
PROVIDE(DAT_0600e920 = FUN_0600E906 + 0x1A);
PROVIDE(DAT_0600e922 = FUN_0600E906 + 0x1C);
PROVIDE(DAT_0600e9e4 = FUN_0600E99C + 0x48);
PROVIDE(DAT_0600e9e8 = FUN_0600E99C + 0x4C);
PROVIDE(DAT_0600e9ea = FUN_0600E99C + 0x4E);
PROVIDE(DAT_0600ea76 = FUN_0600E99C + 0xDA);
PROVIDE(DAT_0600eafa = FUN_0600E99C + 0x15E);
PROVIDE(DAT_0600ebd8 = FUN_0600EB14 + 0xC4);
PROVIDE(DAT_0600ed62 = FUN_0600EC78 + 0xEA);
PROVIDE(DAT_0600ed64 = FUN_0600EC78 + 0xEC);
PROVIDE(DAT_0600ed6c = FUN_0600EC78 + 0xF4);
PROVIDE(DAT_0600ed6e = FUN_0600EC78 + 0xF6);
PROVIDE(DAT_0600ed72 = FUN_0600EC78 + 0xFA);
PROVIDE(DAT_0600ed74 = FUN_0600EC78 + 0xFC);
PROVIDE(DAT_0600ed76 = FUN_0600EC78 + 0xFE);
PROVIDE(DAT_0600ed78 = FUN_0600EC78 + 0x100);
PROVIDE(DAT_0600ed7a = FUN_0600EC78 + 0x102);
PROVIDE(DAT_0600ed7e = FUN_0600EC78 + 0x106);
PROVIDE(DAT_0600ed80 = FUN_0600EC78 + 0x108);
PROVIDE(DAT_0600eeba = FUN_0600EC78 + 0x242);
PROVIDE(DAT_0600eebe = FUN_0600EC78 + 0x246);
PROVIDE(DAT_0600eec0 = FUN_0600EC78 + 0x248);
PROVIDE(DAT_0600eec4 = FUN_0600EC78 + 0x24C);
PROVIDE(DAT_0600eec8 = FUN_0600EC78 + 0x250);
PROVIDE(DAT_0600eecc = FUN_0600EC78 + 0x254);
PROVIDE(DAT_0600eed0 = FUN_0600EC78 + 0x258);
PROVIDE(DAT_0600eed4 = FUN_0600EC78 + 0x25C);
PROVIDE(DAT_0600eed8 = FUN_0600EC78 + 0x260);
PROVIDE(DAT_0600eedc = FUN_0600EC78 + 0x264);
PROVIDE(DAT_0600eede = FUN_0600EC78 + 0x266);
PROVIDE(DAT_0600eee2 = FUN_0600EC78 + 0x26A);
PROVIDE(DAT_0600eee6 = FUN_0600EC78 + 0x26E);
PROVIDE(DAT_0600eee8 = FUN_0600EC78 + 0x270);
PROVIDE(DAT_0600eeec = FUN_0600EC78 + 0x274);
PROVIDE(DAT_0600eeee = FUN_0600EC78 + 0x276);
PROVIDE(DAT_0600eef0 = FUN_0600EC78 + 0x278);
PROVIDE(DAT_0600eef2 = FUN_0600EC78 + 0x27A);
PROVIDE(DAT_0600eef6 = FUN_0600EC78 + 0x27E);
PROVIDE(DAT_0600eef8 = FUN_0600EC78 + 0x280);
PROVIDE(DAT_0600eefc = FUN_0600EC78 + 0x284);
PROVIDE(DAT_0600effe = FUN_0600EC78 + 0x386);
PROVIDE(DAT_0600f000 = FUN_0600EC78 + 0x388);
PROVIDE(DAT_0600f004 = FUN_0600EC78 + 0x38C);
PROVIDE(DAT_0600f006 = FUN_0600EC78 + 0x38E);
PROVIDE(DAT_0600f008 = FUN_0600EC78 + 0x390);
PROVIDE(DAT_0600f00a = FUN_0600EC78 + 0x392);
PROVIDE(DAT_0600f00c = FUN_0600EC78 + 0x394);
PROVIDE(DAT_0600f00e = FUN_0600EC78 + 0x396);
PROVIDE(DAT_0600f010 = FUN_0600EC78 + 0x398);
PROVIDE(DAT_0600f014 = FUN_0600EC78 + 0x39C);
PROVIDE(DAT_0600f018 = FUN_0600EC78 + 0x3A0);
PROVIDE(DAT_0600f01c = FUN_0600EC78 + 0x3A4);
PROVIDE(DAT_0600f01e = FUN_0600EC78 + 0x3A6);
PROVIDE(DAT_0600f020 = FUN_0600EC78 + 0x3A8);
PROVIDE(DAT_0600f022 = FUN_0600EC78 + 0x3AA);
PROVIDE(DAT_0600f024 = FUN_0600EC78 + 0x3AC);
PROVIDE(DAT_0600f028 = FUN_0600EC78 + 0x3B0);
PROVIDE(DAT_0600f02a = FUN_0600EC78 + 0x3B2);
PROVIDE(DAT_0600f02c = FUN_0600EC78 + 0x3B4);
PROVIDE(DAT_0600f02e = FUN_0600EC78 + 0x3B6);
PROVIDE(DAT_0600f030 = FUN_0600EC78 + 0x3B8);
PROVIDE(DAT_0600f032 = FUN_0600EC78 + 0x3BA);
PROVIDE(DAT_0600f034 = FUN_0600EC78 + 0x3BC);
PROVIDE(DAT_0600f036 = FUN_0600EC78 + 0x3BE);
PROVIDE(DAT_0600f14c = FUN_0600EC78 + 0x4D4);
PROVIDE(DAT_0600f14e = FUN_0600EC78 + 0x4D6);
PROVIDE(DAT_0600f150 = FUN_0600EC78 + 0x4D8);
PROVIDE(DAT_0600f152 = FUN_0600EC78 + 0x4DA);
PROVIDE(DAT_0600f26c = FUN_0600EC78 + 0x5F4);
PROVIDE(DAT_0600f270 = FUN_0600EC78 + 0x5F8);
PROVIDE(DAT_0600f272 = FUN_0600EC78 + 0x5FA);
PROVIDE(DAT_0600f276 = FUN_0600EC78 + 0x5FE);
PROVIDE(DAT_0600f342 = FUN_0600EC78 + 0x6CA);
PROVIDE(DAT_0600f344 = FUN_0600EC78 + 0x6CC);
PROVIDE(DAT_0600f346 = FUN_0600EC78 + 0x6CE);
PROVIDE(DAT_0600f348 = FUN_0600EC78 + 0x6D0);
PROVIDE(DAT_0600f34a = FUN_0600EC78 + 0x6D2);
PROVIDE(DAT_0600f612 = FUN_0600F424 + 0x1EE);
PROVIDE(DAT_0600f614 = FUN_0600F424 + 0x1F0);
PROVIDE(DAT_0600f618 = FUN_0600F424 + 0x1F4);
PROVIDE(DAT_0600f61a = FUN_0600F424 + 0x1F6);
PROVIDE(DAT_06010044 = FUN_0600FFD0 + 0x74);
PROVIDE(DAT_06010046 = FUN_0600FFD0 + 0x76);
PROVIDE(DAT_060100f2 = FUN_060100A4 + 0x4E);
PROVIDE(DAT_060100f4 = FUN_060100A4 + 0x50);
PROVIDE(DAT_060100f6 = FUN_060100A4 + 0x52);
PROVIDE(DAT_060100f8 = FUN_060100A4 + 0x54);
PROVIDE(DAT_060101b2 = FUN_060100A4 + 0x10E);
PROVIDE(DAT_0601038c = FUN_060102EC + 0xA0);
PROVIDE(DAT_0601038e = FUN_060102EC + 0xA2);
PROVIDE(DAT_0601043e = FUN_060103B8 + 0x86);
PROVIDE(DAT_0601064a = FUN_060104E0 + 0x16A);
PROVIDE(DAT_0601096e = FUN_06010760 + 0x20E);
PROVIDE(DAT_06010a2a = FUN_06010994 + 0x96);
PROVIDE(DAT_06010c4e = FUN_06010BC4 + 0x8A);
PROVIDE(DAT_0601112c = FUN_06011094 + 0x98);
PROVIDE(DAT_06011206 = FUN_060111E2 + 0x24);
PROVIDE(DAT_060112e6 = FUN_060111E2 + 0x104);
PROVIDE(DAT_060113b4 = FUN_06011310 + 0xA4);
PROVIDE(DAT_06011462 = FUN_06011310 + 0x152);
PROVIDE(DAT_06011466 = FUN_06011310 + 0x156);
PROVIDE(DAT_060115c6 = FUN_0601155E + 0x68);
PROVIDE(DAT_06011efe = FUN_06011E7C + 0x82);
PROVIDE(DAT_06011f00 = FUN_06011E7C + 0x84);
PROVIDE(DAT_06011f02 = FUN_06011E7C + 0x86);
PROVIDE(DAT_06011fd4 = FUN_06011F92 + 0x42);
PROVIDE(DAT_06011fd6 = FUN_06011F92 + 0x44);
PROVIDE(DAT_0601214e = FUN_060120CC + 0x82);
PROVIDE(DAT_060123de = FUN_06012344 + 0x9A);
PROVIDE(DAT_060123e0 = FUN_06012344 + 0x9C);
PROVIDE(DAT_060123e2 = FUN_06012344 + 0x9E);
PROVIDE(DAT_06012586 = FUN_0601250C + 0x7A);
PROVIDE(DAT_060126a4 = FUN_060125D0 + 0xD4);
PROVIDE(DAT_06012884 = FUN_060127E0 + 0xA4);
PROVIDE(DAT_06012888 = FUN_060127E0 + 0xA8);
PROVIDE(DAT_0601288c = FUN_060127E0 + 0xAC);
PROVIDE(DAT_0601288e = FUN_060127E0 + 0xAE);
PROVIDE(DAT_06012890 = FUN_060127E0 + 0xB0);
PROVIDE(DAT_0601299a = FUN_060127E0 + 0x1BA);
PROVIDE(DAT_0601299c = FUN_060127E0 + 0x1BC);
PROVIDE(DAT_0601299e = FUN_060127E0 + 0x1BE);
PROVIDE(DAT_060129a0 = FUN_060127E0 + 0x1C0);
PROVIDE(DAT_060129a2 = FUN_060127E0 + 0x1C2);
PROVIDE(DAT_060129a4 = FUN_060127E0 + 0x1C4);
PROVIDE(DAT_060129a6 = FUN_060127E0 + 0x1C6);
PROVIDE(DAT_06012a92 = FUN_060127E0 + 0x2B2);
PROVIDE(DAT_06012a94 = FUN_060127E0 + 0x2B4);
PROVIDE(DAT_06012c66 = FUN_06012C3C + 0x2A);
PROVIDE(DAT_06013050 = FUN_06012F80 + 0xD0);
PROVIDE(DAT_06013052 = FUN_06012F80 + 0xD2);
PROVIDE(DAT_06013058 = FUN_06012F80 + 0xD8);
PROVIDE(DAT_0601305c = FUN_06012F80 + 0xDC);
PROVIDE(DAT_0601305e = FUN_06012F80 + 0xDE);
PROVIDE(DAT_06013062 = FUN_06012F80 + 0xE2);
PROVIDE(DAT_06013064 = FUN_06012F80 + 0xE4);
PROVIDE(DAT_06013066 = FUN_06012F80 + 0xE6);
PROVIDE(DAT_06013068 = FUN_06012F80 + 0xE8);
PROVIDE(DAT_060131b4 = FUN_06012F80 + 0x234);
PROVIDE(DAT_060131b8 = FUN_06012F80 + 0x238);
PROVIDE(DAT_060131ba = FUN_06012F80 + 0x23A);
PROVIDE(DAT_060131bc = FUN_06012F80 + 0x23C);
PROVIDE(DAT_060131c0 = FUN_06012F80 + 0x240);
PROVIDE(DAT_060131c2 = FUN_06012F80 + 0x242);
PROVIDE(DAT_060131c6 = FUN_06012F80 + 0x246);
PROVIDE(DAT_060131ca = FUN_06012F80 + 0x24A);
PROVIDE(DAT_060131ce = FUN_06012F80 + 0x24E);
PROVIDE(DAT_060131d2 = FUN_06012F80 + 0x252);
PROVIDE(DAT_060131d6 = FUN_06012F80 + 0x256);
PROVIDE(DAT_060131da = FUN_06012F80 + 0x25A);
PROVIDE(DAT_060131de = FUN_06012F80 + 0x25E);
PROVIDE(DAT_060131e0 = FUN_06012F80 + 0x260);
PROVIDE(DAT_060131e4 = FUN_06012F80 + 0x264);
PROVIDE(DAT_060131e8 = FUN_06012F80 + 0x268);
PROVIDE(DAT_060131ea = FUN_06012F80 + 0x26A);
PROVIDE(DAT_060131ee = FUN_06012F80 + 0x26E);
PROVIDE(DAT_060131f0 = FUN_06012F80 + 0x270);
PROVIDE(DAT_060131f2 = FUN_06012F80 + 0x272);
PROVIDE(DAT_060131f6 = FUN_06012F80 + 0x276);
PROVIDE(DAT_060131f8 = FUN_06012F80 + 0x278);
PROVIDE(DAT_060132f2 = FUN_06012F80 + 0x372);
PROVIDE(DAT_060132f6 = FUN_06012F80 + 0x376);
PROVIDE(DAT_060132fc = FUN_06012F80 + 0x37C);
PROVIDE(DAT_060132fe = FUN_06012F80 + 0x37E);
PROVIDE(DAT_06013302 = FUN_06012F80 + 0x382);
PROVIDE(DAT_06013304 = FUN_06012F80 + 0x384);
PROVIDE(DAT_06013306 = FUN_06012F80 + 0x386);
PROVIDE(DAT_06013308 = FUN_06012F80 + 0x388);
PROVIDE(DAT_0601330a = FUN_06012F80 + 0x38A);
PROVIDE(DAT_0601330c = FUN_06012F80 + 0x38C);
PROVIDE(DAT_0601330e = FUN_06012F80 + 0x38E);
PROVIDE(DAT_06013312 = FUN_06012F80 + 0x392);
PROVIDE(DAT_06013318 = FUN_06012F80 + 0x398);
PROVIDE(DAT_0601331a = FUN_06012F80 + 0x39A);
PROVIDE(DAT_0601331c = FUN_06012F80 + 0x39C);
PROVIDE(DAT_0601331e = FUN_06012F80 + 0x39E);
PROVIDE(DAT_06013320 = FUN_06012F80 + 0x3A0);
PROVIDE(DAT_06013322 = FUN_06012F80 + 0x3A2);
PROVIDE(DAT_06013326 = FUN_06012F80 + 0x3A6);
PROVIDE(DAT_06013328 = FUN_06012F80 + 0x3A8);
PROVIDE(DAT_0601332a = FUN_06012F80 + 0x3AA);
PROVIDE(DAT_0601332c = FUN_06012F80 + 0x3AC);
PROVIDE(DAT_0601332e = FUN_06012F80 + 0x3AE);
PROVIDE(DAT_06013440 = FUN_06012F80 + 0x4C0);
PROVIDE(DAT_06013442 = FUN_06012F80 + 0x4C2);
PROVIDE(DAT_06013444 = FUN_06012F80 + 0x4C4);
PROVIDE(DAT_06013446 = FUN_06012F80 + 0x4C6);
PROVIDE(DAT_06013448 = FUN_06012F80 + 0x4C8);
PROVIDE(DAT_0601344a = FUN_06012F80 + 0x4CA);
PROVIDE(DAT_0601344c = FUN_06012F80 + 0x4CC);
PROVIDE(DAT_0601344e = FUN_06012F80 + 0x4CE);
PROVIDE(DAT_06013562 = FUN_06012F80 + 0x5E2);
PROVIDE(DAT_06013682 = FUN_06012F80 + 0x702);
PROVIDE(DAT_06013684 = FUN_06012F80 + 0x704);
PROVIDE(DAT_06013686 = FUN_06012F80 + 0x706);
PROVIDE(DAT_06013688 = FUN_06012F80 + 0x708);
PROVIDE(DAT_0601368a = FUN_06012F80 + 0x70A);
PROVIDE(DAT_0601368c = FUN_06012F80 + 0x70C);
PROVIDE(DAT_0601368e = FUN_06012F80 + 0x70E);
PROVIDE(DAT_06013694 = FUN_06012F80 + 0x714);
PROVIDE(DAT_0601369a = FUN_06012F80 + 0x71A);
PROVIDE(DAT_060136a0 = FUN_06012F80 + 0x720);
PROVIDE(DAT_060136a2 = FUN_06012F80 + 0x722);
PROVIDE(DAT_060136a6 = FUN_06012F80 + 0x726);
PROVIDE(DAT_060136a8 = FUN_06012F80 + 0x728);
PROVIDE(DAT_060136aa = FUN_06012F80 + 0x72A);
PROVIDE(DAT_060136ac = FUN_06012F80 + 0x72C);
PROVIDE(DAT_060136ae = FUN_06012F80 + 0x72E);
PROVIDE(DAT_060136b0 = FUN_06012F80 + 0x730);
PROVIDE(DAT_060136b2 = FUN_06012F80 + 0x732);
PROVIDE(DAT_060136b8 = FUN_06012F80 + 0x738);
PROVIDE(DAT_060136ba = FUN_06012F80 + 0x73A);
PROVIDE(DAT_060136bc = FUN_06012F80 + 0x73C);
PROVIDE(DAT_060136be = FUN_06012F80 + 0x73E);
PROVIDE(DAT_060136c0 = FUN_06012F80 + 0x740);
PROVIDE(DAT_060136c2 = FUN_06012F80 + 0x742);
PROVIDE(DAT_060137b0 = FUN_06012F80 + 0x830);
PROVIDE(DAT_060137b6 = FUN_06012F80 + 0x836);
PROVIDE(DAT_060137b8 = FUN_06012F80 + 0x838);
PROVIDE(DAT_060137ba = FUN_06012F80 + 0x83A);
PROVIDE(DAT_060137bc = FUN_06012F80 + 0x83C);
PROVIDE(DAT_060137be = FUN_06012F80 + 0x83E);
PROVIDE(DAT_060137c0 = FUN_06012F80 + 0x840);
PROVIDE(DAT_060137c2 = FUN_06012F80 + 0x842);
PROVIDE(DAT_060138d6 = FUN_060138BE + 0x18);
PROVIDE(DAT_060138d8 = FUN_060138BE + 0x1A);
PROVIDE(DAT_060138da = FUN_060138BE + 0x1C);
PROVIDE(DAT_06013cca = FUN_06013C58 + 0x72);
PROVIDE(DAT_06013ccc = FUN_06013C58 + 0x74);
PROVIDE(DAT_06013cce = FUN_06013C58 + 0x76);
PROVIDE(DAT_06013cd0 = FUN_06013C58 + 0x78);
PROVIDE(DAT_06013dc6 = FUN_06013C58 + 0x16E);
PROVIDE(DAT_06013dc8 = FUN_06013C58 + 0x170);
PROVIDE(DAT_06013dca = FUN_06013C58 + 0x172);
PROVIDE(DAT_06013dcc = FUN_06013C58 + 0x174);
PROVIDE(DAT_06013dce = FUN_06013C58 + 0x176);
PROVIDE(DAT_06013dd2 = FUN_06013C58 + 0x17A);
PROVIDE(DAT_06013dd4 = FUN_06013C58 + 0x17C);
PROVIDE(DAT_06013dd6 = FUN_06013C58 + 0x17E);
PROVIDE(DAT_06013f46 = FUN_06013E7A + 0xCC);
PROVIDE(DAT_06013f48 = FUN_06013E7A + 0xCE);
PROVIDE(DAT_06013f4a = FUN_06013E7A + 0xD0);
PROVIDE(DAT_06013f4c = FUN_06013E7A + 0xD2);
PROVIDE(DAT_06014080 = FUN_06013FC4 + 0xBC);
PROVIDE(DAT_06014082 = FUN_06013FC4 + 0xBE);
PROVIDE(DAT_06014084 = FUN_06013FC4 + 0xC0);
PROVIDE(DAT_06014086 = FUN_06013FC4 + 0xC2);
PROVIDE(DAT_06014306 = FUN_0601424C + 0xBA);
PROVIDE(DAT_0601440e = FUN_06014360 + 0xAE);
PROVIDE(DAT_06014594 = FUN_0601450C + 0x88);
PROVIDE(DAT_06014682 = FUN_060145BC + 0xC6);
PROVIDE(DAT_06014818 = FUN_0601476C + 0xAC);
PROVIDE(DAT_06014cf2 = FUN_06014A74 + 0x27E);
PROVIDE(DAT_06014de4 = FUN_06014D2C + 0xB8);
PROVIDE(DAT_06016ffa = FUN_06016DD8 + 0x222);
PROVIDE(DAT_0601729e = FUN_060171AC + 0xF2);
PROVIDE(DAT_0601748a = FUN_060173AC + 0xDE);
PROVIDE(DAT_0601748c = FUN_060173AC + 0xE0);
PROVIDE(DAT_0601748e = FUN_060173AC + 0xE2);
PROVIDE(DAT_06017490 = FUN_060173AC + 0xE4);
PROVIDE(DAT_06017492 = FUN_060173AC + 0xE6);
PROVIDE(DAT_060175b4 = FUN_060173AC + 0x208);
PROVIDE(DAT_060175b6 = FUN_060173AC + 0x20A);
PROVIDE(DAT_060175b8 = FUN_060173AC + 0x20C);
PROVIDE(DAT_060175ba = FUN_060173AC + 0x20E);
PROVIDE(DAT_06017692 = FUN_060173AC + 0x2E6);
PROVIDE(DAT_06017696 = FUN_060173AC + 0x2EA);
PROVIDE(DAT_06017698 = FUN_060173AC + 0x2EC);
PROVIDE(DAT_0601769a = FUN_060173AC + 0x2EE);
PROVIDE(DAT_0601769c = FUN_060173AC + 0x2F0);
PROVIDE(DAT_06017728 = FUN_060173AC + 0x37C);
PROVIDE(DAT_0601772a = FUN_060173AC + 0x37E);
PROVIDE(DAT_0601772c = FUN_060173AC + 0x380);
PROVIDE(DAT_060178ac = FUN_06017814 + 0x98);
PROVIDE(DAT_06017bd4 = FUN_06017814 + 0x3C0);
PROVIDE(DAT_06017bd6 = FUN_06017814 + 0x3C2);
PROVIDE(DAT_06017bd8 = FUN_06017814 + 0x3C4);
PROVIDE(DAT_06017c52 = FUN_06017814 + 0x43E);
PROVIDE(DAT_06017d92 = FUN_06017CEC + 0xA6);
PROVIDE(DAT_06017d94 = FUN_06017CEC + 0xA8);
PROVIDE(DAT_06017d96 = FUN_06017CEC + 0xAA);
PROVIDE(DAT_06017d98 = FUN_06017CEC + 0xAC);
PROVIDE(DAT_06017d9a = FUN_06017CEC + 0xAE);
PROVIDE(DAT_06017ea6 = FUN_06017CEC + 0x1BA);
PROVIDE(DAT_06017ea8 = FUN_06017CEC + 0x1BC);
PROVIDE(DAT_06017eaa = FUN_06017CEC + 0x1BE);
PROVIDE(DAT_06017fdc = FUN_06017CEC + 0x2F0);
PROVIDE(DAT_06017fde = FUN_06017CEC + 0x2F2);
PROVIDE(DAT_06017fe2 = FUN_06017CEC + 0x2F6);
PROVIDE(DAT_06017fe4 = FUN_06017CEC + 0x2F8);
PROVIDE(DAT_06017fe6 = FUN_06017CEC + 0x2FA);
PROVIDE(DAT_060180fc = FUN_06017CEC + 0x410);
PROVIDE(DAT_060180fe = FUN_06017CEC + 0x412);
PROVIDE(DAT_06018102 = FUN_06017CEC + 0x416);
PROVIDE(DAT_06018104 = FUN_06017CEC + 0x418);
PROVIDE(DAT_06018212 = FUN_06018166 + 0xAC);
PROVIDE(DAT_06018214 = FUN_06018166 + 0xAE);
PROVIDE(DAT_06018216 = FUN_06018166 + 0xB0);
PROVIDE(DAT_0601821a = FUN_06018166 + 0xB4);
PROVIDE(DAT_060182f2 = FUN_06018278 + 0x7A);
PROVIDE(DAT_060183ec = FUN_06018320 + 0xCC);
PROVIDE(DAT_060183ee = FUN_06018320 + 0xCE);
PROVIDE(DAT_060183f0 = FUN_06018320 + 0xD0);
PROVIDE(DAT_060183f2 = FUN_06018320 + 0xD2);
PROVIDE(DAT_060185a0 = FUN_06018320 + 0x280);
PROVIDE(DAT_06018660 = FUN_060185D8 + 0x88);
PROVIDE(DAT_06018b8e = FUN_06018A3C + 0x152);
PROVIDE(DAT_06018f74 = FUN_06018EE4 + 0x90);
PROVIDE(DAT_06018f76 = FUN_06018EE4 + 0x92);
PROVIDE(DAT_060195ac = FUN_0601950C + 0xA0);
PROVIDE(DAT_060195ae = FUN_0601950C + 0xA2);
PROVIDE(DAT_06019694 = FUN_0601950C + 0x188);
PROVIDE(DAT_06019762 = FUN_060196B0 + 0xB2);
PROVIDE(DAT_06019864 = FUN_060197F4 + 0x70);
PROVIDE(DAT_06019bfc = FUN_06019BC8 + 0x34);
PROVIDE(DAT_0601a6de = FUN_0601A65E + 0x80);
PROVIDE(DAT_0601a6e0 = FUN_0601A65E + 0x82);
PROVIDE(DAT_0601a6e2 = FUN_0601A65E + 0x84);
PROVIDE(DAT_0601a756 = FUN_0601A65E + 0xF8);
PROVIDE(DAT_0601a758 = FUN_0601A65E + 0xFA);
PROVIDE(DAT_0601a75a = FUN_0601A65E + 0xFC);
PROVIDE(DAT_0601a872 = FUN_0601A80C + 0x66);
PROVIDE(DAT_0601a926 = FUN_0601A80C + 0x11A);
PROVIDE(DAT_0601a928 = FUN_0601A80C + 0x11C);
PROVIDE(DAT_0601a92a = FUN_0601A80C + 0x11E);
PROVIDE(DAT_0601a9a4 = FUN_0601A940 + 0x64);
PROVIDE(DAT_0601aa3a = FUN_0601A940 + 0xFA);
PROVIDE(DAT_0601aac2 = FUN_0601A940 + 0x182);
PROVIDE(DAT_0601ae3e = FUN_0601AC88 + 0x1B6);
PROVIDE(DAT_0601b246 = FUN_0601B170 + 0xD6);
PROVIDE(DAT_0601b248 = FUN_0601B170 + 0xD8);
PROVIDE(DAT_0601b24a = FUN_0601B170 + 0xDA);
PROVIDE(DAT_0601b254 = FUN_0601B170 + 0xE4);
PROVIDE(DAT_0601b256 = FUN_0601B170 + 0xE6);
PROVIDE(DAT_0601b25a = FUN_0601B170 + 0xEA);
PROVIDE(DAT_0601b25e = FUN_0601B170 + 0xEE);
PROVIDE(DAT_0601b260 = FUN_0601B170 + 0xF0);
PROVIDE(DAT_0601b262 = FUN_0601B170 + 0xF2);
PROVIDE(DAT_0601b38a = FUN_0601B170 + 0x21A);
PROVIDE(DAT_0601b38c = FUN_0601B170 + 0x21C);
PROVIDE(DAT_0601b38e = FUN_0601B170 + 0x21E);
PROVIDE(DAT_0601b390 = FUN_0601B170 + 0x220);
PROVIDE(DAT_0601b392 = FUN_0601B170 + 0x222);
PROVIDE(DAT_0601b76c = FUN_0601B6F0 + 0x7C);
PROVIDE(DAT_0601b76e = FUN_0601B6F0 + 0x7E);
PROVIDE(DAT_0601b87e = FUN_0601B7F4 + 0x8A);
PROVIDE(DAT_0601bb3a = FUN_0601BA50 + 0xEA);
PROVIDE(DAT_0601bb3e = FUN_0601BA50 + 0xEE);
PROVIDE(DAT_0601bb40 = FUN_0601BA50 + 0xF0);
PROVIDE(DAT_0601bb44 = FUN_0601BA50 + 0xF4);
PROVIDE(DAT_0601bb46 = FUN_0601BA50 + 0xF6);
PROVIDE(DAT_0601bb48 = FUN_0601BA50 + 0xF8);
PROVIDE(DAT_0601bb4a = FUN_0601BA50 + 0xFA);
PROVIDE(DAT_0601bbc0 = FUN_0601BA50 + 0x170);
PROVIDE(DAT_0601bcba = FUN_0601BBDC + 0xDE);
PROVIDE(DAT_0601c510 = FUN_0601C3E4 + 0x12C);
PROVIDE(DAT_0601c5f8 = FUN_0601C3E4 + 0x214);
PROVIDE(DAT_0601c5fa = FUN_0601C3E4 + 0x216);
PROVIDE(DAT_0601c6c0 = FUN_0601C3E4 + 0x2DC);
PROVIDE(DAT_0601c77c = FUN_0601C3E4 + 0x398);
PROVIDE(DAT_0601c844 = FUN_0601C3E4 + 0x460);
PROVIDE(DAT_0601c93c = FUN_0601C3E4 + 0x558);
PROVIDE(DAT_0601c93e = FUN_0601C3E4 + 0x55A);
PROVIDE(DAT_0601ca3a = FUN_0601C978 + 0xC2);
PROVIDE(DAT_0601ca3c = FUN_0601C978 + 0xC4);
PROVIDE(DAT_0601cb48 = FUN_0601CAEE + 0x5A);
PROVIDE(DAT_0601d18c = FUN_0601D12C + 0x60);
PROVIDE(DAT_0601d18e = FUN_0601D12C + 0x62);
PROVIDE(DAT_0601d24c = FUN_0601D12C + 0x120);
PROVIDE(DAT_0601d24e = FUN_0601D12C + 0x122);
PROVIDE(DAT_0601d2c6 = FUN_0601D12C + 0x19A);
PROVIDE(DAT_0601d36c = FUN_0601D2DC + 0x90);
PROVIDE(DAT_0601d444 = FUN_0601D3C0 + 0x84);
PROVIDE(DAT_0601d446 = FUN_0601D3C0 + 0x86);
PROVIDE(DAT_0601d974 = FUN_0601D7D0 + 0x1A4);
PROVIDE(DAT_0601d976 = FUN_0601D7D0 + 0x1A6);
PROVIDE(DAT_0601dd30 = FUN_0601DBB8 + 0x178);
PROVIDE(DAT_0601dd34 = FUN_0601DBB8 + 0x17C);
PROVIDE(DAT_0601de24 = FUN_0601DDF6 + 0x2E);
PROVIDE(DAT_0601de26 = FUN_0601DDF6 + 0x30);
PROVIDE(DAT_0601df14 = FUN_0601DE50 + 0xC4);
PROVIDE(DAT_0601df16 = FUN_0601DE50 + 0xC6);
PROVIDE(DAT_0601df18 = FUN_0601DE50 + 0xC8);
PROVIDE(DAT_0601df1a = FUN_0601DE50 + 0xCA);
PROVIDE(DAT_0601df1c = FUN_0601DE50 + 0xCC);
PROVIDE(DAT_0601e024 = FUN_0601DF88 + 0x9C);
PROVIDE(DAT_0601e028 = FUN_0601DF88 + 0xA0);
PROVIDE(DAT_0601e02a = FUN_0601DF88 + 0xA2);
PROVIDE(DAT_0601e02c = FUN_0601DF88 + 0xA4);
PROVIDE(DAT_0601e02e = FUN_0601DF88 + 0xA6);
PROVIDE(DAT_0601e0e2 = FUN_0601DF88 + 0x15A);
PROVIDE(DAT_0601e0e4 = FUN_0601DF88 + 0x15C);
PROVIDE(DAT_0601e162 = FUN_0601E100 + 0x62);
PROVIDE(DAT_0601e164 = FUN_0601E100 + 0x64);
PROVIDE(DAT_0601e166 = FUN_0601E100 + 0x66);
PROVIDE(DAT_0601e238 = FUN_0601E100 + 0x138);
PROVIDE(DAT_0601e23a = FUN_0601E100 + 0x13A);
PROVIDE(DAT_0601e23c = FUN_0601E100 + 0x13C);
PROVIDE(DAT_0601e240 = FUN_0601E100 + 0x140);
PROVIDE(DAT_0601e244 = FUN_0601E100 + 0x144);
PROVIDE(DAT_0601e248 = FUN_0601E100 + 0x148);
PROVIDE(DAT_0601e24a = FUN_0601E100 + 0x14A);
PROVIDE(DAT_0601e24c = FUN_0601E100 + 0x14C);
PROVIDE(DAT_0601e24e = FUN_0601E100 + 0x14E);
PROVIDE(DAT_0601e444 = FUN_0601E37C + 0xC8);
PROVIDE(DAT_0601f5c6 = FUN_0601F4B4 + 0x112);
PROVIDE(DAT_0601f6ba = FUN_0601F5E0 + 0xDA);
PROVIDE(DAT_0601f804 = FUN_0601F784 + 0x80);
PROVIDE(DAT_0601f806 = FUN_0601F784 + 0x82);
PROVIDE(DAT_0601f962 = FUN_0601F938 + 0x2A);
PROVIDE(DAT_0601f964 = FUN_0601F938 + 0x2C);
PROVIDE(DAT_0601fa26 = FUN_0601F9CC + 0x5A);
PROVIDE(DAT_0601fac4 = FUN_0601F9CC + 0xF8);
PROVIDE(DAT_0601fac8 = FUN_0601F9CC + 0xFC);
PROVIDE(DAT_0601fbae = FUN_0601F9CC + 0x1E2);
PROVIDE(DAT_0601fbb4 = FUN_0601F9CC + 0x1E8);
PROVIDE(DAT_0601fbc4 = FUN_0601F9CC + 0x1F8);
PROVIDE(DAT_0601fbc8 = FUN_0601F9CC + 0x1FC);
PROVIDE(DAT_0601fc94 = FUN_0601F9CC + 0x2C8);
PROVIDE(DAT_0601fc9c = FUN_0601F9CC + 0x2D0);
PROVIDE(DAT_0601ff8a = FUN_0601FEC0 + 0xCA);
PROVIDE(DAT_0601ff8e = FUN_0601FEC0 + 0xCE);
PROVIDE(DAT_0601ff90 = FUN_0601FEC0 + 0xD0);
PROVIDE(DAT_0602014a = FUN_060200A4 + 0xA6);
PROVIDE(DAT_0602014c = FUN_060200A4 + 0xA8);
PROVIDE(DAT_060203be = FUN_06020366 + 0x58);
PROVIDE(DAT_06020db2 = FUN_06020D50 + 0x62);
PROVIDE(DAT_06020f2e = FUN_06020E84 + 0xAA);
PROVIDE(DAT_06020fc8 = FUN_06020E84 + 0x144);
PROVIDE(DAT_06020fca = FUN_06020E84 + 0x146);
PROVIDE(DAT_06021098 = FUN_06020E84 + 0x214);
PROVIDE(DAT_0602109a = FUN_06020E84 + 0x216);
PROVIDE(DAT_0602109c = FUN_06020E84 + 0x218);
PROVIDE(DAT_0602109e = FUN_06020E84 + 0x21A);
PROVIDE(DAT_060212d8 = FUN_06021178 + 0x160);
PROVIDE(DAT_06021416 = FUN_06021178 + 0x29E);
PROVIDE(DAT_06021520 = FUN_06021450 + 0xD0);
PROVIDE(DAT_06021522 = FUN_06021450 + 0xD2);
PROVIDE(DAT_06021526 = FUN_06021450 + 0xD6);
PROVIDE(DAT_060218de = FUN_06021450 + 0x48E);
PROVIDE(DAT_060218e0 = FUN_06021450 + 0x490);
PROVIDE(DAT_06021c2e = FUN_06021450 + 0x7DE);
PROVIDE(DAT_06021c32 = FUN_06021450 + 0x7E2);
PROVIDE(DAT_06021e98 = FUN_06021450 + 0xA48);
PROVIDE(DAT_06021e9a = FUN_06021450 + 0xA4A);
PROVIDE(DAT_06021fe0 = FUN_06021450 + 0xB90);
PROVIDE(DAT_06022114 = FUN_06021450 + 0xCC4);
PROVIDE(DAT_06022116 = FUN_06021450 + 0xCC6);
PROVIDE(DAT_06022118 = FUN_06021450 + 0xCC8);
PROVIDE(DAT_060224b6 = FUN_06022140 + 0x376);
PROVIDE(DAT_060238fe = FUN_0602382C + 0xD2);
PROVIDE(DAT_06023900 = FUN_0602382C + 0xD4);
PROVIDE(DAT_06023904 = FUN_0602382C + 0xD8);
PROVIDE(DAT_06023a62 = FUN_0602382C + 0x236);
PROVIDE(DAT_06023cf8 = FUN_0602382C + 0x4CC);
PROVIDE(DAT_06023d00 = FUN_0602382C + 0x4D4);
PROVIDE(DAT_06023d02 = FUN_0602382C + 0x4D6);
PROVIDE(DAT_06023e50 = FUN_0602382C + 0x624);
PROVIDE(DAT_06023e52 = FUN_0602382C + 0x626);
PROVIDE(DAT_060242e0 = FUN_0602382C + 0xAB4);
PROVIDE(DAT_060242e4 = FUN_0602382C + 0xAB8);
PROVIDE(DAT_0602461e = FUN_0602382C + 0xDF2);
PROVIDE(DAT_06024624 = FUN_0602382C + 0xDF8);
PROVIDE(DAT_06024628 = FUN_0602382C + 0xDFC);
PROVIDE(DAT_0602462a = FUN_0602382C + 0xDFE);
PROVIDE(DAT_0602462c = FUN_0602382C + 0xE00);
PROVIDE(DAT_06024638 = FUN_0602382C + 0xE0C);
PROVIDE(DAT_06024782 = FUN_0602382C + 0xF56);
PROVIDE(DAT_06024784 = FUN_0602382C + 0xF58);
PROVIDE(DAT_06024786 = FUN_0602382C + 0xF5A);
PROVIDE(DAT_06024788 = FUN_0602382C + 0xF5C);
PROVIDE(DAT_060248bc = FUN_0602382C + 0x1090);
PROVIDE(DAT_060248be = FUN_0602382C + 0x1092);
PROVIDE(DAT_06024a08 = FUN_0602382C + 0x11DC);
PROVIDE(DAT_06024a0a = FUN_0602382C + 0x11DE);
PROVIDE(DAT_06024b54 = FUN_0602382C + 0x1328);
PROVIDE(DAT_06024c9e = FUN_0602382C + 0x1472);
PROVIDE(DAT_06024ca0 = FUN_0602382C + 0x1474);
PROVIDE(DAT_06024ca2 = FUN_0602382C + 0x1476);
PROVIDE(DAT_06025136 = FUN_06025070 + 0xC6);
PROVIDE(DAT_0602528a = FUN_06025224 + 0x66);
PROVIDE(DAT_06025292 = FUN_06025224 + 0x6E);
PROVIDE(DAT_0602537a = FUN_06025224 + 0x156);
PROVIDE(DAT_0602537c = FUN_06025224 + 0x158);
PROVIDE(DAT_0602537e = FUN_06025224 + 0x15A);
PROVIDE(DAT_06025380 = FUN_06025224 + 0x15C);
PROVIDE(DAT_06025382 = FUN_06025224 + 0x15E);
PROVIDE(DAT_06025384 = FUN_06025224 + 0x160);
PROVIDE(DAT_06025386 = FUN_06025224 + 0x162);
PROVIDE(DAT_0602538a = FUN_06025224 + 0x166);
PROVIDE(DAT_060254de = FUN_06025478 + 0x66);
PROVIDE(DAT_060254e6 = FUN_06025478 + 0x6E);
PROVIDE(DAT_060255ce = FUN_06025478 + 0x156);
PROVIDE(DAT_060255d0 = FUN_06025478 + 0x158);
PROVIDE(DAT_060255d2 = FUN_06025478 + 0x15A);
PROVIDE(DAT_060255d4 = FUN_06025478 + 0x15C);
PROVIDE(DAT_060255d6 = FUN_06025478 + 0x15E);
PROVIDE(DAT_060255d8 = FUN_06025478 + 0x160);
PROVIDE(DAT_060255da = FUN_06025478 + 0x162);
PROVIDE(DAT_060255de = FUN_06025478 + 0x166);
PROVIDE(DAT_06025746 = FUN_060256CC + 0x7A);
PROVIDE(DAT_0602596a = FUN_060256CC + 0x29E);
PROVIDE(DAT_06025a80 = FUN_060256CC + 0x3B4);
PROVIDE(DAT_06025c6e = FUN_06025BF4 + 0x7A);
PROVIDE(DAT_06025e94 = FUN_06025BF4 + 0x2A0);
PROVIDE(DAT_06025fac = FUN_06025BF4 + 0x3B8);
PROVIDE(DAT_06026016 = FUN_06025BF4 + 0x422);
PROVIDE(DAT_06026576 = FUN_06026518 + 0x5E);
PROVIDE(DAT_06026578 = FUN_06026518 + 0x60);
PROVIDE(DAT_0602672a = FUN_060266CC + 0x5E);
PROVIDE(DAT_0602672c = FUN_060266CC + 0x60);
PROVIDE(DAT_0602672e = FUN_060266CC + 0x62);
PROVIDE(DAT_0602684a = FUN_060266CC + 0x17E);
PROVIDE(DAT_060268a6 = FUN_060266CC + 0x1DA);
PROVIDE(DAT_06026922 = FUN_060268B0 + 0x72);
PROVIDE(DAT_06027d26 = FUN_06027CA4 + 0x82);
PROVIDE(DAT_06027e98 = FUN_06027CA4 + 0x1F4);
PROVIDE(DAT_06027e9a = FUN_06027CA4 + 0x1F6);
PROVIDE(DAT_06027f56 = FUN_06027EDE + 0x78);
PROVIDE(DAT_0602805c = FUN_06027EDE + 0x17E);
PROVIDE(DAT_06028708 = FUN_06028654 + 0xB4);
PROVIDE(DAT_06029c2e = FUN_06029740 + 0x4EE);
PROVIDE(DAT_06029ea4 = FUN_06029740 + 0x764);
PROVIDE(DAT_06029ea6 = FUN_06029740 + 0x766);
PROVIDE(DAT_06029ed4 = FUN_06029740 + 0x794);
PROVIDE(DAT_06029ee2 = FUN_06029740 + 0x7A2);
PROVIDE(DAT_06029f2a = FUN_06029740 + 0x7EA);
PROVIDE(DAT_06029f2c = FUN_06029740 + 0x7EC);
PROVIDE(DAT_06029f2e = FUN_06029740 + 0x7EE);
PROVIDE(DAT_06029f30 = FUN_06029740 + 0x7F0);
PROVIDE(DAT_06029f3e = FUN_06029740 + 0x7FE);
PROVIDE(DAT_06029f4c = FUN_06029740 + 0x80C);
PROVIDE(DAT_06029f94 = FUN_06029740 + 0x854);
PROVIDE(DAT_06029f96 = FUN_06029740 + 0x856);
PROVIDE(DAT_06029f98 = FUN_06029740 + 0x858);
PROVIDE(DAT_06029f9a = FUN_06029740 + 0x85A);
PROVIDE(DAT_06029fa8 = FUN_06029740 + 0x868);
PROVIDE(DAT_06029fb6 = FUN_06029740 + 0x876);
PROVIDE(DAT_06029ffe = FUN_06029740 + 0x8BE);
PROVIDE(DAT_0602a000 = FUN_06029740 + 0x8C0);
PROVIDE(DAT_0602a002 = FUN_06029740 + 0x8C2);
PROVIDE(DAT_0602a004 = FUN_06029740 + 0x8C4);
PROVIDE(DAT_0602a012 = FUN_06029740 + 0x8D2);
PROVIDE(DAT_0602a020 = FUN_06029740 + 0x8E0);
PROVIDE(DAT_0602a050 = FUN_06029740 + 0x910);
PROVIDE(DAT_0602a24e = FUN_06029740 + 0xB0E);
PROVIDE(DAT_0602a4c4 = FUN_06029740 + 0xD84);
PROVIDE(DAT_0602a4c6 = FUN_06029740 + 0xD86);
PROVIDE(DAT_0602a4f4 = FUN_06029740 + 0xDB4);
PROVIDE(DAT_0602a502 = FUN_06029740 + 0xDC2);
PROVIDE(DAT_0602a54a = FUN_06029740 + 0xE0A);
PROVIDE(DAT_0602a54c = FUN_06029740 + 0xE0C);
PROVIDE(DAT_0602a54e = FUN_06029740 + 0xE0E);
PROVIDE(DAT_0602a550 = FUN_06029740 + 0xE10);
PROVIDE(DAT_0602a55e = FUN_06029740 + 0xE1E);
PROVIDE(DAT_0602a56c = FUN_06029740 + 0xE2C);
PROVIDE(DAT_0602a5b4 = FUN_06029740 + 0xE74);
PROVIDE(DAT_0602a5b6 = FUN_06029740 + 0xE76);
PROVIDE(DAT_0602a5b8 = FUN_06029740 + 0xE78);
PROVIDE(DAT_0602a5ba = FUN_06029740 + 0xE7A);
PROVIDE(DAT_0602a5c8 = FUN_06029740 + 0xE88);
PROVIDE(DAT_0602a5d6 = FUN_06029740 + 0xE96);
PROVIDE(DAT_0602a61e = FUN_06029740 + 0xEDE);
PROVIDE(DAT_0602a620 = FUN_06029740 + 0xEE0);
PROVIDE(DAT_0602a622 = FUN_06029740 + 0xEE2);
PROVIDE(DAT_0602a624 = FUN_06029740 + 0xEE4);
PROVIDE(DAT_0602a632 = FUN_06029740 + 0xEF2);
PROVIDE(DAT_0602a640 = FUN_06029740 + 0xF00);
PROVIDE(DAT_0602a670 = FUN_06029740 + 0xF30);
PROVIDE(DAT_0602a97e = FUN_0602A840 + 0x13E);
PROVIDE(DAT_0602aa12 = FUN_0602A840 + 0x1D2);
PROVIDE(DAT_0602aa14 = FUN_0602A840 + 0x1D4);
PROVIDE(DAT_0602aa16 = FUN_0602A840 + 0x1D6);
PROVIDE(DAT_0602ab36 = FUN_0602A840 + 0x2F6);
PROVIDE(DAT_0602ab38 = FUN_0602A840 + 0x2F8);
PROVIDE(DAT_0602ab8c = FUN_0602A840 + 0x34C);
PROVIDE(DAT_0602ab90 = FUN_0602A840 + 0x350);
PROVIDE(DAT_0602ab94 = FUN_0602A840 + 0x354);
PROVIDE(DAT_0602ad02 = FUN_0602ABC4 + 0x13E);
PROVIDE(DAT_0602ad96 = FUN_0602ABC4 + 0x1D2);
PROVIDE(DAT_0602ad98 = FUN_0602ABC4 + 0x1D4);
PROVIDE(DAT_0602ad9a = FUN_0602ABC4 + 0x1D6);
PROVIDE(DAT_0602aeba = FUN_0602ABC4 + 0x2F6);
PROVIDE(DAT_0602aebc = FUN_0602ABC4 + 0x2F8);
PROVIDE(DAT_0602af10 = FUN_0602ABC4 + 0x34C);
PROVIDE(DAT_0602af14 = FUN_0602ABC4 + 0x350);
PROVIDE(DAT_0602af18 = FUN_0602ABC4 + 0x354);
PROVIDE(DAT_0602b082 = FUN_0602AF48 + 0x13A);
PROVIDE(DAT_0602b116 = FUN_0602AF48 + 0x1CE);
PROVIDE(DAT_0602b118 = FUN_0602AF48 + 0x1D0);
PROVIDE(DAT_0602b11a = FUN_0602AF48 + 0x1D2);
PROVIDE(DAT_0602b292 = FUN_0602AF48 + 0x34A);
PROVIDE(DAT_0602b294 = FUN_0602AF48 + 0x34C);
PROVIDE(DAT_0602b296 = FUN_0602AF48 + 0x34E);
PROVIDE(DAT_0602b2ec = FUN_0602AF48 + 0x3A4);
PROVIDE(DAT_0602b2f0 = FUN_0602AF48 + 0x3A8);
PROVIDE(DAT_0602b2f4 = FUN_0602AF48 + 0x3AC);
PROVIDE(DAT_0602b64c = FUN_0602B334 + 0x318);
PROVIDE(DAT_0602b64e = FUN_0602B334 + 0x31A);
PROVIDE(DAT_0602b67c = FUN_0602B334 + 0x348);
PROVIDE(DAT_0602b68a = FUN_0602B334 + 0x356);
PROVIDE(DAT_0602b6d2 = FUN_0602B334 + 0x39E);
PROVIDE(DAT_0602b6d4 = FUN_0602B334 + 0x3A0);
PROVIDE(DAT_0602b6d6 = FUN_0602B334 + 0x3A2);
PROVIDE(DAT_0602b6d8 = FUN_0602B334 + 0x3A4);
PROVIDE(DAT_0602b6e6 = FUN_0602B334 + 0x3B2);
PROVIDE(DAT_0602b6f4 = FUN_0602B334 + 0x3C0);
PROVIDE(DAT_0602b73c = FUN_0602B334 + 0x408);
PROVIDE(DAT_0602b73e = FUN_0602B334 + 0x40A);
PROVIDE(DAT_0602b740 = FUN_0602B334 + 0x40C);
PROVIDE(DAT_0602b742 = FUN_0602B334 + 0x40E);
PROVIDE(DAT_0602b750 = FUN_0602B334 + 0x41C);
PROVIDE(DAT_0602b75e = FUN_0602B334 + 0x42A);
PROVIDE(DAT_0602b7a6 = FUN_0602B334 + 0x472);
PROVIDE(DAT_0602b7a8 = FUN_0602B334 + 0x474);
PROVIDE(DAT_0602b7aa = FUN_0602B334 + 0x476);
PROVIDE(DAT_0602b7ac = FUN_0602B334 + 0x478);
PROVIDE(DAT_0602b7ba = FUN_0602B334 + 0x486);
PROVIDE(DAT_0602b7c8 = FUN_0602B334 + 0x494);
PROVIDE(DAT_0602b7f8 = FUN_0602B334 + 0x4C4);
PROVIDE(DAT_0602bb26 = FUN_0602B9EC + 0x13A);
PROVIDE(DAT_0602bbba = FUN_0602B9EC + 0x1CE);
PROVIDE(DAT_0602bbbc = FUN_0602B9EC + 0x1D0);
PROVIDE(DAT_0602bbbe = FUN_0602B9EC + 0x1D2);
PROVIDE(DAT_0602bd36 = FUN_0602BC7A + 0xBC);
PROVIDE(DAT_0602bd38 = FUN_0602BC7A + 0xBE);
PROVIDE(DAT_0602bd3a = FUN_0602BC7A + 0xC0);
PROVIDE(DAT_0602bd90 = FUN_0602BC7A + 0x116);
PROVIDE(DAT_0602bd94 = FUN_0602BC7A + 0x11A);
PROVIDE(DAT_0602bd98 = FUN_0602BC7A + 0x11E);
PROVIDE(DAT_0602c0f0 = FUN_0602BDD8 + 0x318);
PROVIDE(DAT_0602c0f2 = FUN_0602BDD8 + 0x31A);
PROVIDE(DAT_0602c120 = FUN_0602BDD8 + 0x348);
PROVIDE(DAT_0602c12e = FUN_0602BDD8 + 0x356);
PROVIDE(DAT_0602c176 = FUN_0602BDD8 + 0x39E);
PROVIDE(DAT_0602c178 = FUN_0602BDD8 + 0x3A0);
PROVIDE(DAT_0602c17a = FUN_0602BDD8 + 0x3A2);
PROVIDE(DAT_0602c17c = FUN_0602BDD8 + 0x3A4);
PROVIDE(DAT_0602c18a = FUN_0602BDD8 + 0x3B2);
PROVIDE(DAT_0602c198 = FUN_0602BDD8 + 0x3C0);
PROVIDE(DAT_0602c1e0 = FUN_0602BDD8 + 0x408);
PROVIDE(DAT_0602c1e2 = FUN_0602BDD8 + 0x40A);
PROVIDE(DAT_0602c1e4 = FUN_0602BDD8 + 0x40C);
PROVIDE(DAT_0602c1e6 = FUN_0602BDD8 + 0x40E);
PROVIDE(DAT_0602c1f4 = FUN_0602BDD8 + 0x41C);
PROVIDE(DAT_0602c202 = FUN_0602BDD8 + 0x42A);
PROVIDE(DAT_0602c24a = FUN_0602BDD8 + 0x472);
PROVIDE(DAT_0602c24c = FUN_0602BDD8 + 0x474);
PROVIDE(DAT_0602c24e = FUN_0602BDD8 + 0x476);
PROVIDE(DAT_0602c250 = FUN_0602BDD8 + 0x478);
PROVIDE(DAT_0602c25e = FUN_0602BDD8 + 0x486);
PROVIDE(DAT_0602c26c = FUN_0602BDD8 + 0x494);
PROVIDE(DAT_0602c29c = FUN_0602BDD8 + 0x4C4);
PROVIDE(DAT_0602c71a = FUN_0602C690 + 0x8A);
PROVIDE(DAT_0602c71c = FUN_0602C690 + 0x8C);
PROVIDE(DAT_0602c71e = FUN_0602C690 + 0x8E);
PROVIDE(DAT_0602c720 = FUN_0602C690 + 0x90);
PROVIDE(DAT_0602c722 = FUN_0602C690 + 0x92);
PROVIDE(DAT_0602c724 = FUN_0602C690 + 0x94);
PROVIDE(DAT_0602c726 = FUN_0602C690 + 0x96);
PROVIDE(DAT_0602c728 = FUN_0602C690 + 0x98);
PROVIDE(DAT_0602c72a = FUN_0602C690 + 0x9A);
PROVIDE(DAT_0602c7f8 = FUN_0602C690 + 0x168);
PROVIDE(DAT_0602c7fa = FUN_0602C690 + 0x16A);
PROVIDE(DAT_0602c89c = FUN_0602C884 + 0x18);
PROVIDE(DAT_0602c8a0 = FUN_0602C884 + 0x1C);
PROVIDE(DAT_0602c9cc = FUN_0602C8E2 + 0xEA);
PROVIDE(DAT_0602c9ce = FUN_0602C8E2 + 0xEC);
PROVIDE(DAT_0602c9d0 = FUN_0602C8E2 + 0xEE);
PROVIDE(DAT_0602c9d2 = FUN_0602C8E2 + 0xF0);
PROVIDE(DAT_0602c9d4 = FUN_0602C8E2 + 0xF2);
PROVIDE(DAT_0602c9d6 = FUN_0602C8E2 + 0xF4);
PROVIDE(DAT_0602c9d8 = FUN_0602C8E2 + 0xF6);
PROVIDE(DAT_0602c9dc = FUN_0602C8E2 + 0xFA);
PROVIDE(DAT_0602c9de = FUN_0602C8E2 + 0xFC);
PROVIDE(DAT_0602c9e2 = FUN_0602C8E2 + 0x100);
PROVIDE(DAT_0602c9e6 = FUN_0602C8E2 + 0x104);
PROVIDE(DAT_0602ca72 = FUN_0602C8E2 + 0x190);
PROVIDE(DAT_0602ca74 = FUN_0602C8E2 + 0x192);
PROVIDE(DAT_0602ca76 = FUN_0602C8E2 + 0x194);
PROVIDE(DAT_0602cb04 = FUN_0602CA84 + 0x80);
PROVIDE(DAT_0602cb06 = FUN_0602CA84 + 0x82);
PROVIDE(DAT_0602cb08 = FUN_0602CA84 + 0x84);
PROVIDE(DAT_0602cb0a = FUN_0602CA84 + 0x86);
PROVIDE(DAT_0602cb0c = FUN_0602CA84 + 0x88);
PROVIDE(DAT_0602cb0e = FUN_0602CA84 + 0x8A);
PROVIDE(DAT_0602cb72 = FUN_0602CA84 + 0xEE);
PROVIDE(DAT_0602cb74 = FUN_0602CA84 + 0xF0);
PROVIDE(DAT_0602cb76 = FUN_0602CA84 + 0xF2);
PROVIDE(DAT_0602cb78 = FUN_0602CA84 + 0xF4);
PROVIDE(DAT_0602cb7a = FUN_0602CA84 + 0xF6);
PROVIDE(DAT_0602cc9c = FUN_0602CA84 + 0x218);
PROVIDE(DAT_0602cc9e = FUN_0602CA84 + 0x21A);
PROVIDE(DAT_0602cca0 = FUN_0602CA84 + 0x21C);
PROVIDE(DAT_0602cca2 = FUN_0602CA84 + 0x21E);
PROVIDE(DAT_0602cca4 = FUN_0602CA84 + 0x220);
PROVIDE(DAT_0602cca6 = FUN_0602CA84 + 0x222);
PROVIDE(DAT_0602cca8 = FUN_0602CA84 + 0x224);
PROVIDE(DAT_0602ccaa = FUN_0602CA84 + 0x226);
PROVIDE(DAT_0602ccac = FUN_0602CA84 + 0x228);
PROVIDE(DAT_0602ccae = FUN_0602CA84 + 0x22A);
PROVIDE(DAT_0602ccb0 = FUN_0602CA84 + 0x22C);
PROVIDE(DAT_0602ccb2 = FUN_0602CA84 + 0x22E);
PROVIDE(DAT_0602ccb4 = FUN_0602CA84 + 0x230);
PROVIDE(DAT_0602ccb6 = FUN_0602CA84 + 0x232);
PROVIDE(DAT_0602ccb8 = FUN_0602CA84 + 0x234);
PROVIDE(DAT_0602ccba = FUN_0602CA84 + 0x236);
PROVIDE(DAT_0602ce44 = FUN_0602CDF6 + 0x4E);
PROVIDE(DAT_0602ce46 = FUN_0602CDF6 + 0x50);
PROVIDE(DAT_0602ce48 = FUN_0602CDF6 + 0x52);
PROVIDE(DAT_0602ce4a = FUN_0602CDF6 + 0x54);
PROVIDE(DAT_0602cfda = FUN_0602CDF6 + 0x1E4);
PROVIDE(DAT_0602cfdc = FUN_0602CDF6 + 0x1E6);
PROVIDE(DAT_0602cfde = FUN_0602CDF6 + 0x1E8);
PROVIDE(DAT_0602cfe0 = FUN_0602CDF6 + 0x1EA);
PROVIDE(DAT_0602d020 = FUN_0602CDF6 + 0x22A);
PROVIDE(DAT_0602d04e = FUN_0602CDF6 + 0x258);
PROVIDE(DAT_0602d050 = FUN_0602CDF6 + 0x25A);
PROVIDE(DAT_0602d074 = FUN_0602CDF6 + 0x27E);
PROVIDE(DAT_0602d076 = FUN_0602CDF6 + 0x280);
PROVIDE(DAT_0602d078 = FUN_0602CDF6 + 0x282);
PROVIDE(DAT_0602d0d4 = FUN_0602D08A + 0x4A);
PROVIDE(DAT_0602d0d8 = FUN_0602D08A + 0x4E);
PROVIDE(DAT_0602d0dc = FUN_0602D08A + 0x52);
PROVIDE(DAT_0602d0de = FUN_0602D08A + 0x54);
PROVIDE(DAT_0602d186 = FUN_0602D08A + 0xFC);
PROVIDE(DAT_0602d188 = FUN_0602D08A + 0xFE);
PROVIDE(DAT_0602d18c = FUN_0602D08A + 0x102);
PROVIDE(DAT_0602d18e = FUN_0602D08A + 0x104);
PROVIDE(DAT_0602d236 = FUN_0602D08A + 0x1AC);
PROVIDE(DAT_0602d238 = FUN_0602D08A + 0x1AE);
PROVIDE(DAT_0602d2c4 = FUN_0602D08A + 0x23A);
PROVIDE(DAT_0602d2ca = FUN_0602D08A + 0x240);
PROVIDE(DAT_0602d30a = FUN_0602D08A + 0x280);
PROVIDE(DAT_0602d38a = FUN_0602D08A + 0x300);
PROVIDE(DAT_0602d3e8 = FUN_0602D08A + 0x35E);
PROVIDE(DAT_0602d3ea = FUN_0602D08A + 0x360);
PROVIDE(DAT_0602d432 = FUN_0602D08A + 0x3A8);
PROVIDE(DAT_0602d48a = FUN_0602D43C + 0x4E);
PROVIDE(DAT_0602d48e = FUN_0602D43C + 0x52);
PROVIDE(DAT_0602d496 = FUN_0602D43C + 0x5A);
PROVIDE(DAT_0602d542 = FUN_0602D43C + 0x106);
PROVIDE(DAT_0602d544 = FUN_0602D43C + 0x108);
PROVIDE(DAT_0602d548 = FUN_0602D43C + 0x10C);
PROVIDE(DAT_0602d54a = FUN_0602D43C + 0x10E);
PROVIDE(DAT_0602d5f2 = FUN_0602D43C + 0x1B6);
PROVIDE(DAT_0602d5f4 = FUN_0602D43C + 0x1B8);
PROVIDE(DAT_0602d67c = FUN_0602D43C + 0x240);
PROVIDE(DAT_0602d682 = FUN_0602D43C + 0x246);
PROVIDE(DAT_0602d6c2 = FUN_0602D43C + 0x286);
PROVIDE(DAT_0602d732 = FUN_0602D43C + 0x2F6);
PROVIDE(DAT_0602d790 = FUN_0602D43C + 0x354);
PROVIDE(DAT_0602d862 = FUN_0602D43C + 0x426);
PROVIDE(DAT_0602d864 = FUN_0602D43C + 0x428);
PROVIDE(DAT_0602d866 = FUN_0602D43C + 0x42A);
PROVIDE(DAT_0602d88c = FUN_0602D43C + 0x450);
PROVIDE(DAT_0602d918 = FUN_0602D8C6 + 0x52);
PROVIDE(DAT_0602d91a = FUN_0602D8C6 + 0x54);
PROVIDE(DAT_0602dbac = FUN_0602DB22 + 0x8A);
PROVIDE(DAT_0602dbae = FUN_0602DB22 + 0x8C);
PROVIDE(DAT_0602dbb0 = FUN_0602DB22 + 0x8E);
PROVIDE(DAT_0602dbb2 = FUN_0602DB22 + 0x90);
PROVIDE(DAT_0602dbb4 = FUN_0602DB22 + 0x92);
PROVIDE(DAT_0602dbb6 = FUN_0602DB22 + 0x94);
PROVIDE(DAT_0602dbb8 = FUN_0602DB22 + 0x96);
PROVIDE(DAT_0602dbba = FUN_0602DB22 + 0x98);
PROVIDE(DAT_0602dbbc = FUN_0602DB22 + 0x9A);
PROVIDE(DAT_0602dbbe = FUN_0602DB22 + 0x9C);
PROVIDE(DAT_0602dbc0 = FUN_0602DB22 + 0x9E);
PROVIDE(DAT_0602dbc2 = FUN_0602DB22 + 0xA0);
PROVIDE(DAT_0602e284 = FUN_0602E264 + 0x20);
PROVIDE(DAT_0602e288 = FUN_0602E264 + 0x24);
PROVIDE(DAT_0602e28a = FUN_0602E264 + 0x26);
PROVIDE(DAT_0602e28e = FUN_0602E264 + 0x2A);
PROVIDE(DAT_0602e372 = FUN_0602E350 + 0x22);
PROVIDE(DAT_0602e376 = FUN_0602E350 + 0x26);
PROVIDE(DAT_0602e460 = FUN_0602E42E + 0x32);
PROVIDE(DAT_0602e51a = FUN_0602E4F4 + 0x26);
PROVIDE(DAT_0602e51c = FUN_0602E4F4 + 0x28);
PROVIDE(DAT_0602e51e = FUN_0602E4F4 + 0x2A);
PROVIDE(DAT_0602e520 = FUN_0602E4F4 + 0x2C);
PROVIDE(DAT_0602e522 = FUN_0602E4F4 + 0x2E);
PROVIDE(DAT_0602e5a2 = FUN_0602E578 + 0x2A);
PROVIDE(DAT_0602e5a4 = FUN_0602E578 + 0x2C);
PROVIDE(DAT_0602e80a = FUN_0602E7D4 + 0x36);
PROVIDE(DAT_0602efe6 = FUN_0602EFDA + 0xC);
PROVIDE(DAT_0602f01e = FUN_0602EFF0 + 0x2E);
PROVIDE(DAT_0602f064 = FUN_0602EFF0 + 0x74);
PROVIDE(DAT_0602f066 = FUN_0602EFF0 + 0x76);
PROVIDE(DAT_0602f11e = FUN_0602EFF0 + 0x12E);
PROVIDE(DAT_0602f120 = FUN_0602EFF0 + 0x130);
PROVIDE(DAT_0602f122 = FUN_0602EFF0 + 0x132);
PROVIDE(DAT_0602f124 = FUN_0602EFF0 + 0x134);
PROVIDE(DAT_0602f126 = FUN_0602EFF0 + 0x136);
PROVIDE(DAT_0602f128 = FUN_0602EFF0 + 0x138);
PROVIDE(DAT_0602f12a = FUN_0602EFF0 + 0x13A);
PROVIDE(DAT_0602f15a = FUN_0602EFF0 + 0x16A);
PROVIDE(DAT_0602f15c = FUN_0602EFF0 + 0x16C);
PROVIDE(DAT_0602f15e = FUN_0602EFF0 + 0x16E);
PROVIDE(DAT_0602f160 = FUN_0602EFF0 + 0x170);
PROVIDE(DAT_0602f1bc = FUN_0602EFF0 + 0x1CC);
PROVIDE(DAT_0602f1be = FUN_0602EFF0 + 0x1CE);
PROVIDE(DAT_0602f1f2 = FUN_0602EFF0 + 0x202);
PROVIDE(DAT_0602f24c = FUN_0602F214 + 0x38);
PROVIDE(DAT_0602f24e = FUN_0602F214 + 0x3A);
PROVIDE(DAT_0602f464 = FUN_0602F270 + 0x1F4);
PROVIDE(DAT_0602f466 = FUN_0602F270 + 0x1F6);
PROVIDE(DAT_0602f4aa = FUN_0602F270 + 0x23A);
PROVIDE(DAT_0602f51a = FUN_0602F270 + 0x2AA);
PROVIDE(DAT_0602f51c = FUN_0602F270 + 0x2AC);
PROVIDE(DAT_0602f51e = FUN_0602F270 + 0x2AE);
PROVIDE(DAT_0602f5b4 = FUN_0602F550 + 0x64);
PROVIDE(DAT_0602f5e8 = FUN_0602F5B6 + 0x32);
PROVIDE(DAT_0602f5ea = FUN_0602F5B6 + 0x34);
PROVIDE(DAT_0602f6e0 = FUN_0602F5B6 + 0x12A);
PROVIDE(DAT_0602f6e2 = FUN_0602F5B6 + 0x12C);
PROVIDE(DAT_0602f6e4 = FUN_0602F5B6 + 0x12E);
PROVIDE(DAT_0602f6e6 = FUN_0602F5B6 + 0x130);
PROVIDE(DAT_0602f6e8 = FUN_0602F5B6 + 0x132);
PROVIDE(DAT_0602f6ea = FUN_0602F5B6 + 0x134);
PROVIDE(DAT_0602f6ec = FUN_0602F5B6 + 0x136);
PROVIDE(DAT_0602f6ee = FUN_0602F5B6 + 0x138);
PROVIDE(DAT_0602f6f0 = FUN_0602F5B6 + 0x13A);
PROVIDE(DAT_0602f6f2 = FUN_0602F5B6 + 0x13C);
PROVIDE(DAT_0602f6f4 = FUN_0602F5B6 + 0x13E);
PROVIDE(DAT_0602f6f6 = FUN_0602F5B6 + 0x140);
PROVIDE(DAT_0602f7e4 = FUN_0602F5B6 + 0x22E);
PROVIDE(DAT_0602f7e6 = FUN_0602F5B6 + 0x230);
PROVIDE(DAT_0602f7e8 = FUN_0602F5B6 + 0x232);
PROVIDE(DAT_0602f842 = FUN_0602F7F2 + 0x50);
PROVIDE(DAT_0602f844 = FUN_0602F7F2 + 0x52);
PROVIDE(DAT_0602f890 = FUN_0602F7F2 + 0x9E);
PROVIDE(DAT_0602f8f0 = FUN_0602F7F2 + 0xFE);
PROVIDE(DAT_0602f8f2 = FUN_0602F7F2 + 0x100);
PROVIDE(DAT_0602f980 = FUN_0602F7F2 + 0x18E);
PROVIDE(DAT_0602f982 = FUN_0602F7F2 + 0x190);
PROVIDE(DAT_0602fba8 = FUN_0602F9A6 + 0x202);
PROVIDE(DAT_0602fbca = FUN_0602F9A6 + 0x224);
PROVIDE(DAT_0602fc6e = FUN_0602F9A6 + 0x2C8);
PROVIDE(DAT_0602fc70 = FUN_0602F9A6 + 0x2CA);
PROVIDE(DAT_0602fc72 = FUN_0602F9A6 + 0x2CC);
PROVIDE(DAT_0602fc74 = FUN_0602F9A6 + 0x2CE);
PROVIDE(DAT_0602fc76 = FUN_0602F9A6 + 0x2D0);
PROVIDE(DAT_0602fc9c = FUN_0602F9A6 + 0x2F6);
PROVIDE(DAT_0602fc9e = FUN_0602F9A6 + 0x2F8);
PROVIDE(DAT_0602fd1a = FUN_0602F9A6 + 0x374);
PROVIDE(DAT_060303b6 = FUN_060302D2 + 0xE4);
PROVIDE(DAT_06030402 = FUN_060302D2 + 0x130);
PROVIDE(DAT_0603045e = FUN_060302D2 + 0x18C);
PROVIDE(DAT_060304ac = FUN_060302D2 + 0x1DA);
PROVIDE(DAT_060304ae = FUN_060302D2 + 0x1DC);
PROVIDE(DAT_060304f0 = FUN_060302D2 + 0x21E);
PROVIDE(DAT_0603056a = FUN_06030548 + 0x22);
PROVIDE(DAT_060305ae = FUN_06030548 + 0x66);
PROVIDE(DAT_060305b0 = FUN_06030548 + 0x68);
PROVIDE(DAT_06030602 = FUN_06030548 + 0xBA);
PROVIDE(DAT_06030604 = FUN_06030548 + 0xBC);
PROVIDE(DAT_0603063a = FUN_06030548 + 0xF2);
PROVIDE(DAT_06030680 = FUN_06030548 + 0x138);
PROVIDE(DAT_060306c8 = FUN_06030548 + 0x180);
PROVIDE(DAT_06030714 = FUN_06030548 + 0x1CC);
PROVIDE(DAT_06030716 = FUN_06030548 + 0x1CE);
PROVIDE(DAT_06030742 = FUN_06030548 + 0x1FA);
PROVIDE(DAT_06030a40 = FUN_06030548 + 0x4F8);
PROVIDE(DAT_06030a44 = FUN_06030548 + 0x4FC);
PROVIDE(DAT_06030a46 = FUN_06030548 + 0x4FE);
PROVIDE(DAT_06030b24 = FUN_06030548 + 0x5DC);
PROVIDE(DAT_06030b26 = FUN_06030548 + 0x5DE);
PROVIDE(DAT_06030b28 = FUN_06030548 + 0x5E0);
PROVIDE(DAT_06030b2a = FUN_06030548 + 0x5E2);
PROVIDE(DAT_06030cca = FUN_06030548 + 0x782);
PROVIDE(DAT_06030d22 = FUN_06030548 + 0x7DA);
PROVIDE(DAT_06030da2 = FUN_06030548 + 0x85A);
PROVIDE(DAT_06030eae = FUN_06030E72 + 0x3C);
PROVIDE(DAT_060310b8 = FUN_0603101E + 0x9A);
PROVIDE(DAT_0603112e = FUN_0603101E + 0x110);
PROVIDE(DAT_06031130 = FUN_0603101E + 0x112);
PROVIDE(DAT_06031132 = FUN_0603101E + 0x114);
PROVIDE(DAT_06031188 = FUN_0603101E + 0x16A);
PROVIDE(DAT_0603118a = FUN_0603101E + 0x16C);
PROVIDE(DAT_060311b6 = FUN_0603101E + 0x198);
PROVIDE(DAT_0603120a = FUN_0603101E + 0x1EC);
PROVIDE(DAT_0603135c = FUN_0603101E + 0x33E);
PROVIDE(DAT_0603143a = FUN_0603139C + 0x9E);
PROVIDE(DAT_06031496 = FUN_0603139C + 0xFA);
PROVIDE(DAT_06031516 = FUN_0603139C + 0x17A);
PROVIDE(DAT_0603162e = FUN_0603139C + 0x292);
PROVIDE(DAT_06031750 = FUN_06031700 + 0x50);
PROVIDE(DAT_0603178c = FUN_06031700 + 0x8C);
PROVIDE(DAT_060317c6 = FUN_06031700 + 0xC6);
PROVIDE(DAT_060318e4 = FUN_06031898 + 0x4C);
PROVIDE(DAT_06031918 = FUN_06031898 + 0x80);
PROVIDE(DAT_0603196c = FUN_06031898 + 0xD4);
PROVIDE(DAT_06031a64 = FUN_06031A34 + 0x30);
PROVIDE(DAT_06031b22 = FUN_06031A34 + 0xEE);
PROVIDE(DAT_06031d36 = FUN_06031A34 + 0x302);
PROVIDE(DAT_06031d38 = FUN_06031A34 + 0x304);
PROVIDE(DAT_06031d3a = FUN_06031A34 + 0x306);
PROVIDE(DAT_06031e30 = FUN_06031E00 + 0x30);
PROVIDE(DAT_06031eee = FUN_06031E00 + 0xEE);
PROVIDE(DAT_06032102 = FUN_06031E00 + 0x302);
PROVIDE(DAT_06032104 = FUN_06031E00 + 0x304);
PROVIDE(DAT_06032106 = FUN_06031E00 + 0x306);
PROVIDE(DAT_0603489e = FUN_06034762 + 0x13C);
PROVIDE(DAT_06034976 = FUN_0603495C + 0x1A);
PROVIDE(DAT_06034a8e = FUN_06034A10 + 0x7E);
PROVIDE(DAT_06035734 = FUN_06034F08 + 0x82C);
PROVIDE(DAT_06036fba = FUN_06036F0C + 0xAE);
PROVIDE(DAT_06036fbc = FUN_06036F0C + 0xB0);
PROVIDE(DAT_06036fbe = FUN_06036F0C + 0xB2);
PROVIDE(DAT_06036fc0 = FUN_06036F0C + 0xB4);
PROVIDE(DAT_06036fc2 = FUN_06036F0C + 0xB6);
PROVIDE(DAT_06037078 = FUN_06036F0C + 0x16C);
PROVIDE(DAT_0603707a = FUN_06036F0C + 0x16E);
PROVIDE(DAT_0603707c = FUN_06036F0C + 0x170);
PROVIDE(DAT_0603707e = FUN_06036F0C + 0x172);
PROVIDE(DAT_06037154 = FUN_060370E4 + 0x70);
PROVIDE(DAT_06037156 = FUN_060370E4 + 0x72);
PROVIDE(DAT_0603728e = FUN_060370E4 + 0x1AA);
PROVIDE(DAT_06037362 = FUN_060370E4 + 0x27E);
PROVIDE(DAT_0603743a = FUN_060370E4 + 0x356);
PROVIDE(DAT_06037532 = FUN_060370E4 + 0x44E);
PROVIDE(DAT_06037536 = FUN_060370E4 + 0x452);
PROVIDE(DAT_060376a4 = FUN_06037660 + 0x44);
PROVIDE(DAT_060376a6 = FUN_06037660 + 0x46);
PROVIDE(DAT_060376a8 = FUN_06037660 + 0x48);
PROVIDE(DAT_060378f8 = FUN_06037660 + 0x298);
PROVIDE(DAT_060378fa = FUN_06037660 + 0x29A);
PROVIDE(DAT_060378fc = FUN_06037660 + 0x29C);
PROVIDE(DAT_060378fe = FUN_06037660 + 0x29E);
PROVIDE(DAT_06037b10 = FUN_06037660 + 0x4B0);
PROVIDE(DAT_06037c8e = FUN_06037660 + 0x62E);
PROVIDE(DAT_06037c90 = FUN_06037660 + 0x630);
PROVIDE(DAT_06037c92 = FUN_06037660 + 0x632);
PROVIDE(DAT_06037c94 = FUN_06037660 + 0x634);
PROVIDE(DAT_06037c96 = FUN_06037660 + 0x636);
PROVIDE(DAT_06038108 = FUN_0603806C + 0x9C);
PROVIDE(DAT_0603881a = FUN_06038794 + 0x86);
PROVIDE(DAT_06038a9a = FUN_06038A64 + 0x36);
PROVIDE(DAT_06038a9e = FUN_06038A64 + 0x3A);
PROVIDE(DAT_06038cc8 = FUN_06038BD4 + 0xF4);
PROVIDE(DAT_06038cd4 = FUN_06038BD4 + 0x100);
PROVIDE(DAT_06038cd6 = FUN_06038BD4 + 0x102);
PROVIDE(DAT_06038e1a = FUN_06038BD4 + 0x246);
PROVIDE(DAT_06038efa = FUN_06038E54 + 0xA6);
PROVIDE(DAT_06038efc = FUN_06038E54 + 0xA8);
PROVIDE(DAT_0603918c = FUN_06039100 + 0x8C);
PROVIDE(DAT_0603918e = FUN_06039100 + 0x8E);
PROVIDE(DAT_060392e6 = FUN_06039250 + 0x96);
PROVIDE(DAT_060397f4 = FUN_0603950C + 0x2E8);
PROVIDE(DAT_060397f6 = FUN_0603950C + 0x2EA);
PROVIDE(DAT_060397f8 = FUN_0603950C + 0x2EC);
PROVIDE(DAT_0603a1a2 = FUN_0603A0B0 + 0xF2);
PROVIDE(DAT_0603a2ca = FUN_0603A0B0 + 0x21A);
PROVIDE(DAT_0603a6fe = FUN_0603A0B0 + 0x64E);
PROVIDE(DAT_0603a8bc = FUN_0603A7B0 + 0x10C);
PROVIDE(DAT_0603ac16 = FUN_0603AA82 + 0x194);
PROVIDE(DAT_0603ac18 = FUN_0603AA82 + 0x196);
PROVIDE(DAT_0603ac1a = FUN_0603AA82 + 0x198);
PROVIDE(DAT_0603ac9e = FUN_0603AC1C + 0x82);
PROVIDE(DAT_0603af72 = FUN_0603AEE8 + 0x8A);
PROVIDE(DAT_0603b270 = FUN_0603B21C + 0x54);
PROVIDE(DAT_0603b4c6 = FUN_0603B424 + 0xA2);
PROVIDE(DAT_0603b4c8 = FUN_0603B424 + 0xA4);
PROVIDE(DAT_0603b4ca = FUN_0603B424 + 0xA6);
PROVIDE(DAT_0603b4cc = FUN_0603B424 + 0xA8);
PROVIDE(DAT_0603b4ce = FUN_0603B424 + 0xAA);
PROVIDE(DAT_0603b7a4 = FUN_0603B74C + 0x58);
PROVIDE(DAT_0603b7a6 = FUN_0603B74C + 0x5A);
PROVIDE(DAT_0603b7a8 = FUN_0603B74C + 0x5C);
PROVIDE(DAT_0603b7aa = FUN_0603B74C + 0x5E);
PROVIDE(DAT_0603b838 = FUN_0603B7C0 + 0x78);
PROVIDE(DAT_0603b83a = FUN_0603B7C0 + 0x7A);
PROVIDE(DAT_0603b88c = FUN_0603B7C0 + 0xCC);
PROVIDE(DAT_0603b88e = FUN_0603B7C0 + 0xCE);
PROVIDE(DAT_0603b91e = FUN_0603B8B4 + 0x6A);
PROVIDE(DAT_0603bae6 = FUN_0603BAC6 + 0x20);
PROVIDE(DAT_0603bbb0 = FUN_0603BB86 + 0x2A);
PROVIDE(DAT_0603bbb4 = FUN_0603BB86 + 0x2E);
PROVIDE(DAT_0603bbb6 = FUN_0603BB86 + 0x30);
PROVIDE(DAT_0603bc50 = FUN_0603BC12 + 0x3E);
PROVIDE(DAT_0603bc52 = FUN_0603BC12 + 0x40);
PROVIDE(DAT_0603bc54 = FUN_0603BC12 + 0x42);
PROVIDE(DAT_0603bc56 = FUN_0603BC12 + 0x44);
PROVIDE(DAT_0603bf6e = FUN_0603BF22 + 0x4C);
PROVIDE(DAT_0603c07a = FUN_0603BF22 + 0x158);
PROVIDE(DAT_0603c496 = FUN_0603C1A8 + 0x2EE);
PROVIDE(DAT_0603c49a = FUN_0603C1A8 + 0x2F2);
PROVIDE(DAT_0603c49c = FUN_0603C1A8 + 0x2F4);
PROVIDE(DAT_0603c7ea = FUN_0603C728 + 0xC2);
PROVIDE(DAT_0603c8d4 = FUN_0603C728 + 0x1AC);
PROVIDE(DAT_0603cade = FUN_0603C728 + 0x3B6);
PROVIDE(DAT_0603cae0 = FUN_0603C728 + 0x3B8);
PROVIDE(DAT_0603cae2 = FUN_0603C728 + 0x3BA);
PROVIDE(DAT_0603cd4c = FUN_0603CC88 + 0xC4);
PROVIDE(DAT_0603ce8e = FUN_0603CD5C + 0x132);
PROVIDE(DAT_0603ce90 = FUN_0603CD5C + 0x134);
PROVIDE(DAT_0603d034 = FUN_0603CD5C + 0x2D8);
PROVIDE(DAT_0603d1c2 = FUN_0603CD5C + 0x466);
PROVIDE(DAT_0603d426 = FUN_0603D3A8 + 0x7E);
PROVIDE(DAT_0603d500 = FUN_0603D43C + 0xC4);
PROVIDE(DAT_0603d5be = FUN_0603D518 + 0xA6);
PROVIDE(DAT_0603e0b2 = FUN_0603E050 + 0x62);
PROVIDE(DAT_0603e3b6 = FUN_0603E050 + 0x366);
PROVIDE(DAT_0603e3b8 = FUN_0603E050 + 0x368);
PROVIDE(DAT_0603e3ba = FUN_0603E050 + 0x36A);
PROVIDE(DAT_0603e3bc = FUN_0603E050 + 0x36C);
PROVIDE(DAT_0603e61e = FUN_0603E5BC + 0x62);
PROVIDE(DAT_0603e93a = FUN_0603E5BC + 0x37E);
PROVIDE(DAT_0603e93c = FUN_0603E5BC + 0x380);
PROVIDE(DAT_0603e93e = FUN_0603E5BC + 0x382);
PROVIDE(DAT_0603ea46 = FUN_0603E5BC + 0x48A);
PROVIDE(DAT_0603ef8a = FUN_0603EF64 + 0x26);
PROVIDE(DAT_0603eff4 = FUN_0603EF64 + 0x90);
PROVIDE(DAT_0603f682 = FUN_0603F582 + 0x100);
PROVIDE(DAT_0603f8ae = FUN_0603F582 + 0x32C);
PROVIDE(DAT_0603fb22 = FUN_0603FAE4 + 0x3E);
PROVIDE(DAT_0603fb24 = FUN_0603FAE4 + 0x40);
PROVIDE(DAT_0603fcb6 = FUN_0603FC60 + 0x56);
PROVIDE(DAT_0604009e = FUN_06040010 + 0x8E);
PROVIDE(DAT_060401e8 = FUN_060400D6 + 0x112);
PROVIDE(DAT_0604089c = FUN_0604087C + 0x20);
PROVIDE(DAT_06040d2c = FUN_06040C98 + 0x94);
PROVIDE(DAT_06040dc0 = FUN_06040C98 + 0x128);
PROVIDE(DAT_06040dc2 = FUN_06040C98 + 0x12A);
PROVIDE(DAT_06040e72 = FUN_06040C98 + 0x1DA);
PROVIDE(DAT_06041174 = FUN_06041128 + 0x4C);
PROVIDE(DAT_060411f6 = FUN_060411A0 + 0x56);
PROVIDE(DAT_0604155c = FUN_060414D0 + 0x8C);
PROVIDE(DAT_0604155e = FUN_060414D0 + 0x8E);
PROVIDE(DAT_060415ee = FUN_060415C8 + 0x26);
PROVIDE(DAT_060417d8 = FUN_060416A8 + 0x130);
PROVIDE(DAT_060417da = FUN_060416A8 + 0x132);
PROVIDE(DAT_06041b0a = FUN_06041AA0 + 0x6A);
PROVIDE(DAT_06041bc6 = FUN_06041B3C + 0x8A);
PROVIDE(DAT_06041bc8 = FUN_06041B3C + 0x8C);
PROVIDE(DAT_06041bcc = FUN_06041B3C + 0x90);
PROVIDE(DAT_06041bd2 = FUN_06041B3C + 0x96);
PROVIDE(DAT_06041ca8 = FUN_06041B3C + 0x16C);
PROVIDE(DAT_06041caa = FUN_06041B3C + 0x16E);
PROVIDE(DAT_06041d5a = FUN_06041CC8 + 0x92);
PROVIDE(DAT_06041df0 = FUN_06041D74 + 0x7C);
PROVIDE(DAT_06041df2 = FUN_06041D74 + 0x7E);
PROVIDE(DAT_06041eb6 = FUN_06041D74 + 0x142);
PROVIDE(DAT_06041f90 = FUN_06041EE8 + 0xA8);
PROVIDE(DAT_06041f94 = FUN_06041EE8 + 0xAC);
PROVIDE(DAT_06041f96 = FUN_06041EE8 + 0xAE);
PROVIDE(DAT_0604207c = FUN_06041EE8 + 0x194);
PROVIDE(DAT_0604207e = FUN_06041EE8 + 0x196);
PROVIDE(DAT_06042120 = FUN_06042088 + 0x98);
PROVIDE(DAT_06042122 = FUN_06042088 + 0x9A);
PROVIDE(DAT_0604222c = FUN_06042134 + 0xF8);
PROVIDE(DAT_0604222e = FUN_06042134 + 0xFA);
PROVIDE(DAT_0604230a = FUN_060422F0 + 0x1A);
PROVIDE(DAT_0604230c = FUN_060422F0 + 0x1C);
PROVIDE(DAT_06042398 = FUN_060422F0 + 0xA8);
PROVIDE(DAT_0604239a = FUN_060422F0 + 0xAA);
PROVIDE(DAT_060424c8 = FUN_06042458 + 0x70);
PROVIDE(DAT_060424ca = FUN_06042458 + 0x72);
PROVIDE(DAT_06042ba6 = FUN_06042ACA + 0xDC);
PROVIDE(DAT_06042c7a = FUN_06042BEE + 0x8C);
PROVIDE(DAT_06082A7C = 0x06082A7C);
PROVIDE(DAT_06083264 = 0x06083264);
PROVIDE(DAT_06083268 = 0x06083268);
/* Synthetic symbols -- fixed (data/system range) (863) */
PROVIDE(sym_0600026C = 0x0600026C);
PROVIDE(sym_06000300 = 0x06000300);
PROVIDE(sym_06000310 = 0x06000310);
PROVIDE(sym_06000320 = 0x06000320);
PROVIDE(sym_06000324 = 0x06000324);
PROVIDE(sym_06000340 = 0x06000340);
PROVIDE(sym_06000344 = 0x06000344);
PROVIDE(sym_06000348 = 0x06000348);
PROVIDE(sym_06000354 = 0x06000354);
PROVIDE(sym_06000358 = 0x06000358);
PROVIDE(sym_0602FD9B = FUN_0602F9A6 + 0x3F5);
PROVIDE(sym_0602FD9D = FUN_0602F9A6 + 0x3F7);
PROVIDE(sym_0602FD9F = FUN_0602F9A6 + 0x3F9);
PROVIDE(sym_0602FDA1 = FUN_0602F9A6 + 0x3FB);
PROVIDE(sym_0604475D = FUN_06042BEE + 0x1B6F);
PROVIDE(sym_060448B5 = FUN_06042BEE + 0x1CC7);
PROVIDE(sym_06047DDF = FUN_06046E48 + 0xF97);
PROVIDE(sym_06059C7B = FUN_06046E48 + 0x12E33);
PROVIDE(sym_06059CA7 = FUN_06046E48 + 0x12E5F);
PROVIDE(sym_06059CAD = FUN_06046E48 + 0x12E65);
PROVIDE(sym_06059F6F = FUN_06046E48 + 0x13127);
PROVIDE(sym_0605A1D5 = FUN_06046E48 + 0x1338D);
PROVIDE(sym_0605A1DD = FUN_06046E48 + 0x13395);
PROVIDE(sym_0605AB17 = FUN_06046E48 + 0x13CCF);
PROVIDE(sym_0605AB19 = FUN_06046E48 + 0x13CD1);
PROVIDE(sym_0605ACDD = FUN_06046E48 + 0x13E95);
PROVIDE(sym_0605ACDF = FUN_06046E48 + 0x13E97);
PROVIDE(sym_0605ACE1 = FUN_06046E48 + 0x13E99);
PROVIDE(sym_0605ACE3 = FUN_06046E48 + 0x13E9B);
PROVIDE(sym_0605ACE5 = FUN_06046E48 + 0x13E9D);
PROVIDE(sym_0605ACF3 = FUN_06046E48 + 0x13EAB);
PROVIDE(sym_0605B821 = FUN_06046E48 + 0x149D9);
PROVIDE(sym_0605BE33 = FUN_06046E48 + 0x14FEB);
PROVIDE(sym_0605BE35 = FUN_06046E48 + 0x14FED);
PROVIDE(sym_0605D241 = FUN_06046E48 + 0x163F9);
PROVIDE(sym_0605D243 = FUN_06046E48 + 0x163FB);
PROVIDE(sym_0605D245 = FUN_06046E48 + 0x163FD);
PROVIDE(sym_0605D4F5 = FUN_06046E48 + 0x166AD);
PROVIDE(sym_0605D4F7 = FUN_06046E48 + 0x166AF);
PROVIDE(sym_0605DF23 = FUN_06046E48 + 0x170DB);
PROVIDE(sym_0605DF37 = FUN_06046E48 + 0x170EF);
PROVIDE(sym_0605DF57 = FUN_06046E48 + 0x1710F);
PROVIDE(sym_0605DFED = FUN_06046E48 + 0x171A5);
PROVIDE(sym_0605E05D = FUN_06046E48 + 0x17215);
PROVIDE(sym_0605E0A1 = FUN_06046E48 + 0x17259);
PROVIDE(sym_06060A40 = FUN_06046E48 + 0x19BF8);
PROVIDE(sym_06060A48 = FUN_06046E48 + 0x19C00);
PROVIDE(sym_06060D2A = FUN_06046E48 + 0x19EE2);
PROVIDE(sym_06060D34 = FUN_06046E48 + 0x19EEC);
PROVIDE(sym_06060D40 = FUN_06046E48 + 0x19EF8);
PROVIDE(sym_06060D42 = FUN_06046E48 + 0x19EFA);
PROVIDE(sym_06060D44 = FUN_06046E48 + 0x19EFC);
PROVIDE(sym_06060D46 = FUN_06046E48 + 0x19EFE);
PROVIDE(sym_06060D48 = FUN_06046E48 + 0x19F00);
PROVIDE(sym_06060D4A = FUN_06046E48 + 0x19F02);
PROVIDE(sym_06060D4C = FUN_06046E48 + 0x19F04);
PROVIDE(sym_06060D4E = FUN_06046E48 + 0x19F06);
PROVIDE(sym_06060D50 = FUN_06046E48 + 0x19F08);
PROVIDE(sym_06060D54 = FUN_06046E48 + 0x19F0C);
PROVIDE(sym_06060D58 = FUN_06046E48 + 0x19F10);
PROVIDE(sym_06060D5C = FUN_06046E48 + 0x19F14);
PROVIDE(sym_06060D5E = FUN_06046E48 + 0x19F16);
PROVIDE(sym_06060D60 = FUN_06046E48 + 0x19F18);
PROVIDE(sym_06060D62 = FUN_06046E48 + 0x19F1A);
PROVIDE(sym_06060D64 = FUN_06046E48 + 0x19F1C);
PROVIDE(sym_06060D66 = FUN_06046E48 + 0x19F1E);
PROVIDE(sym_06060D68 = FUN_06046E48 + 0x19F20);
PROVIDE(sym_06060D6A = FUN_06046E48 + 0x19F22);
PROVIDE(sym_06060D6C = FUN_06046E48 + 0x19F24);
PROVIDE(sym_06060D70 = FUN_06046E48 + 0x19F28);
PROVIDE(sym_06060D74 = FUN_06046E48 + 0x19F2C);
PROVIDE(sym_06060D78 = FUN_06046E48 + 0x19F30);
PROVIDE(sym_06060D7C = FUN_06046E48 + 0x19F34);
PROVIDE(sym_06060F2C = FUN_06046E48 + 0x1A0E4);
PROVIDE(sym_0606107C = FUN_06046E48 + 0x1A234);
PROVIDE(sym_060610BC = FUN_06046E48 + 0x1A274);
PROVIDE(sym_06061170 = FUN_06046E48 + 0x1A328);
PROVIDE(sym_06061184 = FUN_06046E48 + 0x1A33C);
PROVIDE(sym_06061198 = FUN_06046E48 + 0x1A350);
PROVIDE(sym_06061199 = FUN_06046E48 + 0x1A351);
PROVIDE(sym_0606119C = FUN_06046E48 + 0x1A354);
PROVIDE(sym_060611DC = FUN_06046E48 + 0x1A394);
PROVIDE(sym_060611FC = FUN_06046E48 + 0x1A3B4);
PROVIDE(sym_06061238 = FUN_06046E48 + 0x1A3F0);
PROVIDE(sym_0606123A = FUN_06046E48 + 0x1A3F2);
PROVIDE(sym_0606123C = FUN_06046E48 + 0x1A3F4);
PROVIDE(sym_0606123E = FUN_06046E48 + 0x1A3F6);
PROVIDE(sym_06061240 = FUN_06046E48 + 0x1A3F8);
PROVIDE(sym_06061270 = FUN_06046E48 + 0x1A428);
PROVIDE(sym_0606128A = FUN_06046E48 + 0x1A442);
PROVIDE(sym_06061294 = FUN_06046E48 + 0x1A44C);
PROVIDE(sym_06061298 = FUN_06046E48 + 0x1A450);
PROVIDE(sym_0606129C = FUN_06046E48 + 0x1A454);
PROVIDE(sym_060612A0 = FUN_06046E48 + 0x1A458);
PROVIDE(sym_060612AC = FUN_06046E48 + 0x1A464);
PROVIDE(sym_060612B0 = FUN_06046E48 + 0x1A468);
PROVIDE(sym_060612B4 = FUN_06046E48 + 0x1A46C);
PROVIDE(sym_060612B8 = FUN_06046E48 + 0x1A470);
PROVIDE(sym_060612C4 = FUN_06046E48 + 0x1A47C);
PROVIDE(sym_060620C4 = FUN_06046E48 + 0x1B27C);
PROVIDE(sym_060620D0 = FUN_06046E48 + 0x1B288);
PROVIDE(sym_060620D4 = FUN_06046E48 + 0x1B28C);
PROVIDE(sym_060620D8 = FUN_06046E48 + 0x1B290);
PROVIDE(sym_060620DC = FUN_06046E48 + 0x1B294);
PROVIDE(sym_060620E0 = FUN_06046E48 + 0x1B298);
PROVIDE(sym_060620E4 = FUN_06046E48 + 0x1B29C);
PROVIDE(sym_060620E8 = FUN_06046E48 + 0x1B2A0);
PROVIDE(sym_0606212C = FUN_06046E48 + 0x1B2E4);
PROVIDE(sym_06062130 = FUN_06046E48 + 0x1B2E8);
PROVIDE(sym_0606213C = FUN_06046E48 + 0x1B2F4);
PROVIDE(sym_06062180 = FUN_06046E48 + 0x1B338);
PROVIDE(sym_06062184 = FUN_06046E48 + 0x1B33C);
PROVIDE(sym_06062188 = FUN_06046E48 + 0x1B340);
PROVIDE(sym_0606218C = FUN_06046E48 + 0x1B344);
PROVIDE(sym_06062190 = FUN_06046E48 + 0x1B348);
PROVIDE(sym_060621D8 = FUN_06046E48 + 0x1B390);
PROVIDE(sym_060621DC = FUN_06046E48 + 0x1B394);
PROVIDE(sym_060621E0 = FUN_06046E48 + 0x1B398);
PROVIDE(sym_060621E4 = FUN_06046E48 + 0x1B39C);
PROVIDE(sym_060621E8 = FUN_06046E48 + 0x1B3A0);
PROVIDE(sym_06062230 = FUN_06046E48 + 0x1B3E8);
PROVIDE(sym_06062248 = FUN_06046E48 + 0x1B400);
PROVIDE(sym_06062260 = FUN_06046E48 + 0x1B418);
PROVIDE(sym_06062290 = FUN_06046E48 + 0x1B448);
PROVIDE(sym_0606229C = FUN_06046E48 + 0x1B454);
PROVIDE(sym_060622A8 = FUN_06046E48 + 0x1B460);
PROVIDE(sym_060622B4 = FUN_06046E48 + 0x1B46C);
PROVIDE(sym_060622C0 = FUN_06046E48 + 0x1B478);
PROVIDE(sym_06062334 = FUN_06046E48 + 0x1B4EC);
PROVIDE(sym_06062338 = FUN_06046E48 + 0x1B4F0);
PROVIDE(sym_060623AC = FUN_06046E48 + 0x1B564);
PROVIDE(sym_060623B0 = FUN_06046E48 + 0x1B568);
PROVIDE(sym_060623C8 = FUN_06046E48 + 0x1B580);
PROVIDE(sym_06062464 = FUN_06046E48 + 0x1B61C);
PROVIDE(sym_0606247C = FUN_06046E48 + 0x1B634);
PROVIDE(sym_060624A4 = FUN_06046E48 + 0x1B65C);
PROVIDE(sym_060624C8 = FUN_06046E48 + 0x1B680);
PROVIDE(sym_060624F8 = FUN_06046E48 + 0x1B6B0);
PROVIDE(sym_060625C4 = FUN_06046E48 + 0x1B77C);
PROVIDE(sym_06062624 = FUN_06046E48 + 0x1B7DC);
PROVIDE(sym_06062780 = FUN_06046E48 + 0x1B938);
PROVIDE(sym_060627F8 = FUN_06046E48 + 0x1B9B0);
PROVIDE(sym_06062820 = FUN_06046E48 + 0x1B9D8);
PROVIDE(sym_06062874 = FUN_06046E48 + 0x1BA2C);
PROVIDE(sym_060628C8 = FUN_06046E48 + 0x1BA80);
PROVIDE(sym_0606291C = FUN_06046E48 + 0x1BAD4);
PROVIDE(sym_06062970 = FUN_06046E48 + 0x1BB28);
PROVIDE(sym_0606298C = FUN_06046E48 + 0x1BB44);
PROVIDE(sym_0606299A = FUN_06046E48 + 0x1BB52);
PROVIDE(sym_0606299C = FUN_06046E48 + 0x1BB54);
PROVIDE(sym_060629AA = FUN_06046E48 + 0x1BB62);
PROVIDE(sym_060629AC = FUN_06046E48 + 0x1BB64);
PROVIDE(sym_06062D95 = FUN_06046E48 + 0x1BF4D);
PROVIDE(sym_0606318C = FUN_06046E48 + 0x1C344);
PROVIDE(sym_06063190 = FUN_06046E48 + 0x1C348);
PROVIDE(sym_060631AC = FUN_06046E48 + 0x1C364);
PROVIDE(sym_060631B4 = FUN_06046E48 + 0x1C36C);
PROVIDE(sym_060631B8 = FUN_06046E48 + 0x1C370);
PROVIDE(sym_060631BC = FUN_06046E48 + 0x1C374);
PROVIDE(sym_06063434 = FUN_06046E48 + 0x1C5EC);
PROVIDE(sym_06063450 = FUN_06046E48 + 0x1C608);
PROVIDE(sym_0606346C = FUN_06046E48 + 0x1C624);
PROVIDE(sym_06063488 = FUN_06046E48 + 0x1C640);
PROVIDE(sym_060634A4 = FUN_06046E48 + 0x1C65C);
PROVIDE(sym_060634C0 = FUN_06046E48 + 0x1C678);
PROVIDE(sym_060634DC = FUN_06046E48 + 0x1C694);
PROVIDE(sym_060634F4 = FUN_06046E48 + 0x1C6AC);
PROVIDE(sym_060634F8 = FUN_06046E48 + 0x1C6B0);
PROVIDE(sym_06063510 = FUN_06046E48 + 0x1C6C8);
PROVIDE(sym_06063514 = FUN_06046E48 + 0x1C6CC);
PROVIDE(sym_06063520 = FUN_06046E48 + 0x1C6D8);
PROVIDE(sym_0606352C = FUN_06046E48 + 0x1C6E4);
PROVIDE(sym_06063538 = FUN_06046E48 + 0x1C6F0);
PROVIDE(sym_06063544 = FUN_06046E48 + 0x1C6FC);
PROVIDE(sym_0606354C = FUN_06046E48 + 0x1C704);
PROVIDE(sym_06063554 = FUN_06046E48 + 0x1C70C);
PROVIDE(sym_06063558 = FUN_06046E48 + 0x1C710);
PROVIDE(sym_0606355C = FUN_06046E48 + 0x1C714);
PROVIDE(sym_06063564 = FUN_06046E48 + 0x1C71C);
PROVIDE(sym_0606356C = FUN_06046E48 + 0x1C724);
PROVIDE(sym_06063570 = FUN_06046E48 + 0x1C728);
PROVIDE(sym_06063574 = FUN_06046E48 + 0x1C72C);
PROVIDE(sym_06063578 = FUN_06046E48 + 0x1C730);
PROVIDE(sym_06063580 = FUN_06046E48 + 0x1C738);
PROVIDE(sym_06063584 = FUN_06046E48 + 0x1C73C);
PROVIDE(sym_0606358C = FUN_06046E48 + 0x1C744);
PROVIDE(sym_06063590 = FUN_06046E48 + 0x1C748);
PROVIDE(sym_06063594 = FUN_06046E48 + 0x1C74C);
PROVIDE(sym_060635A0 = FUN_06046E48 + 0x1C758);
PROVIDE(sym_060635A2 = FUN_06046E48 + 0x1C75A);
PROVIDE(sym_060635A8 = FUN_06046E48 + 0x1C760);
PROVIDE(sym_060635AC = FUN_06046E48 + 0x1C764);
PROVIDE(sym_060635AE = FUN_06046E48 + 0x1C766);
PROVIDE(sym_060635B0 = FUN_06046E48 + 0x1C768);
PROVIDE(sym_060635B2 = FUN_06046E48 + 0x1C76A);
PROVIDE(sym_060635B4 = FUN_06046E48 + 0x1C76C);
PROVIDE(sym_060635B8 = FUN_06046E48 + 0x1C770);
PROVIDE(sym_060635BC = FUN_06046E48 + 0x1C774);
PROVIDE(sym_060635C0 = FUN_06046E48 + 0x1C778);
PROVIDE(sym_060635C4 = FUN_06046E48 + 0x1C77C);
PROVIDE(sym_060635C8 = FUN_06046E48 + 0x1C780);
PROVIDE(sym_060635CC = FUN_06046E48 + 0x1C784);
PROVIDE(sym_060635D0 = FUN_06046E48 + 0x1C788);
PROVIDE(sym_060635D2 = FUN_06046E48 + 0x1C78A);
PROVIDE(sym_060635D4 = FUN_06046E48 + 0x1C78C);
PROVIDE(sym_060635D6 = FUN_06046E48 + 0x1C78E);
PROVIDE(sym_060635D8 = FUN_06046E48 + 0x1C790);
PROVIDE(sym_060635DA = FUN_06046E48 + 0x1C792);
PROVIDE(sym_060635DC = FUN_06046E48 + 0x1C794);
PROVIDE(sym_060635DE = FUN_06046E48 + 0x1C796);
PROVIDE(sym_060635E0 = FUN_06046E48 + 0x1C798);
PROVIDE(sym_06063600 = FUN_06046E48 + 0x1C7B8);
PROVIDE(sym_06063601 = FUN_06046E48 + 0x1C7B9);
PROVIDE(sym_06063602 = FUN_06046E48 + 0x1C7BA);
PROVIDE(sym_06063608 = FUN_06046E48 + 0x1C7C0);
PROVIDE(sym_0606360C = FUN_06046E48 + 0x1C7C4);
PROVIDE(sym_06063610 = FUN_06046E48 + 0x1C7C8);
PROVIDE(sym_06063614 = FUN_06046E48 + 0x1C7CC);
PROVIDE(sym_06063618 = FUN_06046E48 + 0x1C7D0);
PROVIDE(sym_0606361C = FUN_06046E48 + 0x1C7D4);
PROVIDE(sym_06063620 = FUN_06046E48 + 0x1C7D8);
PROVIDE(sym_06063624 = FUN_06046E48 + 0x1C7DC);
PROVIDE(sym_0606364C = FUN_06046E48 + 0x1C804);
PROVIDE(sym_0606367C = FUN_06046E48 + 0x1C834);
PROVIDE(sym_06063690 = 0x06063690);
PROVIDE(sym_06063750 = 0x06063750);
PROVIDE(sym_06063788 = 0x06063788);
PROVIDE(sym_06063790 = 0x06063790);
PROVIDE(sym_06063798 = 0x06063798);
PROVIDE(sym_060637F8 = 0x060637F8);
PROVIDE(sym_06063800 = 0x06063800);
PROVIDE(sym_06063808 = 0x06063808);
PROVIDE(sym_06063810 = 0x06063810);
PROVIDE(sym_06063818 = 0x06063818);
PROVIDE(sym_06063828 = 0x06063828);
PROVIDE(sym_06063838 = 0x06063838);
PROVIDE(sym_06063848 = 0x06063848);
PROVIDE(sym_06063850 = 0x06063850);
PROVIDE(sym_060638A0 = 0x060638A0);
PROVIDE(sym_060638B0 = 0x060638B0);
PROVIDE(sym_060638C8 = 0x060638C8);
PROVIDE(sym_06063918 = 0x06063918);
PROVIDE(sym_06063920 = 0x06063920);
PROVIDE(sym_06063958 = 0x06063958);
PROVIDE(sym_06063960 = 0x06063960);
PROVIDE(sym_06063968 = 0x06063968);
PROVIDE(sym_06063970 = 0x06063970);
PROVIDE(sym_060639D8 = 0x060639D8);
PROVIDE(sym_060639E0 = 0x060639E0);
PROVIDE(sym_060639F8 = 0x060639F8);
PROVIDE(sym_06063AD0 = 0x06063AD0);
PROVIDE(sym_06063AF0 = 0x06063AF0);
PROVIDE(sym_06063AF8 = 0x06063AF8);
PROVIDE(sym_06063B80 = 0x06063B80);
PROVIDE(sym_06063B88 = 0x06063B88);
PROVIDE(sym_06063C90 = 0x06063C90);
PROVIDE(sym_06063C98 = 0x06063C98);
PROVIDE(sym_06063CA0 = 0x06063CA0);
PROVIDE(sym_06063CF8 = 0x06063CF8);
PROVIDE(sym_06063D00 = 0x06063D00);
PROVIDE(sym_06063D08 = 0x06063D08);
PROVIDE(sym_06063D90 = 0x06063D90);
PROVIDE(sym_06063D94 = 0x06063D94);
PROVIDE(sym_06063D98 = 0x06063D98);
PROVIDE(sym_06063D9A = 0x06063D9A);
PROVIDE(sym_06063D9C = 0x06063D9C);
PROVIDE(sym_06063D9E = 0x06063D9E);
PROVIDE(sym_06063DA0 = 0x06063DA0);
PROVIDE(sym_06063DA8 = 0x06063DA8);
PROVIDE(sym_06063DF8 = 0x06063DF8);
PROVIDE(sym_06063E04 = 0x06063E04);
PROVIDE(sym_06063E08 = 0x06063E08);
PROVIDE(sym_06063E0C = 0x06063E0C);
PROVIDE(sym_06063E10 = 0x06063E10);
PROVIDE(sym_06063E14 = 0x06063E14);
PROVIDE(sym_06063E1C = 0x06063E1C);
PROVIDE(sym_06063E20 = 0x06063E20);
PROVIDE(sym_06063E24 = 0x06063E24);
PROVIDE(sym_06063E28 = 0x06063E28);
PROVIDE(sym_06063E2C = 0x06063E2C);
PROVIDE(sym_06063E30 = 0x06063E30);
PROVIDE(sym_06063E34 = 0x06063E34);
PROVIDE(sym_06063E4C = 0x06063E4C);
PROVIDE(sym_06063E50 = 0x06063E50);
PROVIDE(sym_06063E60 = 0x06063E60);
PROVIDE(sym_06063E64 = 0x06063E64);
PROVIDE(sym_06063E74 = 0x06063E74);
PROVIDE(sym_06063E78 = 0x06063E78);
PROVIDE(sym_06063E88 = 0x06063E88);
PROVIDE(sym_06063E8C = 0x06063E8C);
PROVIDE(sym_06063E9C = 0x06063E9C);
PROVIDE(sym_06063EB0 = 0x06063EB0);
PROVIDE(sym_06063EC4 = 0x06063EC4);
PROVIDE(sym_06063ED8 = 0x06063ED8);
PROVIDE(sym_06063EEC = 0x06063EEC);
PROVIDE(sym_06063EF0 = 0x06063EF0);
PROVIDE(sym_06063EF8 = 0x06063EF8);
PROVIDE(sym_06063F04 = 0x06063F04);
PROVIDE(sym_06063F08 = 0x06063F08);
PROVIDE(sym_06063F10 = 0x06063F10);
PROVIDE(sym_06063F14 = 0x06063F14);
PROVIDE(sym_06063F18 = 0x06063F18);
PROVIDE(sym_06063F1C = 0x06063F1C);
PROVIDE(sym_06063F20 = 0x06063F20);
PROVIDE(sym_06063F24 = 0x06063F24);
PROVIDE(sym_06063F28 = 0x06063F28);
PROVIDE(sym_06063F3C = 0x06063F3C);
PROVIDE(sym_06063F42 = 0x06063F42);
PROVIDE(sym_06063F44 = 0x06063F44);
PROVIDE(sym_06063F46 = 0x06063F46);
PROVIDE(sym_06063F48 = 0x06063F48);
PROVIDE(sym_06063F4A = 0x06063F4A);
PROVIDE(sym_06063F4C = 0x06063F4C);
PROVIDE(sym_06063F50 = 0x06063F50);
PROVIDE(sym_06063F54 = 0x06063F54);
PROVIDE(sym_06063F58 = 0x06063F58);
PROVIDE(sym_06063F5C = 0x06063F5C);
PROVIDE(sym_06063F60 = 0x06063F60);
PROVIDE(sym_06063F64 = 0x06063F64);
PROVIDE(sym_060684EC = 0x060684EC);
PROVIDE(sym_06069BB6 = 0x06069BB6);
PROVIDE(sym_0606A4EC = 0x0606A4EC);
PROVIDE(sym_0606A4F0 = 0x0606A4F0);
PROVIDE(sym_0606A4F4 = 0x0606A4F4);
PROVIDE(sym_0606A4F8 = 0x0606A4F8);
PROVIDE(sym_0606B178 = 0x0606B178);
PROVIDE(sym_0606BDF8 = 0x0606BDF8);
PROVIDE(sym_0606BDFC = 0x0606BDFC);
PROVIDE(sym_060785FC = 0x060785FC);
PROVIDE(sym_06078604 = 0x06078604);
PROVIDE(sym_0607861C = 0x0607861C);
PROVIDE(sym_06078620 = 0x06078620);
PROVIDE(sym_06078624 = 0x06078624);
PROVIDE(sym_06078634 = 0x06078634);
PROVIDE(sym_06078635 = 0x06078635);
PROVIDE(sym_06078636 = 0x06078636);
PROVIDE(sym_06078637 = 0x06078637);
PROVIDE(sym_06078638 = 0x06078638);
PROVIDE(sym_0607863C = 0x0607863C);
PROVIDE(sym_06078644 = 0x06078644);
PROVIDE(sym_06078648 = 0x06078648);
PROVIDE(sym_06078649 = 0x06078649);
PROVIDE(sym_0607864A = 0x0607864A);
PROVIDE(sym_0607864B = 0x0607864B);
PROVIDE(sym_0607864C = 0x0607864C);
PROVIDE(sym_06078650 = 0x06078650);
PROVIDE(sym_06078652 = 0x06078652);
PROVIDE(sym_06078654 = 0x06078654);
PROVIDE(sym_06078656 = 0x06078656);
PROVIDE(sym_06078658 = 0x06078658);
PROVIDE(sym_0607865A = 0x0607865A);
PROVIDE(sym_0607865C = 0x0607865C);
PROVIDE(sym_0607865E = 0x0607865E);
PROVIDE(sym_06078660 = 0x06078660);
PROVIDE(sym_06078662 = 0x06078662);
PROVIDE(sym_06078663 = 0x06078663);
PROVIDE(sym_06078664 = 0x06078664);
PROVIDE(sym_06078668 = 0x06078668);
PROVIDE(sym_0607866C = 0x0607866C);
PROVIDE(sym_0607866D = 0x0607866D);
PROVIDE(sym_06078670 = 0x06078670);
PROVIDE(sym_0607867C = 0x0607867C);
PROVIDE(sym_06078680 = 0x06078680);
PROVIDE(sym_06078698 = 0x06078698);
PROVIDE(sym_0607869A = 0x0607869A);
PROVIDE(sym_0607869C = 0x0607869C);
PROVIDE(sym_060786A0 = 0x060786A0);
PROVIDE(sym_060786A4 = 0x060786A4);
PROVIDE(sym_060786A8 = 0x060786A8);
PROVIDE(sym_060786AC = 0x060786AC);
PROVIDE(sym_060786B0 = 0x060786B0);
PROVIDE(sym_060786B4 = 0x060786B4);
PROVIDE(sym_060786B8 = 0x060786B8);
PROVIDE(sym_060786BC = 0x060786BC);
PROVIDE(sym_060786C0 = 0x060786C0);
PROVIDE(sym_060786C4 = 0x060786C4);
PROVIDE(sym_060786C8 = 0x060786C8);
PROVIDE(sym_060786CA = 0x060786CA);
PROVIDE(sym_060786CC = 0x060786CC);
PROVIDE(sym_0607884C = 0x0607884C);
PROVIDE(sym_06078850 = 0x06078850);
PROVIDE(sym_06078854 = 0x06078854);
PROVIDE(sym_06078858 = 0x06078858);
PROVIDE(sym_0607885C = 0x0607885C);
PROVIDE(sym_06078860 = 0x06078860);
PROVIDE(sym_06078864 = 0x06078864);
PROVIDE(sym_06078868 = 0x06078868);
PROVIDE(sym_0607886C = 0x0607886C);
PROVIDE(sym_0607886E = 0x0607886E);
PROVIDE(sym_06078870 = 0x06078870);
PROVIDE(sym_06078878 = 0x06078878);
PROVIDE(sym_0607887A = 0x0607887A);
PROVIDE(sym_0607887C = 0x0607887C);
PROVIDE(sym_0607887E = 0x0607887E);
PROVIDE(sym_0607887F = 0x0607887F);
PROVIDE(sym_06078880 = 0x06078880);
PROVIDE(sym_06078884 = 0x06078884);
PROVIDE(sym_06078888 = 0x06078888);
PROVIDE(sym_06078894 = 0x06078894);
PROVIDE(sym_06078898 = 0x06078898);
PROVIDE(sym_0607889C = 0x0607889C);
PROVIDE(sym_060788A0 = 0x060788A0);
PROVIDE(sym_060788A4 = 0x060788A4);
PROVIDE(sym_060788A8 = 0x060788A8);
PROVIDE(sym_060788AC = 0x060788AC);
PROVIDE(sym_060788B0 = 0x060788B0);
PROVIDE(sym_060788B2 = 0x060788B2);
PROVIDE(sym_060788B4 = 0x060788B4);
PROVIDE(sym_060788C0 = 0x060788C0);
PROVIDE(sym_060788CC = 0x060788CC);
PROVIDE(sym_060788D8 = 0x060788D8);
PROVIDE(sym_060788E4 = 0x060788E4);
PROVIDE(sym_060788F0 = 0x060788F0);
PROVIDE(sym_060788F4 = 0x060788F4);
PROVIDE(sym_060788F8 = 0x060788F8);
PROVIDE(sym_060788FC = 0x060788FC);
PROVIDE(sym_06078900 = 0x06078900);
PROVIDE(sym_06078B68 = 0x06078B68);
PROVIDE(sym_0607E940 = 0x0607E940);
PROVIDE(sym_0607E944 = 0x0607E944);
PROVIDE(sym_0607E948 = 0x0607E948);
PROVIDE(sym_0607E94C = 0x0607E94C);
PROVIDE(sym_0607E9EC = 0x0607E9EC);
PROVIDE(sym_0607EA8C = 0x0607EA8C);
PROVIDE(sym_0607EA98 = 0x0607EA98);
PROVIDE(sym_0607EA9C = 0x0607EA9C);
PROVIDE(sym_0607EAA0 = 0x0607EAA0);
PROVIDE(sym_0607EAAC = 0x0607EAAC);
PROVIDE(sym_0607EAB8 = 0x0607EAB8);
PROVIDE(sym_0607EABC = 0x0607EABC);
PROVIDE(sym_0607EAC0 = 0x0607EAC0);
PROVIDE(sym_0607EAC8 = 0x0607EAC8);
PROVIDE(sym_0607EACC = 0x0607EACC);
PROVIDE(sym_0607EAD0 = 0x0607EAD0);
PROVIDE(sym_0607EAD8 = 0x0607EAD8);
PROVIDE(sym_0607EADC = 0x0607EADC);
PROVIDE(sym_0607EAE0 = 0x0607EAE0);
PROVIDE(sym_0607EAE4 = 0x0607EAE4);
PROVIDE(sym_0607EAE8 = 0x0607EAE8);
PROVIDE(sym_0607EAEC = 0x0607EAEC);
PROVIDE(sym_0607EB84 = 0x0607EB84);
PROVIDE(sym_0607EB88 = 0x0607EB88);
PROVIDE(sym_0607EB8C = 0x0607EB8C);
PROVIDE(sym_0607EB94 = 0x0607EB94);
PROVIDE(sym_0607EBBC = 0x0607EBBC);
PROVIDE(sym_0607EBC0 = 0x0607EBC0);
PROVIDE(sym_0607EBC4 = 0x0607EBC4);
PROVIDE(sym_0607EBC8 = 0x0607EBC8);
PROVIDE(sym_0607EBCC = 0x0607EBCC);
PROVIDE(sym_0607EBD0 = 0x0607EBD0);
PROVIDE(sym_0607EBD4 = 0x0607EBD4);
PROVIDE(sym_0607EBDC = 0x0607EBDC);
PROVIDE(sym_0607EBE0 = 0x0607EBE0);
PROVIDE(sym_0607EBE4 = 0x0607EBE4);
PROVIDE(sym_0607EBEC = 0x0607EBEC);
PROVIDE(sym_0607EBF4 = 0x0607EBF4);
PROVIDE(sym_0607EBF8 = 0x0607EBF8);
PROVIDE(sym_0607ED88 = 0x0607ED88);
PROVIDE(sym_0607ED8C = 0x0607ED8C);
PROVIDE(sym_0607ED90 = 0x0607ED90);
PROVIDE(sym_0607ED91 = 0x0607ED91);
PROVIDE(sym_06080307 = 0x06080307);
PROVIDE(sym_06081888 = 0x06081888);
PROVIDE(sym_0608188A = 0x0608188A);
PROVIDE(sym_0608188C = 0x0608188C);
PROVIDE(sym_0608188E = 0x0608188E);
PROVIDE(sym_06081890 = 0x06081890);
PROVIDE(sym_06081892 = 0x06081892);
PROVIDE(sym_06081894 = 0x06081894);
PROVIDE(sym_06081896 = 0x06081896);
PROVIDE(sym_06081898 = 0x06081898);
PROVIDE(sym_0608215C = 0x0608215C);
PROVIDE(sym_06082A20 = 0x06082A20);
PROVIDE(sym_06082A24 = 0x06082A24);
PROVIDE(sym_06082A25 = 0x06082A25);
PROVIDE(sym_06082A26 = 0x06082A26);
PROVIDE(sym_06082A28 = 0x06082A28);
PROVIDE(sym_06082A2C = 0x06082A2C);
PROVIDE(sym_06082A30 = 0x06082A30);
PROVIDE(sym_06082A34 = 0x06082A34);
PROVIDE(sym_06082A38 = 0x06082A38);
PROVIDE(sym_06082A3C = 0x06082A3C);
PROVIDE(sym_06082A40 = 0x06082A40);
PROVIDE(sym_06082A44 = 0x06082A44);
PROVIDE(sym_06082A48 = 0x06082A48);
PROVIDE(sym_06082A50 = 0x06082A50);
PROVIDE(sym_06082A54 = 0x06082A54);
PROVIDE(sym_06082A58 = 0x06082A58);
PROVIDE(sym_06082A5C = 0x06082A5C);
PROVIDE(sym_06082A60 = 0x06082A60);
PROVIDE(sym_06082A68 = 0x06082A68);
PROVIDE(sym_06082A6C = 0x06082A6C);
PROVIDE(sym_06082A70 = 0x06082A70);
PROVIDE(sym_06082A74 = 0x06082A74);
PROVIDE(sym_06082A78 = 0x06082A78);
PROVIDE(sym_06083238 = 0x06083238);
PROVIDE(sym_0608323C = 0x0608323C);
PROVIDE(sym_06083240 = 0x06083240);
PROVIDE(sym_06083244 = 0x06083244);
PROVIDE(sym_06083250 = 0x06083250);
PROVIDE(sym_06083254 = 0x06083254);
PROVIDE(sym_06083255 = 0x06083255);
PROVIDE(sym_06083258 = 0x06083258);
PROVIDE(sym_0608325C = 0x0608325C);
PROVIDE(sym_06083260 = 0x06083260);
PROVIDE(sym_06083261 = 0x06083261);
PROVIDE(sym_06083274 = 0x06083274);
PROVIDE(sym_06084360 = 0x06084360);
PROVIDE(sym_0608436C = 0x0608436C);
PROVIDE(sym_06084AEC = 0x06084AEC);
PROVIDE(sym_06084AF0 = 0x06084AF0);
PROVIDE(sym_06084AF2 = 0x06084AF2);
PROVIDE(sym_06084AF4 = 0x06084AF4);
PROVIDE(sym_06084AF6 = 0x06084AF6);
PROVIDE(sym_06084AF8 = 0x06084AF8);
PROVIDE(sym_06084AFC = 0x06084AFC);
PROVIDE(sym_06084B00 = 0x06084B00);
PROVIDE(sym_06084B08 = 0x06084B08);
PROVIDE(sym_06084B0C = 0x06084B0C);
PROVIDE(sym_06084B10 = 0x06084B10);
PROVIDE(sym_06084B14 = 0x06084B14);
PROVIDE(sym_06084B18 = 0x06084B18);
PROVIDE(sym_06084B1C = 0x06084B1C);
PROVIDE(sym_06084B20 = 0x06084B20);
PROVIDE(sym_06084B28 = 0x06084B28);
PROVIDE(sym_06084CA8 = 0x06084CA8);
PROVIDE(sym_06084E28 = 0x06084E28);
PROVIDE(sym_06084FA8 = 0x06084FA8);
PROVIDE(sym_06084FAC = 0x06084FAC);
PROVIDE(sym_06084FB0 = 0x06084FB0);
PROVIDE(sym_06084FB4 = 0x06084FB4);
PROVIDE(sym_06084FB8 = 0x06084FB8);
PROVIDE(sym_06084FC8 = 0x06084FC8);
PROVIDE(sym_06085490 = 0x06085490);
PROVIDE(sym_06085640 = 0x06085640);
PROVIDE(sym_06085F88 = 0x06085F88);
PROVIDE(sym_06085F89 = 0x06085F89);
PROVIDE(sym_06085F8A = 0x06085F8A);
PROVIDE(sym_06085F8B = 0x06085F8B);
PROVIDE(sym_06085F8C = 0x06085F8C);
PROVIDE(sym_06085F8D = 0x06085F8D);
PROVIDE(sym_06085F8E = 0x06085F8E);
PROVIDE(sym_06085F90 = 0x06085F90);
PROVIDE(sym_06085F92 = 0x06085F92);
PROVIDE(sym_06085F94 = 0x06085F94);
PROVIDE(sym_06085F98 = 0x06085F98);
PROVIDE(sym_06085FAC = 0x06085FAC);
PROVIDE(sym_06085FBC = 0x06085FBC);
PROVIDE(sym_06085FC0 = 0x06085FC0);
PROVIDE(sym_06085FCC = 0x06085FCC);
PROVIDE(sym_06085FD0 = 0x06085FD0);
PROVIDE(sym_06085FF0 = 0x06085FF0);
PROVIDE(sym_06085FF1 = 0x06085FF1);
PROVIDE(sym_06085FF2 = 0x06085FF2);
PROVIDE(sym_06085FF3 = 0x06085FF3);
PROVIDE(sym_06085FF4 = 0x06085FF4);
PROVIDE(sym_06085FF5 = 0x06085FF5);
PROVIDE(sym_06085FF6 = 0x06085FF6);
PROVIDE(sym_06085FF7 = 0x06085FF7);
PROVIDE(sym_06085FF8 = 0x06085FF8);
PROVIDE(sym_06085FF9 = 0x06085FF9);
PROVIDE(sym_06085FFC = 0x06085FFC);
PROVIDE(sym_06086000 = 0x06086000);
PROVIDE(sym_06086004 = 0x06086004);
PROVIDE(sym_06086008 = 0x06086008);
PROVIDE(sym_0608600C = 0x0608600C);
PROVIDE(sym_0608600D = 0x0608600D);
PROVIDE(sym_0608600E = 0x0608600E);
PROVIDE(sym_0608600F = 0x0608600F);
PROVIDE(sym_06086010 = 0x06086010);
PROVIDE(sym_06086011 = 0x06086011);
PROVIDE(sym_06086012 = 0x06086012);
PROVIDE(sym_06086014 = 0x06086014);
PROVIDE(sym_06086018 = 0x06086018);
PROVIDE(sym_0608601C = 0x0608601C);
PROVIDE(sym_06086020 = 0x06086020);
PROVIDE(sym_06086024 = 0x06086024);
PROVIDE(sym_06086028 = 0x06086028);
PROVIDE(sym_0608602C = 0x0608602C);
PROVIDE(sym_06086030 = 0x06086030);
PROVIDE(sym_06086034 = 0x06086034);
PROVIDE(sym_06086038 = 0x06086038);
PROVIDE(sym_0608604C = 0x0608604C);
PROVIDE(sym_06086050 = 0x06086050);
PROVIDE(sym_06086054 = 0x06086054);
PROVIDE(sym_06086056 = 0x06086056);
PROVIDE(sym_06086058 = 0x06086058);
PROVIDE(sym_0608605A = 0x0608605A);
PROVIDE(sym_06087060 = 0x06087060);
PROVIDE(sym_06087064 = 0x06087064);
PROVIDE(sym_06087068 = 0x06087068);
PROVIDE(sym_0608706A = 0x0608706A);
PROVIDE(sym_0608706C = 0x0608706C);
PROVIDE(sym_06087070 = 0x06087070);
PROVIDE(sym_06087074 = 0x06087074);
PROVIDE(sym_0608707C = 0x0608707C);
PROVIDE(sym_06087080 = 0x06087080);
PROVIDE(sym_06087084 = 0x06087084);
PROVIDE(sym_06087086 = 0x06087086);
PROVIDE(sym_06087094 = 0x06087094);
PROVIDE(sym_060870F4 = 0x060870F4);
PROVIDE(sym_060877B4 = 0x060877B4);
PROVIDE(sym_060877D8 = 0x060877D8);
PROVIDE(sym_060877D9 = 0x060877D9);
PROVIDE(sym_060877DD = 0x060877DD);
PROVIDE(sym_060877E4 = 0x060877E4);
PROVIDE(sym_060877E8 = 0x060877E8);
PROVIDE(sym_060877F0 = 0x060877F0);
PROVIDE(sym_060877F4 = 0x060877F4);
PROVIDE(sym_060877F8 = 0x060877F8);
PROVIDE(sym_060877FC = 0x060877FC);
PROVIDE(sym_06087800 = 0x06087800);
PROVIDE(sym_06087802 = 0x06087802);
PROVIDE(sym_06087804 = 0x06087804);
PROVIDE(sym_06087806 = 0x06087806);
PROVIDE(sym_06087808 = 0x06087808);
PROVIDE(sym_0608780A = 0x0608780A);
PROVIDE(sym_0608780C = 0x0608780C);
PROVIDE(sym_06087810 = 0x06087810);
PROVIDE(sym_06087814 = 0x06087814);
PROVIDE(sym_06087818 = 0x06087818);
PROVIDE(sym_0608781C = 0x0608781C);
PROVIDE(sym_06087820 = 0x06087820);
PROVIDE(sym_06087824 = 0x06087824);
PROVIDE(sym_06087825 = 0x06087825);
PROVIDE(sym_06087826 = 0x06087826);
PROVIDE(sym_06087828 = 0x06087828);
PROVIDE(sym_0608782C = 0x0608782C);
PROVIDE(sym_06087C6C = 0x06087C6C);
PROVIDE(sym_06087C84 = 0x06087C84);
PROVIDE(sym_06087C87 = 0x06087C87);
PROVIDE(sym_06089594 = 0x06089594);
PROVIDE(sym_06089595 = 0x06089595);
PROVIDE(sym_06089598 = 0x06089598);
PROVIDE(sym_0608959C = 0x0608959C);
PROVIDE(sym_060895A0 = 0x060895A0);
PROVIDE(sym_0608962C = 0x0608962C);
PROVIDE(sym_060896B8 = 0x060896B8);
PROVIDE(sym_06089744 = 0x06089744);
PROVIDE(sym_060897D0 = 0x060897D0);
PROVIDE(sym_06089B18 = 0x06089B18);
PROVIDE(sym_06089C58 = 0x06089C58);
PROVIDE(sym_06089D98 = 0x06089D98);
PROVIDE(sym_06089DB4 = 0x06089DB4);
PROVIDE(sym_06089DD0 = 0x06089DD0);
PROVIDE(sym_06089DEC = 0x06089DEC);
PROVIDE(sym_06089E08 = 0x06089E08);
PROVIDE(sym_06089E24 = 0x06089E24);
PROVIDE(sym_06089E28 = 0x06089E28);
PROVIDE(sym_06089E2C = 0x06089E2C);
PROVIDE(sym_06089E30 = 0x06089E30);
PROVIDE(sym_06089E34 = 0x06089E34);
PROVIDE(sym_06089E38 = 0x06089E38);
PROVIDE(sym_06089E3C = 0x06089E3C);
PROVIDE(sym_06089E40 = 0x06089E40);
PROVIDE(sym_06089E44 = 0x06089E44);
PROVIDE(sym_06089E46 = 0x06089E46);
PROVIDE(sym_06089E4A = 0x06089E4A);
PROVIDE(sym_06089E96 = 0x06089E96);
PROVIDE(sym_06089E98 = 0x06089E98);
PROVIDE(sym_06089E9C = 0x06089E9C);
PROVIDE(sym_06089E9E = 0x06089E9E);
PROVIDE(sym_06089EA0 = 0x06089EA0);
PROVIDE(sym_06089EC4 = 0x06089EC4);
PROVIDE(sym_06089EC6 = 0x06089EC6);
PROVIDE(sym_06089EC8 = 0x06089EC8);
PROVIDE(sym_06089ECC = 0x06089ECC);
PROVIDE(sym_06089ED0 = 0x06089ED0);
PROVIDE(sym_06089ED4 = 0x06089ED4);
PROVIDE(sym_06089ED6 = 0x06089ED6);
PROVIDE(sym_06089ED8 = 0x06089ED8);
PROVIDE(sym_06089EDA = 0x06089EDA);
PROVIDE(sym_06089EDC = 0x06089EDC);
PROVIDE(sym_06089EE0 = 0x06089EE0);
PROVIDE(sym_0608A4E0 = 0x0608A4E0);
PROVIDE(sym_0608A4F0 = 0x0608A4F0);
PROVIDE(sym_0608A520 = 0x0608A520);
PROVIDE(sym_0608A52C = 0x0608A52C);
PROVIDE(sym_0608A530 = 0x0608A530);
PROVIDE(sym_0608A6B0 = 0x0608A6B0);
PROVIDE(sym_0608A6C0 = 0x0608A6C0);
PROVIDE(sym_0608A6F0 = 0x0608A6F0);
PROVIDE(sym_0608A6FC = 0x0608A6FC);
PROVIDE(sym_0608A704 = 0x0608A704);
PROVIDE(sym_0608A70C = 0x0608A70C);
PROVIDE(sym_0608A718 = 0x0608A718);
PROVIDE(sym_0608A724 = 0x0608A724);
PROVIDE(sym_0608A730 = 0x0608A730);
PROVIDE(sym_0608A73C = 0x0608A73C);
PROVIDE(sym_0608A76C = 0x0608A76C);
PROVIDE(sym_0608A790 = 0x0608A790);
PROVIDE(sym_0608A798 = 0x0608A798);
PROVIDE(sym_0608A7A0 = 0x0608A7A0);
PROVIDE(sym_0608A7AC = 0x0608A7AC);
PROVIDE(sym_0608A7B8 = 0x0608A7B8);
PROVIDE(sym_0608A7C4 = 0x0608A7C4);
PROVIDE(sym_0608A7D0 = 0x0608A7D0);
PROVIDE(sym_0608A800 = 0x0608A800);
PROVIDE(sym_0608A820 = 0x0608A820);
PROVIDE(sym_0608AC20 = 0x0608AC20);
PROVIDE(sym_0608E460 = 0x0608E460);
PROVIDE(sym_06094220 = 0x06094220);
PROVIDE(sym_06094620 = 0x06094620);
PROVIDE(sym_06094A20 = 0x06094A20);
PROVIDE(sym_06094A28 = 0x06094A28);
PROVIDE(sym_06094A30 = 0x06094A30);
PROVIDE(sym_06094A60 = 0x06094A60);
PROVIDE(sym_06094A90 = 0x06094A90);
PROVIDE(sym_06094AB0 = 0x06094AB0);
PROVIDE(sym_06094AE0 = 0x06094AE0);
PROVIDE(sym_06094AE4 = 0x06094AE4);
PROVIDE(sym_06094EE4 = 0x06094EE4);
PROVIDE(sym_06094EEC = 0x06094EEC);
PROVIDE(sym_06094EF4 = 0x06094EF4);
PROVIDE(sym_06094F24 = 0x06094F24);
PROVIDE(sym_06094F54 = 0x06094F54);
PROVIDE(sym_06094F74 = 0x06094F74);
PROVIDE(sym_06094FA4 = 0x06094FA4);
PROVIDE(sym_06094FA8 = 0x06094FA8);
PROVIDE(sym_06094FAC = 0x06094FAC);
PROVIDE(sym_06095F48 = 0x06095F48);
PROVIDE(sym_060961A8 = 0x060961A8);
PROVIDE(sym_060A0FA8 = 0x060A0FA8);
PROVIDE(sym_060A17A8 = 0x060A17A8);
PROVIDE(sym_060A2428 = 0x060A2428);
PROVIDE(sym_060A2468 = 0x060A2468);
PROVIDE(sym_060A246C = 0x060A246C);
PROVIDE(sym_060A2470 = 0x060A2470);
PROVIDE(sym_060A3C70 = 0x060A3C70);
PROVIDE(sym_060A3D70 = 0x060A3D70);
PROVIDE(sym_060A3D74 = 0x060A3D74);
PROVIDE(sym_060A3D78 = 0x060A3D78);
PROVIDE(sym_060A3D7C = 0x060A3D7C);
PROVIDE(sym_060A3D84 = 0x060A3D84);
PROVIDE(sym_060A3D88 = 0x060A3D88);
PROVIDE(sym_060A3D96 = 0x060A3D96);
PROVIDE(sym_060A3DA8 = 0x060A3DA8);
PROVIDE(sym_060A3DB0 = 0x060A3DB0);
PROVIDE(sym_060A3DB8 = 0x060A3DB8);
PROVIDE(sym_060A3DBA = 0x060A3DBA);
PROVIDE(sym_060A3DBC = 0x060A3DBC);
PROVIDE(sym_060A3DBE = 0x060A3DBE);
PROVIDE(sym_060A3DF8 = 0x060A3DF8);
PROVIDE(sym_060A3E38 = 0x060A3E38);
PROVIDE(sym_060A3E3C = 0x060A3E3C);
PROVIDE(sym_060A3E44 = 0x060A3E44);
PROVIDE(sym_060A3E48 = 0x060A3E48);
PROVIDE(sym_060A3E68 = 0x060A3E68);
PROVIDE(sym_060A3EE8 = 0x060A3EE8);
PROVIDE(sym_060A3F68 = 0x060A3F68);
PROVIDE(sym_060A45D0 = 0x060A45D0);
PROVIDE(sym_060A4C38 = 0x060A4C38);
PROVIDE(sym_060A4C3C = 0x060A4C3C);
PROVIDE(sym_060A4C40 = 0x060A4C40);
PROVIDE(sym_060A4C44 = 0x060A4C44);
PROVIDE(sym_060A4C48 = 0x060A4C48);
PROVIDE(sym_060A4C4C = 0x060A4C4C);
PROVIDE(sym_060A4C50 = 0x060A4C50);
PROVIDE(sym_060A4C54 = 0x060A4C54);
PROVIDE(sym_060A4C58 = 0x060A4C58);
PROVIDE(sym_060A4C59 = 0x060A4C59);
PROVIDE(sym_060A4C5C = 0x060A4C5C);
PROVIDE(sym_060A4C60 = 0x060A4C60);
PROVIDE(sym_060A4C68 = 0x060A4C68);
PROVIDE(sym_060A4C70 = 0x060A4C70);
PROVIDE(sym_060A4C74 = 0x060A4C74);
PROVIDE(sym_060A4C78 = 0x060A4C78);
PROVIDE(sym_060A4C80 = 0x060A4C80);
PROVIDE(sym_060A4C84 = 0x060A4C84);
PROVIDE(sym_060A4C88 = 0x060A4C88);
PROVIDE(sym_060A4C8C = 0x060A4C8C);
PROVIDE(sym_060A4C90 = 0x060A4C90);
PROVIDE(sym_060A4C92 = 0x060A4C92);
PROVIDE(sym_060A4C94 = 0x060A4C94);
PROVIDE(sym_060A4C96 = 0x060A4C96);
PROVIDE(sym_060A4C98 = 0x060A4C98);
PROVIDE(sym_060A4C9C = 0x060A4C9C);
PROVIDE(sym_060A4CA8 = 0x060A4CA8);
PROVIDE(sym_060A4CA9 = 0x060A4CA9);
PROVIDE(sym_060A4CAA = 0x060A4CAA);
PROVIDE(sym_060A4CAB = 0x060A4CAB);
PROVIDE(sym_060A4CAC = 0x060A4CAC);
PROVIDE(sym_060A4CAE = 0x060A4CAE);
PROVIDE(sym_060A4CAF = 0x060A4CAF);
PROVIDE(sym_060A4CB0 = 0x060A4CB0);
PROVIDE(sym_060A4CB4 = 0x060A4CB4);
PROVIDE(sym_060A4CB8 = 0x060A4CB8);
PROVIDE(sym_060A4CBC = 0x060A4CBC);
PROVIDE(sym_060A4CC0 = 0x060A4CC0);
PROVIDE(sym_060A4CC4 = 0x060A4CC4);
PROVIDE(sym_060A4CC8 = 0x060A4CC8);
PROVIDE(sym_060A4CCC = 0x060A4CCC);
PROVIDE(sym_060A4CD0 = 0x060A4CD0);
PROVIDE(sym_060A4CD4 = 0x060A4CD4);
PROVIDE(sym_060A4CD8 = 0x060A4CD8);
PROVIDE(sym_060A4CD9 = 0x060A4CD9);
PROVIDE(sym_060A4CE8 = 0x060A4CE8);
PROVIDE(sym_060A4CEC = 0x060A4CEC);
PROVIDE(sym_060A4CF0 = 0x060A4CF0);
PROVIDE(sym_060A4CF4 = 0x060A4CF4);
PROVIDE(sym_060A4CF8 = 0x060A4CF8);
PROVIDE(sym_060A4CFC = 0x060A4CFC);
PROVIDE(sym_060A4CFD = 0x060A4CFD);
PROVIDE(sym_060A4D02 = 0x060A4D02);
PROVIDE(sym_060A4D04 = 0x060A4D04);
PROVIDE(sym_060A4D08 = 0x060A4D08);
PROVIDE(sym_060A4D0C = 0x060A4D0C);
PROVIDE(sym_060A4D0D = 0x060A4D0D);
PROVIDE(sym_060A4D0E = 0x060A4D0E);
PROVIDE(sym_060A4D0F = 0x060A4D0F);
PROVIDE(sym_060A4D10 = 0x060A4D10);
PROVIDE(sym_060A4D11 = 0x060A4D11);
PROVIDE(sym_060A4D14 = 0x060A4D14);
PROVIDE(sym_060A4D18 = 0x060A4D18);
PROVIDE(sym_060A4D28 = 0x060A4D28);
PROVIDE(sym_060A4D30 = 0x060A4D30);
PROVIDE(sym_060A4D36 = 0x060A4D36);
PROVIDE(sym_060A4D3E = 0x060A4D3E);
PROVIDE(sym_060A4D46 = 0x060A4D46);
PROVIDE(sym_060A4D58 = 0x060A4D58);
PROVIDE(sym_060A4D5C = 0x060A4D5C);
PROVIDE(sym_060A4D60 = 0x060A4D60);
PROVIDE(sym_060A4D80 = 0x060A4D80);
PROVIDE(sym_060A4D84 = 0x060A4D84);
PROVIDE(sym_060A4D88 = 0x060A4D88);
PROVIDE(sym_060A4D8C = 0x060A4D8C);
PROVIDE(sym_060A4D90 = 0x060A4D90);
PROVIDE(sym_060A4D94 = 0x060A4D94);
PROVIDE(sym_060A4D98 = 0x060A4D98);
PROVIDE(sym_060A4D9A = 0x060A4D9A);
PROVIDE(sym_060A4D9C = 0x060A4D9C);
PROVIDE(sym_060A4D9E = 0x060A4D9E);
PROVIDE(sym_060A4DA0 = 0x060A4DA0);
PROVIDE(sym_060A4DA2 = 0x060A4DA2);
PROVIDE(sym_060A4DA4 = 0x060A4DA4);
PROVIDE(sym_060A4DA5 = 0x060A4DA5);
PROVIDE(sym_060A4DA6 = 0x060A4DA6);
PROVIDE(sym_060A4DA7 = 0x060A4DA7);
PROVIDE(sym_060A4DA8 = 0x060A4DA8);
PROVIDE(sym_060A53A8 = 0x060A53A8);
PROVIDE(sym_060A53B0 = 0x060A53B0);
PROVIDE(sym_060A53B8 = 0x060A53B8);
PROVIDE(sym_060A5400 = 0x060A5400);
PROVIDE(sym_060A6000 = 0x060A6000);
PROVIDE(sym_060BF000 = 0x060BF000);
PROVIDE(sym_060C2000 = 0x060C2000);
PROVIDE(sym_060C6000 = 0x060C6000);
PROVIDE(sym_060D5840 = 0x060D5840);
PROVIDE(sym_060D6900 = 0x060D6900);
PROVIDE(sym_060EE300 = 0x060EE300);
PROVIDE(sym_060EE7D4 = 0x060EE7D4);
PROVIDE(sym_060EECA8 = 0x060EECA8);
PROVIDE(sym_060EF17C = 0x060EF17C);
PROVIDE(sym_060EF650 = 0x060EF650);
PROVIDE(sym_060EFB24 = 0x060EFB24);
PROVIDE(sym_060F0000 = 0x060F0000);
PROVIDE(sym_060F8000 = 0x060F8000);
PROVIDE(sym_060FD730 = 0x060FD730);
PROVIDE(sym_060FD760 = 0x060FD760);
PROVIDE(sym_060FD7C0 = 0x060FD7C0);
PROVIDE(sym_060FD970 = 0x060FD970);
PROVIDE(sym_060FDA18 = 0x060FDA18);
PROVIDE(sym_060FDAA8 = 0x060FDAA8);

/* 886 code-range sym_ defined as labels in .s files (relocatable) */
