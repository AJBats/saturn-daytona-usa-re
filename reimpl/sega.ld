/* sega.ld -- Byte-identical retail linker script
 *
 * Produces the original Sega binary layout. Every function is placed at
 * its retail address via SORT_BY_NAME on .text.FUN_* sections, and FUN_
 * PROVIDEs pin them in place. `make retail` / `make validate` use this.
 *
 * Code-range sym_ symbols are labels in .s files (relocatable).
 * Data-range sym_ and DAT_ symbols are fixed PROVIDEs.
 */

OUTPUT_FORMAT("elf32-sh")
OUTPUT_ARCH(sh)
ENTRY(_start)

SECTIONS
{
    . = 0x06003000;
    .text : {
        *(.text.startup)
        *(SORT_BY_NAME(.text.FUN_*))
    }

    /DISCARD/ : {
        *(.comment)
        *(.note.*)
        *(.eh_frame)
    }
}

/* FUN_ symbols (1258) */
PROVIDE(system_init = system_init + 0x0);
PROVIDE(sound_timer_init = sound_timer_init + 0x0);
PROVIDE(vdp_init_dispatch = vdp_init_dispatch + 0x0);
PROVIDE(gameover_channel_setup = gameover_channel_setup + 0x0);
PROVIDE(vdp_init_advanced = vdp_init_advanced + 0x0);
PROVIDE(vdp2_course0_init = vdp2_course0_init + 0x0);
PROVIDE(vdp2_course1_init = vdp2_course1_init + 0x0);
PROVIDE(vdp2_course2_init = vdp2_course2_init + 0x0);
PROVIDE(vdp2_register_init = vdp2_register_init + 0x0);
PROVIDE(dma_vram_init = dma_vram_init + 0x0);
PROVIDE(dma_config_dispatch = dma_config_dispatch + 0x0);
PROVIDE(master_init_dispatch = master_init_dispatch + 0x0);
PROVIDE(obj_template_init = obj_template_init + 0x0);
PROVIDE(engine_init_global = engine_init_global + 0x0);
PROVIDE(obj_transform_cache = obj_transform_cache + 0x0);
PROVIDE(obj_position_update = obj_position_update + 0x0);
PROVIDE(obj_coord_setter = obj_coord_setter + 0x0);
PROVIDE(hw_render_dispatch = hw_render_dispatch + 0x0);
PROVIDE(controller_input_update = controller_input_update + 0x0);
PROVIDE(vec3_angle_calc = vec3_angle_calc + 0x0);
PROVIDE(camera_orient_calc = camera_orient_calc + 0x0);
PROVIDE(obj_state_writer = obj_state_writer + 0x0);
PROVIDE(sprite_frame_select = sprite_frame_select + 0x0);
PROVIDE(perspective_project = perspective_project + 0x0);
PROVIDE(bg_layer_init = bg_layer_init + 0x0);
PROVIDE(vdp_mode_setup = vdp_mode_setup + 0x0);
PROVIDE(frame_dispatch = frame_dispatch + 0x0);
PROVIDE(anim_frame_counter = anim_frame_counter + 0x0);
PROVIDE(input_event_handler = input_event_handler + 0x0);
PROVIDE(display_compositor = display_compositor + 0x0);
PROVIDE(world_camera_update = world_camera_update + 0x0);
PROVIDE(anim_frame_transform = anim_frame_transform + 0x0);
PROVIDE(segment_position_track = segment_position_track + 0x0);
PROVIDE(pre_render_transform = pre_render_transform + 0x0);
PROVIDE(car_array_init = car_array_init + 0x0);
PROVIDE(scene_fallback_render = scene_fallback_render + 0x0);
PROVIDE(coord_grid_pack = coord_grid_pack + 0x0);
PROVIDE(scene_post_render = scene_post_render + 0x0);
PROVIDE(scene_path_a = scene_path_a + 0x0);
PROVIDE(scene_path_b = scene_path_b + 0x0);
PROVIDE(FUN_06006F3C = FUN_06006F3C + 0x0);
PROVIDE(vblank_out_handler = vblank_out_handler + 0x0);
PROVIDE(framebuf_swap_ctrl = framebuf_swap_ctrl + 0x0);
PROVIDE(render_obj_stub = render_obj_stub + 0x0);
PROVIDE(main_loop_timing = main_loop_timing + 0x0);
PROVIDE(system_watchdog = system_watchdog + 0x0);
PROVIDE(vdp1_sprite_render = vdp1_sprite_render + 0x0);
PROVIDE(vdp1_sprite_render_alt = vdp1_sprite_render_alt + 0x0);
PROVIDE(frame_end_commit = frame_end_commit + 0x0);
PROVIDE(render_pass_extra = render_pass_extra + 0x0);
PROVIDE(vdp1_sprite_builder = vdp1_sprite_builder + 0x0);
PROVIDE(dma_queue_mgr = dma_queue_mgr + 0x0);
PROVIDE(dma_queue_commit = dma_queue_commit + 0x0);
PROVIDE(vblank_frame_handler = vblank_frame_handler + 0x0);
PROVIDE(gas_force_apply = gas_force_apply + 0x0);
PROVIDE(gear_shift_handler = gear_shift_handler + 0x0);
PROVIDE(force_steer_calc = force_steer_calc + 0x0);
PROVIDE(force_steer_impact = force_steer_impact + 0x0);
PROVIDE(race_config_physics = race_config_physics + 0x0);
PROVIDE(brake_force_apply = brake_force_apply + 0x0);
PROVIDE(force_table_apply = force_table_apply + 0x0);
PROVIDE(state_boot_init = state_boot_init + 0x0);
PROVIDE(state_attract_setup = state_attract_setup + 0x0);
PROVIDE(attract_init_body = attract_init_body + 0x0);
PROVIDE(state_attract_active = state_attract_active + 0x0);
PROVIDE(state_course_select_init = state_course_select_init + 0x0);
PROVIDE(state_course_select_active = state_course_select_active + 0x0);
PROVIDE(state_car_select_init = state_car_select_init + 0x0);
PROVIDE(state_car_select_active = state_car_select_active + 0x0);
PROVIDE(state_loading_init = state_loading_init + 0x0);
PROVIDE(state_loading_check = state_loading_check + 0x0);
PROVIDE(state_resource_load = state_resource_load + 0x0);
PROVIDE(state_memory_route = state_memory_route + 0x0);
PROVIDE(state_mode_select_entry = state_mode_select_entry + 0x0);
PROVIDE(state_mode_select_setup = state_mode_select_setup + 0x0);
PROVIDE(state_mode_select_active = state_mode_select_active + 0x0);
PROVIDE(state_race_prepare = state_race_prepare + 0x0);
PROVIDE(state_pre_race = state_pre_race + 0x0);
PROVIDE(state_race_setup = state_race_setup + 0x0);
PROVIDE(state_race_main = state_race_main + 0x0);
PROVIDE(state_post_countdown = state_post_countdown + 0x0);
PROVIDE(state_post_lap = state_post_lap + 0x0);
PROVIDE(state_abort = state_abort + 0x0);
PROVIDE(state_results_screen = state_results_screen + 0x0);
PROVIDE(state_time_extend_setup = state_time_extend_setup + 0x0);
PROVIDE(state_time_extend_active = state_time_extend_active + 0x0);
PROVIDE(state_race_complete = state_race_complete + 0x0);
PROVIDE(state_post_race_cleanup = state_post_race_cleanup + 0x0);
PROVIDE(state_post_race_init = state_post_race_init + 0x0);
PROVIDE(state_post_race_display = state_post_race_display + 0x0);
PROVIDE(state_postrace_wait_init = state_postrace_wait_init + 0x0);
PROVIDE(state_postrace_countdown = state_postrace_countdown + 0x0);
PROVIDE(state_attract_return = state_attract_return + 0x0);
PROVIDE(state_demo_setup = state_demo_setup + 0x0);
PROVIDE(state_timeext_setup = state_timeext_setup + 0x0);
PROVIDE(sound_state_transition = sound_state_transition + 0x0);
PROVIDE(audio_display_init = audio_display_init + 0x0);
PROVIDE(race_resource_init = race_resource_init + 0x0);
PROVIDE(vdp1_init = vdp1_init + 0x0);
PROVIDE(per_frame_update = per_frame_update + 0x0);
PROVIDE(camera_push_save = camera_push_save + 0x0);
PROVIDE(camera_dist_clamp = camera_dist_clamp + 0x0);
PROVIDE(camera_pos_calc = camera_pos_calc + 0x0);
PROVIDE(camera_scene_setup = camera_scene_setup + 0x0);
PROVIDE(camera_param_load = camera_param_load + 0x0);
PROVIDE(camera_collision_avoid = camera_collision_avoid + 0x0);
PROVIDE(secondary_geom_proc = secondary_geom_proc + 0x0);
PROVIDE(car_proximity_check = car_proximity_check + 0x0);
PROVIDE(render_obj_additive = render_obj_additive + 0x0);
PROVIDE(render_obj_absolute = render_obj_absolute + 0x0);
PROVIDE(camera_car_transform = camera_car_transform + 0x0);
PROVIDE(camera_track_setup = camera_track_setup + 0x0);
PROVIDE(course_obj_transform = course_obj_transform + 0x0);
PROVIDE(scene_render_coord = scene_render_coord + 0x0);
PROVIDE(camera_lerp = camera_lerp + 0x0);
PROVIDE(render_cs0_loop = render_cs0_loop + 0x0);
PROVIDE(render_scene_loop = render_scene_loop + 0x0);
PROVIDE(camera_system = camera_system + 0x0);
PROVIDE(scene_master = scene_master + 0x0);
PROVIDE(scene_render_body = scene_render_body + 0x0);
PROVIDE(race_utility_calc = race_utility_calc + 0x0);
PROVIDE(scene_update = scene_update + 0x0);
PROVIDE(race_utility_fn = race_utility_fn + 0x0);
PROVIDE(accel_response = accel_response + 0x0);
PROVIDE(player_collision = player_collision + 0x0);
PROVIDE(ai_orchestrator = ai_orchestrator + 0x0);
PROVIDE(heading_speed_damping = heading_speed_damping + 0x0);
PROVIDE(ai_steering_update = ai_steering_update + 0x0);
PROVIDE(ai_speed_trampoline = ai_speed_trampoline + 0x0);
PROVIDE(ai_speed_target = ai_speed_target + 0x0);
PROVIDE(track_position_calc = track_position_calc + 0x0);
PROVIDE(race_pos_interp = race_pos_interp + 0x0);
PROVIDE(heading_correct = heading_correct + 0x0);
PROVIDE(track_pos_query = track_pos_query + 0x0);
PROVIDE(race_heading_calc = race_heading_calc + 0x0);
PROVIDE(collision_detect_main = collision_detect_main + 0x0);
PROVIDE(track_segment_advance = track_segment_advance + 0x0);
PROVIDE(collision_dispatch = collision_dispatch + 0x0);
PROVIDE(collision_passive = collision_passive + 0x0);
PROVIDE(physics_calc_dispatch = physics_calc_dispatch + 0x0);
PROVIDE(vehicle_state_update = vehicle_state_update + 0x0);
PROVIDE(render_batch = render_batch + 0x0);
PROVIDE(checkpoint_detect = checkpoint_detect + 0x0);
PROVIDE(car_iterate_update = car_iterate_update + 0x0);
PROVIDE(lap_time_record = lap_time_record + 0x0);
PROVIDE(lap_complete_flag = lap_complete_flag + 0x0);
PROVIDE(finish_proximity = finish_proximity + 0x0);
PROVIDE(car_update_post = car_update_post + 0x0);
PROVIDE(finish_display = finish_display + 0x0);
PROVIDE(checkpoint_sound_trigger = checkpoint_sound_trigger + 0x0);
PROVIDE(checkpoint_time_calc = checkpoint_time_calc + 0x0);
PROVIDE(audio_dist_calc = audio_dist_calc + 0x0);
PROVIDE(race_countdown_update = race_countdown_update + 0x0);
PROVIDE(race_state_update = race_state_update + 0x0);
PROVIDE(car_iteration_loop = car_iteration_loop + 0x0);
PROVIDE(update_mode_dispatch = update_mode_dispatch + 0x0);
PROVIDE(race_update_abort = race_update_abort + 0x0);
PROVIDE(race_update_ending = race_update_ending + 0x0);
PROVIDE(car_update_racing = car_update_racing + 0x0);
PROVIDE(car_type_init = car_type_init + 0x0);
PROVIDE(car_update_simple = car_update_simple + 0x0);
PROVIDE(race_update_full = race_update_full + 0x0);
PROVIDE(car_frame_update = car_frame_update + 0x0);
PROVIDE(player_physics_main = player_physics_main + 0x0);
PROVIDE(per_frame_race_update = per_frame_race_update + 0x0);
PROVIDE(ai_physics_main = ai_physics_main + 0x0);
PROVIDE(pre_update_setup = pre_update_setup + 0x0);
PROVIDE(race_init_master = race_init_master + 0x0);
PROVIDE(car_physics_init = car_physics_init + 0x0);
PROVIDE(game_state_dispatch = game_state_dispatch + 0x0);
PROVIDE(post_race_transition = post_race_transition + 0x0);
PROVIDE(transition_handler_a = transition_handler_a + 0x0);
PROVIDE(transition_small_a = transition_small_a + 0x0);
PROVIDE(race_countdown_timer = race_countdown_timer + 0x0);
PROVIDE(transition_minimal = transition_minimal + 0x0);
PROVIDE(transition_handler_b = transition_handler_b + 0x0);
PROVIDE(transition_handler_c = transition_handler_c + 0x0);
PROVIDE(transition_stub = transition_stub + 0x0);
PROVIDE(transition_small_b = transition_small_b + 0x0);
PROVIDE(transition_large_menu = transition_large_menu + 0x0);
PROVIDE(transition_large_results = transition_large_results + 0x0);
PROVIDE(transition_small_c = transition_small_c + 0x0);
PROVIDE(transition_medium_a = transition_medium_a + 0x0);
PROVIDE(transition_small_d = transition_small_d + 0x0);
PROVIDE(transition_medium_b = transition_medium_b + 0x0);
PROVIDE(transition_medium_c = transition_medium_c + 0x0);
PROVIDE(hud_race_display = hud_race_display + 0x0);
PROVIDE(sprite_anim_render = sprite_anim_render + 0x0);
PROVIDE(speedometer_ctrl = speedometer_ctrl + 0x0);
PROVIDE(brake_state_toggle = brake_state_toggle + 0x0);
PROVIDE(throttle_state_toggle = throttle_state_toggle + 0x0);
PROVIDE(multi_state_anim = multi_state_anim + 0x0);
PROVIDE(adv_anim_state = adv_anim_state + 0x0);
PROVIDE(hud_coord_calc = hud_coord_calc + 0x0);
PROVIDE(hud_post_update = hud_post_update + 0x0);
PROVIDE(tachometer_ctrl = tachometer_ctrl + 0x0);
PROVIDE(hud_sound_trigger = hud_sound_trigger + 0x0);
PROVIDE(graphics_mode_setup = graphics_mode_setup + 0x0);
PROVIDE(vdp_mode_select = vdp_mode_select + 0x0);
PROVIDE(race_position_track = race_position_track + 0x0);
PROVIDE(hud_course_render = hud_course_render + 0x0);
PROVIDE(lap_progress_indicator = lap_progress_indicator + 0x0);
PROVIDE(position_ranking_display = position_ranking_display + 0x0);
PROVIDE(anim_ui_transition = anim_ui_transition + 0x0);
PROVIDE(hud_layer_composite = hud_layer_composite + 0x0);
PROVIDE(sprite_batch_renderer = sprite_batch_renderer + 0x0);
PROVIDE(hud_transparency = hud_transparency + 0x0);
PROVIDE(sprite_buffer_init = sprite_buffer_init + 0x0);
PROVIDE(sprite_3d_render = sprite_3d_render + 0x0);
PROVIDE(hud_main_draw = hud_main_draw + 0x0);
PROVIDE(vertex_transform_rot = vertex_transform_rot + 0x0);
PROVIDE(split_screen_layout = split_screen_layout + 0x0);
PROVIDE(rigid_body_transform = rigid_body_transform + 0x0);
PROVIDE(hud_damage_warning = hud_damage_warning + 0x0);
PROVIDE(post_sprite_cleanup = post_sprite_cleanup + 0x0);
PROVIDE(dual_hud_render = dual_hud_render + 0x0);
PROVIDE(throttle_input_proc = throttle_input_proc + 0x0);
PROVIDE(sound_init_race = sound_init_race + 0x0);
PROVIDE(file_seek = file_seek + 0x0);
PROVIDE(sound_init_bonus = sound_init_bonus + 0x0);
PROVIDE(file_size_get = file_size_get + 0x0);
PROVIDE(file_close = file_close + 0x0);
PROVIDE(race_start_init = race_start_init + 0x0);
PROVIDE(file_read_callback = file_read_callback + 0x0);
PROVIDE(race_cleanup_handler = race_cleanup_handler + 0x0);
PROVIDE(lap_time_formatter = lap_time_formatter + 0x0);
PROVIDE(lap_timer_ctrl = lap_timer_ctrl + 0x0);
PROVIDE(position_vel_limiter = position_vel_limiter + 0x0);
PROVIDE(file_data_parse = file_data_parse + 0x0);
PROVIDE(file_block_read = file_block_read + 0x0);
PROVIDE(file_format_detect = file_format_detect + 0x0);
PROVIDE(file_format_parse = file_format_parse + 0x0);
PROVIDE(hud_lap_gfx_update = hud_lap_gfx_update + 0x0);
PROVIDE(lap_display_anim = lap_display_anim + 0x0);
PROVIDE(race_progress_check = race_progress_check + 0x0);
PROVIDE(hud_menu_logic = hud_menu_logic + 0x0);
PROVIDE(course_table_lookup = course_table_lookup + 0x0);
PROVIDE(car_param_lookup = car_param_lookup + 0x0);
PROVIDE(cd_status_reader = cd_status_reader + 0x0);
PROVIDE(cd_error_recover = cd_error_recover + 0x0);
PROVIDE(track_seg_lookup = track_seg_lookup + 0x0);
PROVIDE(cd_dma_setup = cd_dma_setup + 0x0);
PROVIDE(cd_progress_notify = cd_progress_notify + 0x0);
PROVIDE(cd_course_loader = cd_course_loader + 0x0);
PROVIDE(cd_texture_loader = cd_texture_loader + 0x0);
PROVIDE(sound_init_sequence = sound_init_sequence + 0x0);
PROVIDE(sound_scsp_boot = sound_scsp_boot + 0x0);
PROVIDE(game_init_master = game_init_master + 0x0);
PROVIDE(gfx_frame_dispatch = gfx_frame_dispatch + 0x0);
PROVIDE(race_timer_format = race_timer_format + 0x0);
PROVIDE(score_calculator = score_calculator + 0x0);
PROVIDE(best_time_compare = best_time_compare + 0x0);
PROVIDE(ranking_pts_calc = ranking_pts_calc + 0x0);
PROVIDE(bonus_multiplier = bonus_multiplier + 0x0);
PROVIDE(lap_time_display = lap_time_display + 0x0);
PROVIDE(camera_fov_dispatch = camera_fov_dispatch + 0x0);
PROVIDE(score_commit_save = score_commit_save + 0x0);
PROVIDE(obj_render_loop_3d = obj_render_loop_3d + 0x0);
PROVIDE(end_race_score = end_race_score + 0x0);
PROVIDE(bg_obj_render_loop = bg_obj_render_loop + 0x0);
PROVIDE(dyn_obj_physics = dyn_obj_physics + 0x0);
PROVIDE(render_iter_loop = render_iter_loop + 0x0);
PROVIDE(race_variant_setup_a = race_variant_setup_a + 0x0);
PROVIDE(camera_angle_interp = camera_angle_interp + 0x0);
PROVIDE(multi_obj_physics = multi_obj_physics + 0x0);
PROVIDE(race_variant_setup_b = race_variant_setup_b + 0x0);
PROVIDE(race_variant_setup_c = race_variant_setup_c + 0x0);
PROVIDE(track_normal_calc = track_normal_calc + 0x0);
PROVIDE(camera_track_update = camera_track_update + 0x0);
PROVIDE(adv_collision_resp = adv_collision_resp + 0x0);
PROVIDE(track_wall_collision = track_wall_collision + 0x0);
PROVIDE(track_elev_map = track_elev_map + 0x0);
PROVIDE(perspective_proj_3d = perspective_proj_3d + 0x0);
PROVIDE(display_channel_a = display_channel_a + 0x0);
PROVIDE(display_channel_b = display_channel_b + 0x0);
PROVIDE(display_channels_load = display_channels_load + 0x0);
PROVIDE(display_channels_clear = display_channels_clear + 0x0);
PROVIDE(channel_config_a = channel_config_a + 0x0);
PROVIDE(channel_config_partial = channel_config_partial + 0x0);
PROVIDE(channel_config_b = channel_config_b + 0x0);
PROVIDE(vdp1_cmd_update = vdp1_cmd_update + 0x0);
PROVIDE(util_wrapper = util_wrapper + 0x0);
PROVIDE(display_mode_init = display_mode_init + 0x0);
PROVIDE(ai_waypoint_pathfind = ai_waypoint_pathfind + 0x0);
PROVIDE(ai_position_ranking = ai_position_ranking + 0x0);
PROVIDE(hud_layout_mgr = hud_layout_mgr + 0x0);
PROVIDE(hud_elem_render = hud_elem_render + 0x0);
PROVIDE(race_data_dispatch = race_data_dispatch + 0x0);
PROVIDE(hud_anim_ctrl = hud_anim_ctrl + 0x0);
PROVIDE(hud_priority_sort = hud_priority_sort + 0x0);
PROVIDE(minimap_render = minimap_render + 0x0);
PROVIDE(hud_nop_stub_a = hud_nop_stub_a + 0x0);
PROVIDE(minimap_car_dot = minimap_car_dot + 0x0);
PROVIDE(hud_minimap_stub = hud_minimap_stub + 0x0);
PROVIDE(minimap_full_update = minimap_full_update + 0x0);
PROVIDE(lap_counter_update = lap_counter_update + 0x0);
PROVIDE(position_change_anim = position_change_anim + 0x0);
PROVIDE(best_lap_display = best_lap_display + 0x0);
PROVIDE(time_compare_display = time_compare_display + 0x0);
PROVIDE(time_delta_format = time_delta_format + 0x0);
PROVIDE(time_digit_update = time_digit_update + 0x0);
PROVIDE(position_suffix_ordinal = position_suffix_ordinal + 0x0);
PROVIDE(lap_progress_bar = lap_progress_bar + 0x0);
PROVIDE(speed_unit_display = speed_unit_display + 0x0);
PROVIDE(speed_value_format = speed_value_format + 0x0);
PROVIDE(vdp2_layer_init = vdp2_layer_init + 0x0);
PROVIDE(results_init_stub = results_init_stub + 0x0);
PROVIDE(results_screen_render = results_screen_render + 0x0);
PROVIDE(hud_results_stub_a = hud_results_stub_a + 0x0);
PROVIDE(results_scroll_anim = results_scroll_anim + 0x0);
PROVIDE(results_elem_place = results_elem_place + 0x0);
PROVIDE(results_time_column = results_time_column + 0x0);
PROVIDE(results_bonus_calc = results_bonus_calc + 0x0);
PROVIDE(hud_results_stub_b = hud_results_stub_b + 0x0);
PROVIDE(results_car_name = results_car_name + 0x0);
PROVIDE(results_ranking_table = results_ranking_table + 0x0);
PROVIDE(hud_nop_stub_b = hud_nop_stub_b + 0x0);
PROVIDE(results_transition = results_transition + 0x0);
PROVIDE(results_best_laps = results_best_laps + 0x0);
PROVIDE(results_awards = results_awards + 0x0);
PROVIDE(results_cleanup = results_cleanup + 0x0);
PROVIDE(results_input_handler = results_input_handler + 0x0);
PROVIDE(hud_text_stub = hud_text_stub + 0x0);
PROVIDE(bcd_sprite_map = bcd_sprite_map + 0x0);
PROVIDE(hud_nop_stub_c = hud_nop_stub_c + 0x0);
PROVIDE(small_number_render = small_number_render + 0x0);
PROVIDE(text_string_render = text_string_render + 0x0);
PROVIDE(text_color_set = text_color_set + 0x0);
PROVIDE(track_seg_init = track_seg_init + 0x0);
PROVIDE(text_scroll_marquee = text_scroll_marquee + 0x0);
PROVIDE(track_vtx_builder = track_vtx_builder + 0x0);
PROVIDE(poly_table_read = poly_table_read + 0x0);
PROVIDE(poly_table_validate = poly_table_validate + 0x0);
PROVIDE(vdp2_util_loop = vdp2_util_loop + 0x0);
PROVIDE(vdp2_frame_update = vdp2_frame_update + 0x0);
PROVIDE(vdp2_loop_ctrl = vdp2_loop_ctrl + 0x0);
PROVIDE(vdp2_data_lookup = vdp2_data_lookup + 0x0);
PROVIDE(geom_pipeline_coord = geom_pipeline_coord + 0x0);
PROVIDE(track_seg_util = track_seg_util + 0x0);
PROVIDE(poly_table_lookup = poly_table_lookup + 0x0);
PROVIDE(geom_computation = geom_computation + 0x0);
PROVIDE(track_geometry_proc = track_geometry_proc + 0x0);
PROVIDE(track_state_handler = track_state_handler + 0x0);
PROVIDE(track_state_machine = track_state_machine + 0x0);
PROVIDE(geom_math_calc = geom_math_calc + 0x0);
PROVIDE(track_calc_helper = track_calc_helper + 0x0);
PROVIDE(vdp2_scroll_config = vdp2_scroll_config + 0x0);
PROVIDE(track_utility_misc = track_utility_misc + 0x0);
PROVIDE(course0_bg_load = course0_bg_load + 0x0);
PROVIDE(course1_bg_load = course1_bg_load + 0x0);
PROVIDE(course2_bg_load = course2_bg_load + 0x0);
PROVIDE(vdp2_config_extended = vdp2_config_extended + 0x0);
PROVIDE(handler_dispatch = handler_dispatch + 0x0);
PROVIDE(mode_flag_set_a = mode_flag_set_a + 0x0);
PROVIDE(mode_flag_set_b = mode_flag_set_b + 0x0);
PROVIDE(handler_init_reset = handler_init_reset + 0x0);
PROVIDE(mode_flag_set_c = mode_flag_set_c + 0x0);
PROVIDE(cdb_read_status = cdb_read_status + 0x0);
PROVIDE(race_sound_handler = race_sound_handler + 0x0);
PROVIDE(race_prep_init = race_prep_init + 0x0);
PROVIDE(save_state_snapshot = save_state_snapshot + 0x0);
PROVIDE(race_state_pair_1 = race_state_pair_1 + 0x0);
PROVIDE(restore_state_snapshot = restore_state_snapshot + 0x0);
PROVIDE(race_state_pair_2 = race_state_pair_2 + 0x0);
PROVIDE(state_snapshot_compare = state_snapshot_compare + 0x0);
PROVIDE(race_variant_a = race_variant_a + 0x0);
PROVIDE(transition_timer_set = transition_timer_set + 0x0);
PROVIDE(race_variant_b = race_variant_b + 0x0);
PROVIDE(transition_anim_drive = transition_anim_drive + 0x0);
PROVIDE(race_variant_c = race_variant_c + 0x0);
PROVIDE(transition_fade_ctrl = transition_fade_ctrl + 0x0);
PROVIDE(race_variant_d = race_variant_d + 0x0);
PROVIDE(transition_sound_trigger = transition_sound_trigger + 0x0);
PROVIDE(race_variant_e = race_variant_e + 0x0);
PROVIDE(transition_multi_step = transition_multi_step + 0x0);
PROVIDE(race_variant_f = race_variant_f + 0x0);
PROVIDE(transition_full_exec = transition_full_exec + 0x0);
PROVIDE(sound_channel_reset = sound_channel_reset + 0x0);
PROVIDE(race_data_handler = race_data_handler + 0x0);
PROVIDE(race_utility_func = race_utility_func + 0x0);
PROVIDE(palette_frame_effects = palette_frame_effects + 0x0);
PROVIDE(track_poly_start = track_poly_start + 0x0);
PROVIDE(course_select_state = course_select_state + 0x0);
PROVIDE(course_select_draw = course_select_draw + 0x0);
PROVIDE(course_select_input = course_select_input + 0x0);
PROVIDE(mode_select_handler = mode_select_handler + 0x0);
PROVIDE(car_select_state = car_select_state + 0x0);
PROVIDE(car_select_setup = car_select_setup + 0x0);
PROVIDE(FUN_06019928 = FUN_06019928 + 0x0);
PROVIDE(car_select_input = car_select_input + 0x0);
PROVIDE(course0_physics_init = course0_physics_init + 0x0);
PROVIDE(trans_select_at_mt = trans_select_at_mt + 0x0);
PROVIDE(course1_physics_init = course1_physics_init + 0x0);
PROVIDE(pre_race_camera = pre_race_camera + 0x0);
PROVIDE(course2_physics_init = course2_physics_init + 0x0);
PROVIDE(grid_position_camera = grid_position_camera + 0x0);
PROVIDE(start_light_ctrl = start_light_ctrl + 0x0);
PROVIDE(start_light_render = start_light_render + 0x0);
PROVIDE(hud_nop_stub_d = hud_nop_stub_d + 0x0);
PROVIDE(green_light_anim = green_light_anim + 0x0);
PROVIDE(car_physics_final = car_physics_final + 0x0);
PROVIDE(hud_nop_stub_e = hud_nop_stub_e + 0x0);
PROVIDE(race_start_transition = race_start_transition + 0x0);
PROVIDE(car_init_handler = car_init_handler + 0x0);
PROVIDE(preview_camera_pos = preview_camera_pos + 0x0);
PROVIDE(preview_camera_target = preview_camera_target + 0x0);
PROVIDE(course_data_rom_load = course_data_rom_load + 0x0);
PROVIDE(course_init_pipeline = course_init_pipeline + 0x0);
PROVIDE(preview_camera_path = preview_camera_path + 0x0);
PROVIDE(replay_cam_pos_select = replay_cam_pos_select + 0x0);
PROVIDE(course_config_render = course_config_render + 0x0);
PROVIDE(replay_cam_main_loop = replay_cam_main_loop + 0x0);
PROVIDE(course_data_handler = course_data_handler + 0x0);
PROVIDE(replay_cam_auto_cut = replay_cam_auto_cut + 0x0);
PROVIDE(replay_init_stub = replay_init_stub + 0x0);
PROVIDE(replay_cam_interp = replay_cam_interp + 0x0);
PROVIDE(replay_end_stub = replay_end_stub + 0x0);
PROVIDE(replay_cam_cleanup = replay_cam_cleanup + 0x0);
PROVIDE(disc_ready_stub = disc_ready_stub + 0x0);
PROVIDE(disc_sector_read = disc_sector_read + 0x0);
PROVIDE(course_setup_handler = course_setup_handler + 0x0);
PROVIDE(course_state_setup = course_state_setup + 0x0);
PROVIDE(disc_course_data_load = disc_course_data_load + 0x0);
PROVIDE(disc_load_mgr = disc_load_mgr + 0x0);
PROVIDE(disc_load_complete_check = disc_load_complete_check + 0x0);
PROVIDE(disc_read_check = disc_read_check + 0x0);
PROVIDE(disc_error_handler = disc_error_handler + 0x0);
PROVIDE(course_data_loader = course_data_loader + 0x0);
PROVIDE(texture_file_loader = texture_file_loader + 0x0);
PROVIDE(disc_anim_data_load = disc_anim_data_load + 0x0);
PROVIDE(anim_data_loader = anim_data_loader + 0x0);
PROVIDE(disc_texture_load_ext = disc_texture_load_ext + 0x0);
PROVIDE(replay_record_frame = replay_record_frame + 0x0);
PROVIDE(replay_record_main = replay_record_main + 0x0);
PROVIDE(replay_recorder = replay_recorder + 0x0);
PROVIDE(replay_playback_engine = replay_playback_engine + 0x0);
PROVIDE(replay_playback = replay_playback + 0x0);
PROVIDE(master_ctrl_dispatch = master_ctrl_dispatch + 0x0);
PROVIDE(render_stage_1 = render_stage_1 + 0x0);
PROVIDE(render_stage_2 = render_stage_2 + 0x0);
PROVIDE(render_stage_3 = render_stage_3 + 0x0);
PROVIDE(render_stage_4 = render_stage_4 + 0x0);
PROVIDE(render_stage_5 = render_stage_5 + 0x0);
PROVIDE(render_stage_6 = render_stage_6 + 0x0);
PROVIDE(render_matrix_calc = render_matrix_calc + 0x0);
PROVIDE(render_coord_transform = render_coord_transform + 0x0);
PROVIDE(render_setup_dispatch = render_setup_dispatch + 0x0);
PROVIDE(sound_cmd_queue_write = sound_cmd_queue_write + 0x0);
PROVIDE(sound_channel_alloc = sound_channel_alloc + 0x0);
PROVIDE(camera_view_update = camera_view_update + 0x0);
PROVIDE(sound_cmd_dispatch = sound_cmd_dispatch + 0x0);
PROVIDE(sound_write_direct = sound_write_direct + 0x0);
PROVIDE(sound_channel_a = sound_channel_a + 0x0);
PROVIDE(snd_channel_a_body = snd_channel_a_body + 0x0);
PROVIDE(sound_channel_b = sound_channel_b + 0x0);
PROVIDE(snd_channel_b_body = snd_channel_b_body + 0x0);
PROVIDE(sound_channel_c = sound_channel_c + 0x0);
PROVIDE(snd_channel_c_handler = snd_channel_c_handler + 0x0);
PROVIDE(sound_channel_c2 = sound_channel_c2 + 0x0);
PROVIDE(sound_pass_direct = sound_pass_direct + 0x0);
PROVIDE(snd_direct_pass = snd_direct_pass + 0x0);
PROVIDE(sound_channel_d = sound_channel_d + 0x0);
PROVIDE(snd_channel_d_handler = snd_channel_d_handler + 0x0);
PROVIDE(sound_notify_handler = sound_notify_handler + 0x0);
PROVIDE(snd_race_update = snd_race_update + 0x0);
PROVIDE(replay_camera_ctrl = replay_camera_ctrl + 0x0);
PROVIDE(camera_cleanup_reset = camera_cleanup_reset + 0x0);
PROVIDE(camera_event_handler = camera_event_handler + 0x0);
PROVIDE(camera_special_mode = camera_special_mode + 0x0);
PROVIDE(geom_matrix_setup = geom_matrix_setup + 0x0);
PROVIDE(hud_element_pos = hud_element_pos + 0x0);
PROVIDE(hud_overlay_render = hud_overlay_render + 0x0);
PROVIDE(hud_large_element = hud_large_element + 0x0);
PROVIDE(hud_text_handler = hud_text_handler + 0x0);
PROVIDE(mat_identity_set = mat_identity_set + 0x0);
PROVIDE(hud_state_machine = hud_state_machine + 0x0);
PROVIDE(mat_multiply_helper = mat_multiply_helper + 0x0);
PROVIDE(hud_utility = hud_utility + 0x0);
PROVIDE(mat_euler_rotate = mat_euler_rotate + 0x0);
PROVIDE(hud_render_stage = hud_render_stage + 0x0);
PROVIDE(mat_transpose = mat_transpose + 0x0);
PROVIDE(hud_handler_main = hud_handler_main + 0x0);
PROVIDE(geom_vertex_process = geom_vertex_process + 0x0);
PROVIDE(geom_coord_calc = geom_coord_calc + 0x0);
PROVIDE(geom_rotation_apply = geom_rotation_apply + 0x0);
PROVIDE(geom_normal_compute = geom_normal_compute + 0x0);
PROVIDE(geom_vertex_compute = geom_vertex_compute + 0x0);
PROVIDE(geom_batch_transform = geom_batch_transform + 0x0);
PROVIDE(geom_output_handler = geom_output_handler + 0x0);
PROVIDE(mem_pool_alloc = mem_pool_alloc + 0x0);
PROVIDE(geom_display_proc = geom_display_proc + 0x0);
PROVIDE(mem_pool_reset = mem_pool_reset + 0x0);
PROVIDE(geom_render_util = geom_render_util + 0x0);
PROVIDE(geom_output_finalize = geom_output_finalize + 0x0);
PROVIDE(geom_output_ctrl = geom_output_ctrl + 0x0);
PROVIDE(geom_output_dispatch = geom_output_dispatch + 0x0);
PROVIDE(resource_validator = resource_validator + 0x0);
PROVIDE(geom_output_main = geom_output_main + 0x0);
PROVIDE(geom_display_ctrl_a = geom_display_ctrl_a + 0x0);
PROVIDE(geom_display_ctrl_b = geom_display_ctrl_b + 0x0);
PROVIDE(vram_alloc_mgr = vram_alloc_mgr + 0x0);
PROVIDE(geom_display_handler = geom_display_handler + 0x0);
PROVIDE(geom_final_output = geom_final_output + 0x0);
PROVIDE(vram_ptr_get = vram_ptr_get + 0x0);
PROVIDE(vram_defrag = vram_defrag + 0x0);
PROVIDE(race_start_obj_init = race_start_obj_init + 0x0);
PROVIDE(obj_pool_alloc = obj_pool_alloc + 0x0);
PROVIDE(obj_pool_dealloc = obj_pool_dealloc + 0x0);
PROVIDE(obj_type_set = obj_type_set + 0x0);
PROVIDE(obj_create = obj_create + 0x0);
PROVIDE(obj_destroy = obj_destroy + 0x0);
PROVIDE(obj_init_defaults = obj_init_defaults + 0x0);
PROVIDE(obj_list_iterate = obj_list_iterate + 0x0);
PROVIDE(obj_list_proc = obj_list_proc + 0x0);
PROVIDE(obj_visibility_test = obj_visibility_test + 0x0);
PROVIDE(obj_update_dispatch = obj_update_dispatch + 0x0);
PROVIDE(obj_culling_pass = obj_culling_pass + 0x0);
PROVIDE(obj_lod_level = obj_lod_level + 0x0);
PROVIDE(obj_lod_selector = obj_lod_selector + 0x0);
PROVIDE(obj_anim_driver = obj_anim_driver + 0x0);
PROVIDE(obj_collision_box = obj_collision_box + 0x0);
PROVIDE(obj_state_pack = obj_state_pack + 0x0);
PROVIDE(obj_collision_update = obj_collision_update + 0x0);
PROVIDE(obj_data_compact = obj_data_compact + 0x0);
PROVIDE(obj_pool_return = obj_pool_return + 0x0);
PROVIDE(obj_state_serialize = obj_state_serialize + 0x0);
PROVIDE(obj_anim_advance = obj_anim_advance + 0x0);
PROVIDE(obj_render_prepare = obj_render_prepare + 0x0);
PROVIDE(obj_state_manager = obj_state_manager + 0x0);
PROVIDE(obj_render_setup = obj_render_setup + 0x0);
PROVIDE(obj_cleanup = obj_cleanup + 0x0);
PROVIDE(obj_render_update = obj_render_update + 0x0);
PROVIDE(obj_render_cleanup = obj_render_cleanup + 0x0);
PROVIDE(obj_overlay_render = obj_overlay_render + 0x0);
PROVIDE(track_obj_placement = track_obj_placement + 0x0);
PROVIDE(scene_process_stage = scene_process_stage + 0x0);
PROVIDE(render_list_builder = render_list_builder + 0x0);
PROVIDE(render_obj_processor = render_obj_processor + 0x0);
PROVIDE(render_batch_proc = render_batch_proc + 0x0);
PROVIDE(projection_mgr = projection_mgr + 0x0);
PROVIDE(render_stage_c = render_stage_c + 0x0);
PROVIDE(render_stage_b = render_stage_b + 0x0);
PROVIDE(scene_setup_master = scene_setup_master + 0x0);
PROVIDE(render_finalize_a = render_finalize_a + 0x0);
PROVIDE(render_finalize_b = render_finalize_b + 0x0);
PROVIDE(scene_finalize_a = scene_finalize_a + 0x0);
PROVIDE(scene_finalize_b = scene_finalize_b + 0x0);
PROVIDE(scene_process_a = scene_process_a + 0x0);
PROVIDE(scene_process_b = scene_process_b + 0x0);
PROVIDE(scene_physics_integrate = scene_physics_integrate + 0x0);
PROVIDE(scene_physics_variant = scene_physics_variant + 0x0);
PROVIDE(scene_dual_finalize = scene_dual_finalize + 0x0);
PROVIDE(transform_heading_apply = transform_heading_apply + 0x0);
PROVIDE(transform_rotation_apply = transform_rotation_apply + 0x0);
PROVIDE(transform_heading_alt = transform_heading_alt + 0x0);
PROVIDE(transform_rotation_alt = transform_rotation_alt + 0x0);
PROVIDE(mat_multiply_basic = mat_multiply_basic + 0x0);
PROVIDE(sprite_pair_render = sprite_pair_render + 0x0);
PROVIDE(sprite_anim_update = sprite_anim_update + 0x0);
PROVIDE(menu_overlay_render = menu_overlay_render + 0x0);
PROVIDE(vdp2_reg_block_setup = vdp2_reg_block_setup + 0x0);
PROVIDE(mat_scale_columns = mat_scale_columns + 0x0);
PROVIDE(mat_rot_x = mat_rot_x + 0x0);
PROVIDE(mat_rot_y = mat_rot_y + 0x0);
PROVIDE(mat_rot_z = mat_rot_z + 0x0);
PROVIDE(mat_vec_transform = mat_vec_transform + 0x0);
PROVIDE(mat_scale_b = mat_scale_b + 0x0);
PROVIDE(mat_rot_xz_b = mat_rot_xz_b + 0x0);
PROVIDE(mat_rot_xy_b = mat_rot_xy_b + 0x0);
PROVIDE(mat_rot_yz_b = mat_rot_yz_b + 0x0);
PROVIDE(mat_vec_transform_b = mat_vec_transform_b + 0x0);
PROVIDE(atan2_full = atan2_full + 0x0);
PROVIDE(vec3_normalize = vec3_normalize + 0x0);
PROVIDE(fpmul = fpmul + 0x0);
PROVIDE(spring_damper = spring_damper + 0x0);
PROVIDE(transform_pipeline = transform_pipeline + 0x0);
PROVIDE(scene_3d_processor = scene_3d_processor + 0x0);
PROVIDE(scene_render_alt = scene_render_alt + 0x0);
PROVIDE(hud_number_display = hud_number_display + 0x0);
PROVIDE(effect_init_stub = effect_init_stub + 0x0);
PROVIDE(screen_flash_effect = screen_flash_effect + 0x0);
PROVIDE(screen_fade_ctrl = screen_fade_ctrl + 0x0);
PROVIDE(motion_blur_effect = motion_blur_effect + 0x0);
PROVIDE(effect_cleanup_stub = effect_cleanup_stub + 0x0);
PROVIDE(particle_sys_mgr = particle_sys_mgr + 0x0);
PROVIDE(dma_memory_transfer = dma_memory_transfer + 0x0);
PROVIDE(mega_render_func = mega_render_func + 0x0);
PROVIDE(render_pass_secondary = render_pass_secondary + 0x0);
PROVIDE(scene_proc_b = scene_proc_b + 0x0);
PROVIDE(scene_proc_c = scene_proc_c + 0x0);
PROVIDE(scene_proc_d = scene_proc_d + 0x0);
PROVIDE(scene_graph_walk = scene_graph_walk + 0x0);
PROVIDE(vdp1_cmd_emit = vdp1_cmd_emit + 0x0);
PROVIDE(vdp1_list_finalize = vdp1_list_finalize + 0x0);
PROVIDE(scene_proc_e = scene_proc_e + 0x0);
PROVIDE(vdp1_display_list_setup = vdp1_display_list_setup + 0x0);
PROVIDE(vdp1_texture_setup = vdp1_texture_setup + 0x0);
PROVIDE(vdp1_color_setup = vdp1_color_setup + 0x0);
PROVIDE(vdp1_coord_setup = vdp1_coord_setup + 0x0);
PROVIDE(vdp1_attr_setup = vdp1_attr_setup + 0x0);
PROVIDE(vdp1_cmd_list_mgr = vdp1_cmd_list_mgr + 0x0);
PROVIDE(vdp1_sprite_cmd = vdp1_sprite_cmd + 0x0);
PROVIDE(vdp1_display_submit = vdp1_display_submit + 0x0);
PROVIDE(vtx_clip_flag_set = vtx_clip_flag_set + 0x0);
PROVIDE(clip_region_test = clip_region_test + 0x0);
PROVIDE(disp_elem_render_ext = disp_elem_render_ext + 0x0);
PROVIDE(vtx_transform_full = vtx_transform_full + 0x0);
PROVIDE(vdp_transform_stub = vdp_transform_stub + 0x0);
PROVIDE(transform_chain_entry = transform_chain_entry + 0x0);
PROVIDE(vdp1_cmd_list_reset = vdp1_cmd_list_reset + 0x0);
PROVIDE(vdp1_cmd_init = vdp1_cmd_init + 0x0);
PROVIDE(vdp1_normal_sprite = vdp1_normal_sprite + 0x0);
PROVIDE(vdp1_scaled_sprite = vdp1_scaled_sprite + 0x0);
PROVIDE(vdp1_line_draw = vdp1_line_draw + 0x0);
PROVIDE(vdp1_polyline = vdp1_polyline + 0x0);
PROVIDE(vdp1_poly3 = vdp1_poly3 + 0x0);
PROVIDE(vdp1_poly4 = vdp1_poly4 + 0x0);
PROVIDE(vdp1_end_marker = vdp1_end_marker + 0x0);
PROVIDE(vdp1_distorted_sprite = vdp1_distorted_sprite + 0x0);
PROVIDE(scene_zsort = scene_zsort + 0x0);
PROVIDE(draw_priority_resolve = draw_priority_resolve + 0x0);
PROVIDE(vdp2_reg_write_a = vdp2_reg_write_a + 0x0);
PROVIDE(vdp2_reg_write_b = vdp2_reg_write_b + 0x0);
PROVIDE(vdp2_scroll_pos_a = vdp2_scroll_pos_a + 0x0);
PROVIDE(vdp2_scroll_pos_b = vdp2_scroll_pos_b + 0x0);
PROVIDE(vdp2_priority_a = vdp2_priority_a + 0x0);
PROVIDE(vdp2_priority_b = vdp2_priority_b + 0x0);
PROVIDE(vdp2_color_offset = vdp2_color_offset + 0x0);
PROVIDE(vdp2_scroll_setup = vdp2_scroll_setup + 0x0);
PROVIDE(vdp2_coeff_load = vdp2_coeff_load + 0x0);
PROVIDE(vdp2_coeff_stub = vdp2_coeff_stub + 0x0);
PROVIDE(vdp2_coeff_helper_a = vdp2_coeff_helper_a + 0x0);
PROVIDE(vdp2_coeff_helper_b = vdp2_coeff_helper_b + 0x0);
PROVIDE(vdp2_coeff_helper_c = vdp2_coeff_helper_c + 0x0);
PROVIDE(vdp2_coeff_helper_d = vdp2_coeff_helper_d + 0x0);
PROVIDE(rbg_rot_matrix_calc = rbg_rot_matrix_calc + 0x0);
PROVIDE(rot_scroll_commit = rot_scroll_commit + 0x0);
PROVIDE(rot_scroll_interp = rot_scroll_interp + 0x0);
PROVIDE(rot_scroll_vscale = rot_scroll_vscale + 0x0);
PROVIDE(rot_scroll_hscale = rot_scroll_hscale + 0x0);
PROVIDE(palette_fade_calc = palette_fade_calc + 0x0);
PROVIDE(vdp2_palette_commit = vdp2_palette_commit + 0x0);
PROVIDE(vdp2_color_bank_sel = vdp2_color_bank_sel + 0x0);
PROVIDE(vdp2_color_offset_anim = vdp2_color_offset_anim + 0x0);
PROVIDE(palette_full_update = palette_full_update + 0x0);
PROVIDE(vdp2_light_dir_stub = vdp2_light_dir_stub + 0x0);
PROVIDE(vdp2_light_intensity = vdp2_light_intensity + 0x0);
PROVIDE(gouraud_color_calc = gouraud_color_calc + 0x0);
PROVIDE(per_vtx_lighting = per_vtx_lighting + 0x0);
PROVIDE(shadow_intensity = shadow_intensity + 0x0);
PROVIDE(billboard_facing = billboard_facing + 0x0);
PROVIDE(billboard_scale = billboard_scale + 0x0);
PROVIDE(billboard_uv_map = billboard_uv_map + 0x0);
PROVIDE(main_scene_render = main_scene_render + 0x0);
PROVIDE(secondary_render_pass = secondary_render_pass + 0x0);
PROVIDE(render_orchestrator = render_orchestrator + 0x0);
PROVIDE(track_seg_visibility = track_seg_visibility + 0x0);
PROVIDE(render_camera_compute = render_camera_compute + 0x0);
PROVIDE(track_seg_render_setup = track_seg_render_setup + 0x0);
PROVIDE(collision_response_b = collision_response_b + 0x0);
PROVIDE(track_poly_build = track_poly_build + 0x0);
PROVIDE(color_material_blend = color_material_blend + 0x0);
PROVIDE(sprite_transform = sprite_transform + 0x0);
PROVIDE(track_texture_map = track_texture_map + 0x0);
PROVIDE(sprite_batch_render = sprite_batch_render + 0x0);
PROVIDE(track_render_pipeline = track_render_pipeline + 0x0);
PROVIDE(track_scenery_render = track_scenery_render + 0x0);
PROVIDE(engine_sound_body = engine_sound_body + 0x0);
PROVIDE(leaf_stub_return = leaf_stub_return + 0x0);
PROVIDE(sound_music_ctrl = sound_music_ctrl + 0x0);
PROVIDE(sound_subsys_wrapper = sound_subsys_wrapper + 0x0);
PROVIDE(sound_channel_mgr = sound_channel_mgr + 0x0);
PROVIDE(sound_enable_toggle = sound_enable_toggle + 0x0);
PROVIDE(sound_volume_set = sound_volume_set + 0x0);
PROVIDE(hud_number_render = hud_number_render + 0x0);
PROVIDE(display_element_stub = display_element_stub + 0x0);
PROVIDE(position_lap_display = position_lap_display + 0x0);
PROVIDE(collision_impulse = collision_impulse + 0x0);
PROVIDE(collision_order_a = collision_order_a + 0x0);
PROVIDE(collision_order_b = collision_order_b + 0x0);
PROVIDE(timer_countdown_display = timer_countdown_display + 0x0);
PROVIDE(speed_tacho_display = speed_tacho_display + 0x0);
PROVIDE(disp_init_setup = disp_init_setup + 0x0);
PROVIDE(display_init_helper = display_init_helper + 0x0);
PROVIDE(display_element_table = display_element_table + 0x0);
PROVIDE(display_dispatch_0 = display_dispatch_0 + 0x0);
PROVIDE(disp_elem_proc_1 = disp_elem_proc_1 + 0x0);
PROVIDE(disp_elem_proc_2 = disp_elem_proc_2 + 0x0);
PROVIDE(disp_elem_proc_3 = disp_elem_proc_3 + 0x0);
PROVIDE(disp_elem_proc_4 = disp_elem_proc_4 + 0x0);
PROVIDE(disp_elem_proc_5 = disp_elem_proc_5 + 0x0);
PROVIDE(disp_elem_proc_6 = disp_elem_proc_6 + 0x0);
PROVIDE(display_dispatch_pop = display_dispatch_pop + 0x0);
PROVIDE(display_cmd_hscroll = display_cmd_hscroll + 0x0);
PROVIDE(display_cmd_vscroll = display_cmd_vscroll + 0x0);
PROVIDE(display_cmd_position = display_cmd_position + 0x0);
PROVIDE(disp_tile_idx_0 = disp_tile_idx_0 + 0x0);
PROVIDE(disp_tile_idx_1 = disp_tile_idx_1 + 0x0);
PROVIDE(disp_tile_idx_2 = disp_tile_idx_2 + 0x0);
PROVIDE(disp_tile_idx_3 = disp_tile_idx_3 + 0x0);
PROVIDE(disp_tile_idx_4 = disp_tile_idx_4 + 0x0);
PROVIDE(disp_tile_idx_5 = disp_tile_idx_5 + 0x0);
PROVIDE(disp_tile_idx_6 = disp_tile_idx_6 + 0x0);
PROVIDE(disp_tile_idx_7 = disp_tile_idx_7 + 0x0);
PROVIDE(digit_render_2 = digit_render_2 + 0x0);
PROVIDE(digit_separator = digit_separator + 0x0);
PROVIDE(disp_digit_thunk_a = disp_digit_thunk_a + 0x0);
PROVIDE(disp_digit_pair_render = disp_digit_pair_render + 0x0);
PROVIDE(position_thunk_0 = position_thunk_0 + 0x0);
PROVIDE(disp_rank_elem_a = disp_rank_elem_a + 0x0);
PROVIDE(disp_rank_elem_b = disp_rank_elem_b + 0x0);
PROVIDE(disp_rank_elem_c = disp_rank_elem_c + 0x0);
PROVIDE(position_suffix_render = position_suffix_render + 0x0);
PROVIDE(hud_laptime_idx_0 = hud_laptime_idx_0 + 0x0);
PROVIDE(hud_laptime_idx_1 = hud_laptime_idx_1 + 0x0);
PROVIDE(hud_laptime_idx_2 = hud_laptime_idx_2 + 0x0);
PROVIDE(hud_laptime_idx_3 = hud_laptime_idx_3 + 0x0);
PROVIDE(hud_laptime_idx_4 = hud_laptime_idx_4 + 0x0);
PROVIDE(hud_laptime_group_render = hud_laptime_group_render + 0x0);
PROVIDE(hud_laptime_idx_5 = hud_laptime_idx_5 + 0x0);
PROVIDE(hud_laptime_idx_6 = hud_laptime_idx_6 + 0x0);
PROVIDE(hud_laptime_idx_7 = hud_laptime_idx_7 + 0x0);
PROVIDE(hud_laptime_idx_8 = hud_laptime_idx_8 + 0x0);
PROVIDE(best_lap_render = best_lap_render + 0x0);
PROVIDE(hud_besttime_idx_0 = hud_besttime_idx_0 + 0x0);
PROVIDE(hud_besttime_idx_1 = hud_besttime_idx_1 + 0x0);
PROVIDE(hud_besttime_idx_2 = hud_besttime_idx_2 + 0x0);
PROVIDE(hud_besttime_idx_3 = hud_besttime_idx_3 + 0x0);
PROVIDE(speed_hundreds_digit = speed_hundreds_digit + 0x0);
PROVIDE(hud_speed_tens = hud_speed_tens + 0x0);
PROVIDE(speed_ones_digit = speed_ones_digit + 0x0);
PROVIDE(hud_speed_decimal = hud_speed_decimal + 0x0);
PROVIDE(speed_group_render = speed_group_render + 0x0);
PROVIDE(hud_speed_idx_0 = hud_speed_idx_0 + 0x0);
PROVIDE(hud_speed_idx_1 = hud_speed_idx_1 + 0x0);
PROVIDE(hud_speed_idx_2 = hud_speed_idx_2 + 0x0);
PROVIDE(hud_speed_idx_3 = hud_speed_idx_3 + 0x0);
PROVIDE(speed_alt_render = speed_alt_render + 0x0);
PROVIDE(hud_speed_suffix = hud_speed_suffix + 0x0);
PROVIDE(speed_kmh_label = speed_kmh_label + 0x0);
PROVIDE(speed_unit_select = speed_unit_select + 0x0);
PROVIDE(speed_display_commit = speed_display_commit + 0x0);
PROVIDE(rpm_gauge_render = rpm_gauge_render + 0x0);
PROVIDE(hud_rpm_digit_0 = hud_rpm_digit_0 + 0x0);
PROVIDE(hud_rpm_digit_1 = hud_rpm_digit_1 + 0x0);
PROVIDE(hud_rpm_digit_2 = hud_rpm_digit_2 + 0x0);
PROVIDE(rpm_display_commit = rpm_display_commit + 0x0);
PROVIDE(hud_rpm_bar_idx_0 = hud_rpm_bar_idx_0 + 0x0);
PROVIDE(hud_rpm_bar_idx_1 = hud_rpm_bar_idx_1 + 0x0);
PROVIDE(hud_rpm_bar_idx_2 = hud_rpm_bar_idx_2 + 0x0);
PROVIDE(hud_rpm_bar_idx_3 = hud_rpm_bar_idx_3 + 0x0);
PROVIDE(rpm_bar_render = rpm_bar_render + 0x0);
PROVIDE(hud_rpm_redline = hud_rpm_redline + 0x0);
PROVIDE(rpm_display_group = rpm_display_group + 0x0);
PROVIDE(hud_gear_idx_0 = hud_gear_idx_0 + 0x0);
PROVIDE(hud_gear_idx_1 = hud_gear_idx_1 + 0x0);
PROVIDE(hud_gear_idx_2 = hud_gear_idx_2 + 0x0);
PROVIDE(hud_gear_idx_3 = hud_gear_idx_3 + 0x0);
PROVIDE(gear_indicator_render = gear_indicator_render + 0x0);
PROVIDE(hud_gear_neutral = hud_gear_neutral + 0x0);
PROVIDE(gear_display_commit = gear_display_commit + 0x0);
PROVIDE(hud_master_compositor = hud_master_compositor + 0x0);
PROVIDE(minimap_offset_set = minimap_offset_set + 0x0);
PROVIDE(hud_map_elem_00 = hud_map_elem_00 + 0x0);
PROVIDE(hud_map_elem_01 = hud_map_elem_01 + 0x0);
PROVIDE(hud_map_elem_02 = hud_map_elem_02 + 0x0);
PROVIDE(hud_map_elem_03 = hud_map_elem_03 + 0x0);
PROVIDE(hud_map_elem_04 = hud_map_elem_04 + 0x0);
PROVIDE(hud_map_elem_05 = hud_map_elem_05 + 0x0);
PROVIDE(hud_map_elem_06 = hud_map_elem_06 + 0x0);
PROVIDE(hud_map_elem_07 = hud_map_elem_07 + 0x0);
PROVIDE(hud_map_elem_08 = hud_map_elem_08 + 0x0);
PROVIDE(hud_map_elem_09 = hud_map_elem_09 + 0x0);
PROVIDE(hud_map_elem_10 = hud_map_elem_10 + 0x0);
PROVIDE(hud_map_elem_11 = hud_map_elem_11 + 0x0);
PROVIDE(disp_helper_a = disp_helper_a + 0x0);
PROVIDE(disp_helper_b = disp_helper_b + 0x0);
PROVIDE(disp_helper_c = disp_helper_c + 0x0);
PROVIDE(disp_helper_d = disp_helper_d + 0x0);
PROVIDE(display_mode_switch = display_mode_switch + 0x0);
PROVIDE(disp_mode_switch = disp_mode_switch + 0x0);
PROVIDE(disp_util_stub_a = disp_util_stub_a + 0x0);
PROVIDE(disp_util_stub_b = disp_util_stub_b + 0x0);
PROVIDE(disp_util_main = disp_util_main + 0x0);
PROVIDE(display_palette_load = display_palette_load + 0x0);
PROVIDE(color_anim_ctrl = color_anim_ctrl + 0x0);
PROVIDE(disp_result_digit_0 = disp_result_digit_0 + 0x0);
PROVIDE(disp_result_digit_1 = disp_result_digit_1 + 0x0);
PROVIDE(disp_result_digit_2 = disp_result_digit_2 + 0x0);
PROVIDE(disp_result_digit_3 = disp_result_digit_3 + 0x0);
PROVIDE(results_digit_group = results_digit_group + 0x0);
PROVIDE(results_separator = results_separator + 0x0);
PROVIDE(results_full_render = results_full_render + 0x0);
PROVIDE(results_time_render = results_time_render + 0x0);
PROVIDE(disp_result_sub_a = disp_result_sub_a + 0x0);
PROVIDE(results_sub_elem = results_sub_elem + 0x0);
PROVIDE(disp_result_sub_b = disp_result_sub_b + 0x0);
PROVIDE(disp_result_sub_c = disp_result_sub_c + 0x0);
PROVIDE(attract_mode_stub = attract_mode_stub + 0x0);
PROVIDE(attract_mode_init = attract_mode_init + 0x0);
PROVIDE(disp_attract_elem = disp_attract_elem + 0x0);
PROVIDE(disp_attract_cleanup = disp_attract_cleanup + 0x0);
PROVIDE(split_hud_render = split_hud_render + 0x0);
PROVIDE(disp_split_stub = disp_split_stub + 0x0);
PROVIDE(split_position_disp = split_position_disp + 0x0);
PROVIDE(disp_course_thunk_0 = disp_course_thunk_0 + 0x0);
PROVIDE(disp_course_thunk_1 = disp_course_thunk_1 + 0x0);
PROVIDE(disp_course_thunk_2 = disp_course_thunk_2 + 0x0);
PROVIDE(disp_course_thunk_3 = disp_course_thunk_3 + 0x0);
PROVIDE(course_name_render = course_name_render + 0x0);
PROVIDE(disp_course_separator = disp_course_separator + 0x0);
PROVIDE(course_desc_display = course_desc_display + 0x0);
PROVIDE(course_preview_elem = course_preview_elem + 0x0);
PROVIDE(course_stats_display = course_stats_display + 0x0);
PROVIDE(course_transition = course_transition + 0x0);
PROVIDE(course_selector_hl = course_selector_hl + 0x0);
PROVIDE(disp_course_icon = disp_course_icon + 0x0);
PROVIDE(disp_course_stub = disp_course_stub + 0x0);
PROVIDE(display_element_mgr = display_element_mgr + 0x0);
PROVIDE(hud_subsystem_init = hud_subsystem_init + 0x0);
PROVIDE(camera_attract_init = camera_attract_init + 0x0);
PROVIDE(disp_timeext_digit_0 = disp_timeext_digit_0 + 0x0);
PROVIDE(disp_timeext_digit_1 = disp_timeext_digit_1 + 0x0);
PROVIDE(disp_timeext_digit_2 = disp_timeext_digit_2 + 0x0);
PROVIDE(time_extend_digits = time_extend_digits + 0x0);
PROVIDE(disp_sel_thunk_00 = disp_sel_thunk_00 + 0x0);
PROVIDE(disp_sel_thunk_01 = disp_sel_thunk_01 + 0x0);
PROVIDE(disp_sel_thunk_02 = disp_sel_thunk_02 + 0x0);
PROVIDE(disp_sel_thunk_03 = disp_sel_thunk_03 + 0x0);
PROVIDE(disp_sel_thunk_04 = disp_sel_thunk_04 + 0x0);
PROVIDE(disp_sel_thunk_05 = disp_sel_thunk_05 + 0x0);
PROVIDE(disp_sel_thunk_06 = disp_sel_thunk_06 + 0x0);
PROVIDE(disp_sel_thunk_07 = disp_sel_thunk_07 + 0x0);
PROVIDE(disp_sel_thunk_08 = disp_sel_thunk_08 + 0x0);
PROVIDE(disp_sel_thunk_09 = disp_sel_thunk_09 + 0x0);
PROVIDE(disp_sel_thunk_10 = disp_sel_thunk_10 + 0x0);
PROVIDE(disp_sel_thunk_11 = disp_sel_thunk_11 + 0x0);
PROVIDE(disp_sel_thunk_12 = disp_sel_thunk_12 + 0x0);
PROVIDE(disp_sel_thunk_13 = disp_sel_thunk_13 + 0x0);
PROVIDE(disp_sel_thunk_14 = disp_sel_thunk_14 + 0x0);
PROVIDE(disp_sel_thunk_15 = disp_sel_thunk_15 + 0x0);
PROVIDE(disp_sel_thunk_16 = disp_sel_thunk_16 + 0x0);
PROVIDE(disp_sel_thunk_17 = disp_sel_thunk_17 + 0x0);
PROVIDE(disp_sel_thunk_18 = disp_sel_thunk_18 + 0x0);
PROVIDE(selector_group_render = selector_group_render + 0x0);
PROVIDE(disp_selext_thunk_00 = disp_selext_thunk_00 + 0x0);
PROVIDE(disp_selext_thunk_01 = disp_selext_thunk_01 + 0x0);
PROVIDE(disp_selext_thunk_02 = disp_selext_thunk_02 + 0x0);
PROVIDE(disp_selext_thunk_03 = disp_selext_thunk_03 + 0x0);
PROVIDE(disp_selext_thunk_04 = disp_selext_thunk_04 + 0x0);
PROVIDE(disp_selext_thunk_05 = disp_selext_thunk_05 + 0x0);
PROVIDE(disp_selext_thunk_06 = disp_selext_thunk_06 + 0x0);
PROVIDE(disp_selext_thunk_07 = disp_selext_thunk_07 + 0x0);
PROVIDE(disp_selext_thunk_08 = disp_selext_thunk_08 + 0x0);
PROVIDE(disp_selext_thunk_09 = disp_selext_thunk_09 + 0x0);
PROVIDE(disp_selext_thunk_10 = disp_selext_thunk_10 + 0x0);
PROVIDE(disp_selext_thunk_11 = disp_selext_thunk_11 + 0x0);
PROVIDE(disp_selext_thunk_12 = disp_selext_thunk_12 + 0x0);
PROVIDE(disp_selext_thunk_13 = disp_selext_thunk_13 + 0x0);
PROVIDE(disp_selext_thunk_14 = disp_selext_thunk_14 + 0x0);
PROVIDE(disp_selext_thunk_15 = disp_selext_thunk_15 + 0x0);
PROVIDE(disp_selext_thunk_16 = disp_selext_thunk_16 + 0x0);
PROVIDE(disp_selext_thunk_17 = disp_selext_thunk_17 + 0x0);
PROVIDE(disp_selext_thunk_18 = disp_selext_thunk_18 + 0x0);
PROVIDE(score_display_render = score_display_render + 0x0);
PROVIDE(disp_score_renderer = disp_score_renderer + 0x0);
PROVIDE(disp_score_digit_0 = disp_score_digit_0 + 0x0);
PROVIDE(disp_score_digit_1 = disp_score_digit_1 + 0x0);
PROVIDE(disp_score_digit_2 = disp_score_digit_2 + 0x0);
PROVIDE(bonus_points_display = bonus_points_display + 0x0);
PROVIDE(disp_end_stub_0 = disp_end_stub_0 + 0x0);
PROVIDE(disp_end_stub_1 = disp_end_stub_1 + 0x0);
PROVIDE(display_frame_mgr = display_frame_mgr + 0x0);
PROVIDE(disp_end_stub_2 = disp_end_stub_2 + 0x0);
PROVIDE(disp_end_stub_3 = disp_end_stub_3 + 0x0);
PROVIDE(disp_end_stub_4 = disp_end_stub_4 + 0x0);
PROVIDE(disp_end_stub_5 = disp_end_stub_5 + 0x0);
PROVIDE(disp_end_stub_6 = disp_end_stub_6 + 0x0);
PROVIDE(disp_end_stub_7 = disp_end_stub_7 + 0x0);
PROVIDE(disp_end_stub_8 = disp_end_stub_8 + 0x0);
PROVIDE(disp_end_stub_9 = disp_end_stub_9 + 0x0);
PROVIDE(display_frame_flush = display_frame_flush + 0x0);
PROVIDE(phys_position_load = phys_position_load + 0x0);
PROVIDE(phys_velocity_integrate = phys_velocity_integrate + 0x0);
PROVIDE(phys_result_store = phys_result_store + 0x0);
PROVIDE(phys_perspective = phys_perspective + 0x0);
PROVIDE(phys_final_integrate = phys_final_integrate + 0x0);
PROVIDE(phys_lighting_setup = phys_lighting_setup + 0x0);
PROVIDE(ai_steering_response = ai_steering_response + 0x0);
PROVIDE(ai_vel_x_entry = ai_vel_x_entry + 0x0);
PROVIDE(ai_vel_x_step_a = ai_vel_x_step_a + 0x0);
PROVIDE(ai_vel_x_step_b = ai_vel_x_step_b + 0x0);
PROVIDE(ai_vel_x_step_c = ai_vel_x_step_c + 0x0);
PROVIDE(xaxis_integrate_damp = xaxis_integrate_damp + 0x0);
PROVIDE(ai_vel_x_cleanup_entry = ai_vel_x_cleanup_entry + 0x0);
PROVIDE(ai_vel_x_cleanup_a = ai_vel_x_cleanup_a + 0x0);
PROVIDE(ai_vel_x_cleanup_b = ai_vel_x_cleanup_b + 0x0);
PROVIDE(ai_vel_x_cleanup_c = ai_vel_x_cleanup_c + 0x0);
PROVIDE(yaxis_integrate = yaxis_integrate + 0x0);
PROVIDE(ai_vel_y_entry = ai_vel_y_entry + 0x0);
PROVIDE(ai_vel_y_step_a = ai_vel_y_step_a + 0x0);
PROVIDE(ai_vel_y_step_b = ai_vel_y_step_b + 0x0);
PROVIDE(ai_vel_y_step_c = ai_vel_y_step_c + 0x0);
PROVIDE(zaxis_integrate = zaxis_integrate + 0x0);
PROVIDE(ai_vel_z_entry = ai_vel_z_entry + 0x0);
PROVIDE(ai_vel_z_step_a = ai_vel_z_step_a + 0x0);
PROVIDE(ai_vel_z_step_b = ai_vel_z_step_b + 0x0);
PROVIDE(ai_vel_z_step_c = ai_vel_z_step_c + 0x0);
PROVIDE(ai_rot_a_entry = ai_rot_a_entry + 0x0);
PROVIDE(ai_rot_a_step = ai_rot_a_step + 0x0);
PROVIDE(ai_rot_a_fix_a = ai_rot_a_fix_a + 0x0);
PROVIDE(ai_rot_a_fix_b = ai_rot_a_fix_b + 0x0);
PROVIDE(ai_rot_a_fix_c = ai_rot_a_fix_c + 0x0);
PROVIDE(ai_rot_b_entry = ai_rot_b_entry + 0x0);
PROVIDE(ai_rot_b_step = ai_rot_b_step + 0x0);
PROVIDE(ai_rot_b_fix_a = ai_rot_b_fix_a + 0x0);
PROVIDE(ai_rot_b_fix_b = ai_rot_b_fix_b + 0x0);
PROVIDE(ai_rot_b_fix_c = ai_rot_b_fix_c + 0x0);
PROVIDE(ai_decision_dispatch = ai_decision_dispatch + 0x0);
PROVIDE(ai_speed_limit = ai_speed_limit + 0x0);
PROVIDE(ai_waypoint_follower = ai_waypoint_follower + 0x0);
PROVIDE(ai_collision_trigger = ai_collision_trigger + 0x0);
PROVIDE(ai_collision_response = ai_collision_response + 0x0);
PROVIDE(ai_reset_stub = ai_reset_stub + 0x0);
PROVIDE(ai_car_pos_init = ai_car_pos_init + 0x0);
PROVIDE(ai_spawn_helper_a = ai_spawn_helper_a + 0x0);
PROVIDE(ai_spawn_helper_b = ai_spawn_helper_b + 0x0);
PROVIDE(ai_spawn_helper_c = ai_spawn_helper_c + 0x0);
PROVIDE(ai_spawn_helper_d = ai_spawn_helper_d + 0x0);
PROVIDE(ai_car_full_init = ai_car_full_init + 0x0);
PROVIDE(vblank_handler = vblank_handler + 0x0);
PROVIDE(ai_rank_stub_a = ai_rank_stub_a + 0x0);
PROVIDE(ai_rank_stub_b = ai_rank_stub_b + 0x0);
PROVIDE(position_calc_current = position_calc_current + 0x0);
PROVIDE(ranking_system_full = ranking_system_full + 0x0);
PROVIDE(lap_complete_check = lap_complete_check + 0x0);
PROVIDE(terrain_data_lookup = terrain_data_lookup + 0x0);
PROVIDE(checkpoint_validate = checkpoint_validate + 0x0);
PROVIDE(section_transition = section_transition + 0x0);
PROVIDE(ai_checkpoint_section = ai_checkpoint_section + 0x0);
PROVIDE(ai_checkpoint_validate = ai_checkpoint_validate + 0x0);
PROVIDE(cd_block_read_safe = cd_block_read_safe + 0x0);
PROVIDE(cd_block_read_atomic = cd_block_read_atomic + 0x0);
PROVIDE(ai_nop_stub = ai_nop_stub + 0x0);
PROVIDE(ai_pit_stop_logic = ai_pit_stop_logic + 0x0);
PROVIDE(track_intersect_test = track_intersect_test + 0x0);
PROVIDE(mesh_boundary_check = mesh_boundary_check + 0x0);
PROVIDE(ai_crash_recovery = ai_crash_recovery + 0x0);
PROVIDE(road_segment_query = road_segment_query + 0x0);
PROVIDE(ai_drafting_calc = ai_drafting_calc + 0x0);
PROVIDE(ai_brake_zone_calc = ai_brake_zone_calc + 0x0);
PROVIDE(ai_brake_zone_adjust = ai_brake_zone_adjust + 0x0);
PROVIDE(ai_brake_zone_main = ai_brake_zone_main + 0x0);
PROVIDE(ai_brake_zone = ai_brake_zone + 0x0);
PROVIDE(ai_throttle_modulate = ai_throttle_modulate + 0x0);
PROVIDE(ai_throttle_mod = ai_throttle_mod + 0x0);
PROVIDE(ai_throttle_adjust = ai_throttle_adjust + 0x0);
PROVIDE(ai_recovery_handler = ai_recovery_handler + 0x0);
PROVIDE(smpc_cmd_init = smpc_cmd_init + 0x0);
PROVIDE(smpc_cmd_builder = smpc_cmd_builder + 0x0);
PROVIDE(slave_main_loop = slave_main_loop + 0x0);
PROVIDE(secondary_input_proc = secondary_input_proc + 0x0);
PROVIDE(smpc_cmd_helper_a = smpc_cmd_helper_a + 0x0);
PROVIDE(smpc_cmd_helper_b = smpc_cmd_helper_b + 0x0);
PROVIDE(smpc_cmd_helper_c = smpc_cmd_helper_c + 0x0);
PROVIDE(smpc_secondary_proc = smpc_secondary_proc + 0x0);
PROVIDE(smpc_response_handler = smpc_response_handler + 0x0);
PROVIDE(smpc_peripheral_query = smpc_peripheral_query + 0x0);
PROVIDE(input_proc_init = input_proc_init + 0x0);
PROVIDE(input_proc_analog = input_proc_analog + 0x0);
PROVIDE(input_proc_digital = input_proc_digital + 0x0);
PROVIDE(input_proc_buttons = input_proc_buttons + 0x0);
PROVIDE(input_proc_extended = input_proc_extended + 0x0);
PROVIDE(input_proc_complete = input_proc_complete + 0x0);
PROVIDE(track_seg_boundary = track_seg_boundary + 0x0);
PROVIDE(seg_boundary_check = seg_boundary_check + 0x0);
PROVIDE(seg_data_loader = seg_data_loader + 0x0);
PROVIDE(track_seg_nop_stub = track_seg_nop_stub + 0x0);
PROVIDE(seg_interpolate = seg_interpolate + 0x0);
PROVIDE(track_seg_interpolate = track_seg_interpolate + 0x0);
PROVIDE(seg_curve_reader = seg_curve_reader + 0x0);
PROVIDE(track_seg_stub = track_seg_stub + 0x0);
PROVIDE(track_bank_angle = track_bank_angle + 0x0);
PROVIDE(track_bank_calc = track_bank_calc + 0x0);
PROVIDE(road_width_calc = road_width_calc + 0x0);
PROVIDE(track_road_width_stub = track_road_width_stub + 0x0);
PROVIDE(course_data_read = course_data_read + 0x0);
PROVIDE(track_road_width_main = track_road_width_main + 0x0);
PROVIDE(track_road_edge_a = track_road_edge_a + 0x0);
PROVIDE(track_road_edge_b = track_road_edge_b + 0x0);
PROVIDE(course_data_access_a = course_data_access_a + 0x0);
PROVIDE(track_road_edge_c = track_road_edge_c + 0x0);
PROVIDE(course_data_access_b = course_data_access_b + 0x0);
PROVIDE(track_road_stub = track_road_stub + 0x0);
PROVIDE(course_data_access_c = course_data_access_c + 0x0);
PROVIDE(track_surface_type_a = track_surface_type_a + 0x0);
PROVIDE(course_data_access_d = course_data_access_d + 0x0);
PROVIDE(track_surface_type_b = track_surface_type_b + 0x0);
PROVIDE(course_data_access_e = course_data_access_e + 0x0);
PROVIDE(track_surface_type_c = track_surface_type_c + 0x0);
PROVIDE(course_data_access_f = course_data_access_f + 0x0);
PROVIDE(track_surface_type_d = track_surface_type_d + 0x0);
PROVIDE(course_data_access_g = course_data_access_g + 0x0);
PROVIDE(track_distance_calc = track_distance_calc + 0x0);
PROVIDE(track_dist_3d = track_dist_3d + 0x0);
PROVIDE(track_dist_stub = track_dist_stub + 0x0);
PROVIDE(distance_3d_calc = distance_3d_calc + 0x0);
PROVIDE(track_dist_threshold = track_dist_threshold + 0x0);
PROVIDE(bbox_overlap_test = bbox_overlap_test + 0x0);
PROVIDE(track_collision_stub = track_collision_stub + 0x0);
PROVIDE(collision_normal_calc = collision_normal_calc + 0x0);
PROVIDE(track_impact_stub = track_impact_stub + 0x0);
PROVIDE(impact_force_calc = impact_force_calc + 0x0);
PROVIDE(track_impact_force = track_impact_force + 0x0);
PROVIDE(collision_response_vel = collision_response_vel + 0x0);
PROVIDE(track_impact_response = track_impact_response + 0x0);
PROVIDE(post_collision_adjust = post_collision_adjust + 0x0);
PROVIDE(track_impact_adjust_stub = track_impact_adjust_stub + 0x0);
PROVIDE(obj_visibility_check = obj_visibility_check + 0x0);
PROVIDE(track_impact_vel_stub = track_impact_vel_stub + 0x0);
PROVIDE(obj_render_queue = obj_render_queue + 0x0);
PROVIDE(track_impact_vel_update = track_impact_vel_update + 0x0);
PROVIDE(obj_lod_select = obj_lod_select + 0x0);
PROVIDE(track_post_collision = track_post_collision + 0x0);
PROVIDE(obj_render_dispatch = obj_render_dispatch + 0x0);
PROVIDE(track_post_nop_stub = track_post_nop_stub + 0x0);
PROVIDE(obj_view_frustum = obj_view_frustum + 0x0);
PROVIDE(track_shadow_project = track_shadow_project + 0x0);
PROVIDE(shadow_projection = shadow_projection + 0x0);
PROVIDE(track_shadow_stub = track_shadow_stub + 0x0);
PROVIDE(ground_shadow_render = ground_shadow_render + 0x0);
PROVIDE(track_shadow_ground = track_shadow_ground + 0x0);
PROVIDE(dynamic_shadow_shape = dynamic_shadow_shape + 0x0);
PROVIDE(track_shadow_shape = track_shadow_shape + 0x0);
PROVIDE(shadow_color_alpha = shadow_color_alpha + 0x0);
PROVIDE(track_effect_stub = track_effect_stub + 0x0);
PROVIDE(particle_spawner = particle_spawner + 0x0);
PROVIDE(ai_master_update = ai_master_update + 0x0);
PROVIDE(display_buffer_init = display_buffer_init + 0x0);
PROVIDE(palette_regs_config = palette_regs_config + 0x0);
PROVIDE(tilemap_dma_update = tilemap_dma_update + 0x0);
PROVIDE(vdp_init_master = vdp_init_master + 0x0);
PROVIDE(texture_bank_setup = texture_bank_setup + 0x0);
PROVIDE(vdp1_polygon_build = vdp1_polygon_build + 0x0);
PROVIDE(display_enable_ctrl = display_enable_ctrl + 0x0);
PROVIDE(scene_buffer_init = scene_buffer_init + 0x0);
PROVIDE(display_hw_init = display_hw_init + 0x0);
PROVIDE(vdp2_regs_setup = vdp2_regs_setup + 0x0);
PROVIDE(scene_data_write_abs = scene_data_write_abs + 0x0);
PROVIDE(scene_data_write_add = scene_data_write_add + 0x0);
PROVIDE(scene_color_intensity = scene_color_intensity + 0x0);
PROVIDE(scene_data_block_copy = scene_data_block_copy + 0x0);
PROVIDE(scene_data_dispatch = scene_data_dispatch + 0x0);
PROVIDE(display_extra_config = display_extra_config + 0x0);
PROVIDE(display_mode_config = display_mode_config + 0x0);
PROVIDE(channel_nibble_config = channel_nibble_config + 0x0);
PROVIDE(display_param_set = display_param_set + 0x0);
PROVIDE(reg_prologue_chain_a = reg_prologue_chain_a + 0x0);
PROVIDE(vblank_display_write = vblank_display_write + 0x0);
PROVIDE(vblank_cmd_dispatch = vblank_cmd_dispatch + 0x0);
PROVIDE(color_transform_calc = color_transform_calc + 0x0);
PROVIDE(vdp2_scroll_update = vdp2_scroll_update + 0x0);
PROVIDE(polygon_param_setup = polygon_param_setup + 0x0);
PROVIDE(scene_state_process = scene_state_process + 0x0);
PROVIDE(smpc_data_manage = smpc_data_manage + 0x0);
PROVIDE(master_menu_render = master_menu_render + 0x0);
PROVIDE(data_table_copy = data_table_copy + 0x0);
PROVIDE(game_logic_main = game_logic_main + 0x0);
PROVIDE(display_channel_iter = display_channel_iter + 0x0);
PROVIDE(vdp1_sprite_draw_main = vdp1_sprite_draw_main + 0x0);
PROVIDE(menu_anim_system = menu_anim_system + 0x0);
PROVIDE(cmd_validate_exec = cmd_validate_exec + 0x0);
PROVIDE(menu_input_proc = menu_input_proc + 0x0);
PROVIDE(cmd_dispatch_helper = cmd_dispatch_helper + 0x0);
PROVIDE(cmd_status_check = cmd_status_check + 0x0);
PROVIDE(menu_sound_trigger = menu_sound_trigger + 0x0);
PROVIDE(cmd_queue_process = cmd_queue_process + 0x0);
PROVIDE(cmd_result_store = cmd_result_store + 0x0);
PROVIDE(cmd_error_return = cmd_error_return + 0x0);
PROVIDE(menu_text_layout = menu_text_layout + 0x0);
PROVIDE(menu_element_dispatch = menu_element_dispatch + 0x0);
PROVIDE(menu_elem_visible = menu_elem_visible + 0x0);
PROVIDE(menu_elem_alpha = menu_elem_alpha + 0x0);
PROVIDE(reg_prologue_chain_b = reg_prologue_chain_b + 0x0);
PROVIDE(menu_cursor_blink = menu_cursor_blink + 0x0);
PROVIDE(menu_cursor_pos = menu_cursor_pos + 0x0);
PROVIDE(menu_select_hl = menu_select_hl + 0x0);
PROVIDE(cmd_validate_chain = cmd_validate_chain + 0x0);
PROVIDE(cmd_multi_validate = cmd_multi_validate + 0x0);
PROVIDE(menu_list_scroll = menu_list_scroll + 0x0);
PROVIDE(menu_state_handler = menu_state_handler + 0x0);
PROVIDE(menu_option_adj = menu_option_adj + 0x0);
PROVIDE(menu_toggle_switch = menu_toggle_switch + 0x0);
PROVIDE(menu_stub_nop = menu_stub_nop + 0x0);
PROVIDE(menu_separator = menu_separator + 0x0);
PROVIDE(menu_header_render = menu_header_render + 0x0);
PROVIDE(cmd_dispatch_main = cmd_dispatch_main + 0x0);
PROVIDE(menu_page_transition = menu_page_transition + 0x0);
PROVIDE(menu_bg_scroll = menu_bg_scroll + 0x0);
PROVIDE(menu_bg_color = menu_bg_color + 0x0);
PROVIDE(menu_bg_pattern = menu_bg_pattern + 0x0);
PROVIDE(menu_border_render = menu_border_render + 0x0);
PROVIDE(nop_stub_menu = nop_stub_menu + 0x0);
PROVIDE(menu_timer_clock = menu_timer_clock + 0x0);
PROVIDE(menu_credits_elem = menu_credits_elem + 0x0);
PROVIDE(menu_ranking_display = menu_ranking_display + 0x0);
PROVIDE(sys_boot_table_init = sys_boot_table_init + 0x0);
PROVIDE(sys_timer_config = sys_timer_config + 0x0);
PROVIDE(sys_dma_channel_init = sys_dma_channel_init + 0x0);
PROVIDE(save_checksum_seed = save_checksum_seed + 0x0);
PROVIDE(save_checksum_calc = save_checksum_calc + 0x0);
PROVIDE(save_data_validate = save_data_validate + 0x0);
PROVIDE(save_field_read = save_field_read + 0x0);
PROVIDE(save_field_write = save_field_write + 0x0);
PROVIDE(save_block_copy = save_block_copy + 0x0);
PROVIDE(save_header_parse = save_header_parse + 0x0);
PROVIDE(save_size_calc = save_size_calc + 0x0);
PROVIDE(save_serialize = save_serialize + 0x0);
PROVIDE(save_deserialize = save_deserialize + 0x0);
PROVIDE(save_integrity_check = save_integrity_check + 0x0);
PROVIDE(save_data_size = save_data_size + 0x0);
PROVIDE(save_data_serialize = save_data_serialize + 0x0);
PROVIDE(save_commit_write = save_commit_write + 0x0);
PROVIDE(display_scene_update = display_scene_update + 0x0);
PROVIDE(display_init_chain = display_init_chain + 0x0);
PROVIDE(high_score_mgr = high_score_mgr + 0x0);
PROVIDE(hud_menu_system = hud_menu_system + 0x0);
PROVIDE(hud_display_ext = hud_display_ext + 0x0);
PROVIDE(display_palette_calc = display_palette_calc + 0x0);
PROVIDE(hud_display_large = hud_display_large + 0x0);
PROVIDE(render_credits_stub = render_credits_stub + 0x0);
PROVIDE(high_score_render = high_score_render + 0x0);
PROVIDE(bus_lock_table_ctrl = bus_lock_table_ctrl + 0x0);
PROVIDE(display_nop_stub_a = display_nop_stub_a + 0x0);
PROVIDE(name_entry_state = name_entry_state + 0x0);
PROVIDE(display_nop_stub_b = display_nop_stub_b + 0x0);
PROVIDE(name_entry_render = name_entry_render + 0x0);
PROVIDE(display_element_draw = display_element_draw + 0x0);
PROVIDE(options_menu_state = options_menu_state + 0x0);
PROVIDE(scene_invalidate_a = scene_invalidate_a + 0x0);
PROVIDE(scene_invalidate_b = scene_invalidate_b + 0x0);
PROVIDE(controller_config = controller_config + 0x0);
PROVIDE(scene_color_matrix = scene_color_matrix + 0x0);
PROVIDE(sound_test_player = sound_test_player + 0x0);
PROVIDE(options_render = options_render + 0x0);
PROVIDE(display_channel_handler = display_channel_handler + 0x0);
PROVIDE(hud_update_main = hud_update_main + 0x0);
PROVIDE(vblank_color_apply = vblank_color_apply + 0x0);
PROVIDE(attract_init_setup = attract_init_setup + 0x0);
PROVIDE(scene_frame_render = scene_frame_render + 0x0);
PROVIDE(slave_sh2_setup = slave_sh2_setup + 0x0);
PROVIDE(sprite_batch_emit = sprite_batch_emit + 0x0);
PROVIDE(hud_toggle_ctrl = hud_toggle_ctrl + 0x0);
PROVIDE(credits_scroll_entry = credits_scroll_entry + 0x0);
PROVIDE(credits_scroll = credits_scroll + 0x0);
PROVIDE(attract_demo_chooser = attract_demo_chooser + 0x0);
PROVIDE(credits_text_format = credits_text_format + 0x0);
PROVIDE(menu_text_position = menu_text_position + 0x0);
PROVIDE(credits_page_build = credits_page_build + 0x0);
PROVIDE(menu_element_render = menu_element_render + 0x0);
PROVIDE(audio_frame_process = audio_frame_process + 0x0);
PROVIDE(audio_state_update = audio_state_update + 0x0);
PROVIDE(audio_sync_master = audio_sync_master + 0x0);
PROVIDE(audio_sync_slave = audio_sync_slave + 0x0);
PROVIDE(audio_event_trigger = audio_event_trigger + 0x0);
PROVIDE(attract_timer_init = attract_timer_init + 0x0);
PROVIDE(attract_demo_select = attract_demo_select + 0x0);
PROVIDE(vblank_dma_chain = vblank_dma_chain + 0x0);
PROVIDE(attract_state_change = attract_state_change + 0x0);
PROVIDE(attract_mode_timer = attract_mode_timer + 0x0);
PROVIDE(attract_timer_tick = attract_timer_tick + 0x0);
PROVIDE(attract_transition = attract_transition + 0x0);
PROVIDE(attract_replay_loader = attract_replay_loader + 0x0);
PROVIDE(attract_demo_loader = attract_demo_loader + 0x0);
PROVIDE(race_timer_sync = race_timer_sync + 0x0);
PROVIDE(scene_buffer_update = scene_buffer_update + 0x0);
PROVIDE(attract_display_orch = attract_display_orch + 0x0);
PROVIDE(vblank_palette_apply = vblank_palette_apply + 0x0);
PROVIDE(hud_palette_select = hud_palette_select + 0x0);
PROVIDE(dma_param_chain_init = dma_param_chain_init + 0x0);
PROVIDE(attract_elem_a = attract_elem_a + 0x0);
PROVIDE(attract_elem_b = attract_elem_b + 0x0);
PROVIDE(scu_dma_transfer = scu_dma_transfer + 0x0);
PROVIDE(attract_cleanup = attract_cleanup + 0x0);
PROVIDE(attract_display_main = attract_display_main + 0x0);
PROVIDE(error_code_stub = error_code_stub + 0x0);
PROVIDE(validation_dispatch = validation_dispatch + 0x0);
PROVIDE(obj_init_validate = obj_init_validate + 0x0);
PROVIDE(evt_error_code_return = evt_error_code_return + 0x0);
PROVIDE(hw_init_setup = hw_init_setup + 0x0);
PROVIDE(sys_boot_sequence = sys_boot_sequence + 0x0);
PROVIDE(mem_test_verify = mem_test_verify + 0x0);
PROVIDE(evt_validate_multi = evt_validate_multi + 0x0);
PROVIDE(sys_timer_init = sys_timer_init + 0x0);
PROVIDE(evt_condition_test = evt_condition_test + 0x0);
PROVIDE(timer_stub = timer_stub + 0x0);
PROVIDE(sys_timer_tick = sys_timer_tick + 0x0);
PROVIDE(timer_overflow_handler = timer_overflow_handler + 0x0);
PROVIDE(obj_setup_decomp = obj_setup_decomp + 0x0);
PROVIDE(watchdog_timer_reset = watchdog_timer_reset + 0x0);
PROVIDE(evt_cmd_enqueue = evt_cmd_enqueue + 0x0);
PROVIDE(evt_status_flag_set = evt_status_flag_set + 0x0);
PROVIDE(evt_condition_return = evt_condition_return + 0x0);
PROVIDE(nop_stub_sys = nop_stub_sys + 0x0);
PROVIDE(dma_channel_setup = dma_channel_setup + 0x0);
PROVIDE(dma_complete_check = dma_complete_check + 0x0);
PROVIDE(evt_checkpoint_handler = evt_checkpoint_handler + 0x0);
PROVIDE(event_priority_set = event_priority_set + 0x0);
PROVIDE(event_timer_sched = event_timer_sched + 0x0);
PROVIDE(reg_push_fragment = reg_push_fragment + 0x0);
PROVIDE(event_callback_dispatch = event_callback_dispatch + 0x0);
PROVIDE(evt_state_dispatch = evt_state_dispatch + 0x0);
PROVIDE(nop_stub_evt = nop_stub_evt + 0x0);
PROVIDE(event_queue_flush = event_queue_flush + 0x0);
PROVIDE(road_segment_check = road_segment_check + 0x0);
PROVIDE(evt_reg_save = evt_reg_save + 0x0);
PROVIDE(event_queue_overflow = event_queue_overflow + 0x0);
PROVIDE(evt_boundary_check = evt_boundary_check + 0x0);
PROVIDE(buffer_slot_alloc = buffer_slot_alloc + 0x0);
PROVIDE(vblank_int_ext = vblank_int_ext + 0x0);
PROVIDE(queue_validator = queue_validator + 0x0);
PROVIDE(queue_helper = queue_helper + 0x0);
PROVIDE(cmd_enqueue = cmd_enqueue + 0x0);
PROVIDE(evt_field_update = evt_field_update + 0x0);
PROVIDE(ai_brake_handler = ai_brake_handler + 0x0);
PROVIDE(evt_checkpoint_validate = evt_checkpoint_validate + 0x0);
PROVIDE(evt_validator_pair = evt_validator_pair + 0x0);
PROVIDE(ai_section_check = ai_section_check + 0x0);
PROVIDE(error_trap_handler = error_trap_handler + 0x0);
PROVIDE(nmi_handler = nmi_handler + 0x0);
PROVIDE(checkpoint_state_check = checkpoint_state_check + 0x0);
PROVIDE(track_segment_interp = track_segment_interp + 0x0);
PROVIDE(track_shadow_test = track_shadow_test + 0x0);
PROVIDE(track_surface_check = track_surface_check + 0x0);
PROVIDE(large_prologue_save = large_prologue_save + 0x0);
PROVIDE(dma_int_handler = dma_int_handler + 0x0);
PROVIDE(evt_callback_handler = evt_callback_handler + 0x0);
PROVIDE(state_field_read = state_field_read + 0x0);
PROVIDE(track_road_validate = track_road_validate + 0x0);
PROVIDE(track_boundary_check = track_boundary_check + 0x0);
PROVIDE(track_surface_validate = track_surface_validate + 0x0);
PROVIDE(state_transition_handler = state_transition_handler + 0x0);
PROVIDE(large_func_prologue = large_func_prologue + 0x0);
PROVIDE(major_state_update = major_state_update + 0x0);
PROVIDE(track_edge_validate = track_edge_validate + 0x0);
PROVIDE(track_shadow_validate = track_shadow_validate + 0x0);
PROVIDE(player_vehicle_interp = player_vehicle_interp + 0x0);
PROVIDE(validator_dispatch = validator_dispatch + 0x0);
PROVIDE(bulk_struct_init = bulk_struct_init + 0x0);
PROVIDE(cdb_wait_scdq = cdb_wait_scdq + 0x0);
PROVIDE(fixpt_div_helper = fixpt_div_helper + 0x0);
PROVIDE(fixpt_div_full = fixpt_div_full + 0x0);
PROVIDE(div_result_read = div_result_read + 0x0);
PROVIDE(math_trig_lib = math_trig_lib + 0x0);
PROVIDE(color_palette_effect = color_palette_effect + 0x0);
PROVIDE(palette_engine_core = palette_engine_core + 0x0);
PROVIDE(palette_render_main = palette_render_main + 0x0);
PROVIDE(binary_final_func = binary_final_func + 0x0);

/* DAT_ symbols (12) */
PROVIDE(DAT_060024d6 = 0x060024D6);
PROVIDE(DAT_06002554 = 0x06002554);
PROVIDE(DAT_06002556 = 0x06002556);
PROVIDE(DAT_060025c6 = 0x060025C6);
PROVIDE(DAT_060026aa = 0x060026AA);
PROVIDE(DAT_060026ac = 0x060026AC);
PROVIDE(DAT_060026ae = 0x060026AE);
PROVIDE(DAT_060026b0 = 0x060026B0);
PROVIDE(DAT_060026b2 = 0x060026B2);
PROVIDE(DAT_06082A7C = 0x06082A7C);
PROVIDE(DAT_06083264 = 0x06083264);
PROVIDE(DAT_06083268 = 0x06083268);

/* Synthetic symbols -- fixed (data/system range) (649) */
PROVIDE(sym_0600026C = 0x0600026C);
PROVIDE(sym_06000300 = 0x06000300);
PROVIDE(sym_06000310 = 0x06000310);
PROVIDE(sym_06000320 = 0x06000320);
PROVIDE(sym_06000324 = 0x06000324);
PROVIDE(sym_06000340 = 0x06000340);
PROVIDE(sym_06000344 = 0x06000344);
PROVIDE(sym_06000348 = 0x06000348);
PROVIDE(sym_06000354 = 0x06000354);
PROVIDE(sym_06000358 = 0x06000358);
PROVIDE(sym_06063690 = 0x06063690);
PROVIDE(sym_06063750 = 0x06063750);
PROVIDE(sym_06063788 = 0x06063788);
PROVIDE(sym_06063790 = 0x06063790);
PROVIDE(sym_06063798 = 0x06063798);
PROVIDE(sym_060637F8 = 0x060637F8);
PROVIDE(sym_06063800 = 0x06063800);
PROVIDE(sym_06063808 = 0x06063808);
PROVIDE(sym_06063810 = 0x06063810);
PROVIDE(sym_06063818 = 0x06063818);
PROVIDE(sym_06063828 = 0x06063828);
PROVIDE(sym_06063838 = 0x06063838);
PROVIDE(sym_06063848 = 0x06063848);
PROVIDE(sym_06063850 = 0x06063850);
PROVIDE(sym_060638A0 = 0x060638A0);
PROVIDE(sym_060638B0 = 0x060638B0);
PROVIDE(sym_060638C8 = 0x060638C8);
PROVIDE(sym_06063918 = 0x06063918);
PROVIDE(sym_06063920 = 0x06063920);
PROVIDE(sym_06063958 = 0x06063958);
PROVIDE(sym_06063960 = 0x06063960);
PROVIDE(sym_06063968 = 0x06063968);
PROVIDE(sym_06063970 = 0x06063970);
PROVIDE(sym_060639D8 = 0x060639D8);
PROVIDE(sym_060639E0 = 0x060639E0);
PROVIDE(sym_060639F8 = 0x060639F8);
PROVIDE(sym_06063AD0 = 0x06063AD0);
PROVIDE(sym_06063AF0 = 0x06063AF0);
PROVIDE(sym_06063AF8 = 0x06063AF8);
PROVIDE(sym_06063B80 = 0x06063B80);
PROVIDE(sym_06063B88 = 0x06063B88);
PROVIDE(sym_06063C90 = 0x06063C90);
PROVIDE(sym_06063C98 = 0x06063C98);
PROVIDE(sym_06063CA0 = 0x06063CA0);
PROVIDE(sym_06063CF8 = 0x06063CF8);
PROVIDE(sym_06063D00 = 0x06063D00);
PROVIDE(sym_06063D08 = 0x06063D08);
PROVIDE(sym_06063D90 = 0x06063D90);
PROVIDE(sym_06063D94 = 0x06063D94);
PROVIDE(g_pad_state = 0x06063D98);
PROVIDE(sym_06063D9A = 0x06063D9A);
PROVIDE(sym_06063D9C = 0x06063D9C);
PROVIDE(sym_06063D9E = 0x06063D9E);
PROVIDE(sym_06063DA0 = 0x06063DA0);
PROVIDE(sym_06063DA8 = 0x06063DA8);
PROVIDE(sym_06063DF8 = 0x06063DF8);
PROVIDE(sym_06063E04 = 0x06063E04);
PROVIDE(sym_06063E08 = 0x06063E08);
PROVIDE(sym_06063E0C = 0x06063E0C);
PROVIDE(sym_06063E10 = 0x06063E10);
PROVIDE(sym_06063E14 = 0x06063E14);
PROVIDE(sym_06063E1C = 0x06063E1C);
PROVIDE(sym_06063E20 = 0x06063E20);
PROVIDE(sym_06063E24 = 0x06063E24);
PROVIDE(sym_06063E28 = 0x06063E28);
PROVIDE(sym_06063E2C = 0x06063E2C);
PROVIDE(sym_06063E30 = 0x06063E30);
PROVIDE(sym_06063E34 = 0x06063E34);
PROVIDE(sym_06063E4C = 0x06063E4C);
PROVIDE(sym_06063E50 = 0x06063E50);
PROVIDE(sym_06063E60 = 0x06063E60);
PROVIDE(sym_06063E64 = 0x06063E64);
PROVIDE(sym_06063E74 = 0x06063E74);
PROVIDE(sym_06063E78 = 0x06063E78);
PROVIDE(sym_06063E88 = 0x06063E88);
PROVIDE(sym_06063E8C = 0x06063E8C);
PROVIDE(sym_06063E9C = 0x06063E9C);
PROVIDE(sym_06063EB0 = 0x06063EB0);
PROVIDE(sym_06063EC4 = 0x06063EC4);
PROVIDE(sym_06063ED8 = 0x06063ED8);
PROVIDE(sym_06063EEC = 0x06063EEC);
PROVIDE(sym_06063EF0 = 0x06063EF0);
PROVIDE(sym_06063EF8 = 0x06063EF8);
PROVIDE(sym_06063F04 = 0x06063F04);
PROVIDE(sym_06063F08 = 0x06063F08);
PROVIDE(sym_06063F10 = 0x06063F10);
PROVIDE(sym_06063F14 = 0x06063F14);
PROVIDE(sym_06063F18 = 0x06063F18);
PROVIDE(sym_06063F1C = 0x06063F1C);
PROVIDE(sym_06063F20 = 0x06063F20);
PROVIDE(sym_06063F24 = 0x06063F24);
PROVIDE(sym_06063F28 = 0x06063F28);
PROVIDE(sym_06063F3C = 0x06063F3C);
PROVIDE(sym_06063F42 = 0x06063F42);
PROVIDE(sym_06063F44 = 0x06063F44);
PROVIDE(sym_06063F46 = 0x06063F46);
PROVIDE(sym_06063F48 = 0x06063F48);
PROVIDE(sym_06063F4A = 0x06063F4A);
PROVIDE(sym_06063F4C = 0x06063F4C);
PROVIDE(sym_06063F50 = 0x06063F50);
PROVIDE(sym_06063F54 = 0x06063F54);
PROVIDE(sym_06063F58 = 0x06063F58);
PROVIDE(sym_06063F5C = 0x06063F5C);
PROVIDE(sym_06063F60 = 0x06063F60);
PROVIDE(sym_06063F64 = 0x06063F64);
PROVIDE(sym_060684EC = 0x060684EC);
PROVIDE(sym_06069BB6 = 0x06069BB6);
PROVIDE(sym_0606A4EC = 0x0606A4EC);
PROVIDE(sym_0606A4F0 = 0x0606A4F0);
PROVIDE(sym_0606A4F4 = 0x0606A4F4);
PROVIDE(sym_0606A4F8 = 0x0606A4F8);
PROVIDE(sym_0606B178 = 0x0606B178);
PROVIDE(sym_0606BDF8 = 0x0606BDF8);
PROVIDE(sym_0606BDFC = 0x0606BDFC);
PROVIDE(sym_060785FC = 0x060785FC);
PROVIDE(sym_06078604 = 0x06078604);
PROVIDE(sym_0607861C = 0x0607861C);
PROVIDE(sym_06078620 = 0x06078620);
PROVIDE(sym_06078624 = 0x06078624);
PROVIDE(sym_06078634 = 0x06078634);
PROVIDE(sym_06078635 = 0x06078635);
PROVIDE(sym_06078636 = 0x06078636);
PROVIDE(sym_06078637 = 0x06078637);
PROVIDE(sym_06078638 = 0x06078638);
PROVIDE(sym_0607863C = 0x0607863C);
PROVIDE(sym_06078644 = 0x06078644);
PROVIDE(sym_06078648 = 0x06078648);
PROVIDE(sym_06078649 = 0x06078649);
PROVIDE(sym_0607864A = 0x0607864A);
PROVIDE(sym_0607864B = 0x0607864B);
PROVIDE(sym_0607864C = 0x0607864C);
PROVIDE(sym_06078650 = 0x06078650);
PROVIDE(sym_06078652 = 0x06078652);
PROVIDE(sym_06078654 = 0x06078654);
PROVIDE(sym_06078656 = 0x06078656);
PROVIDE(sym_06078658 = 0x06078658);
PROVIDE(sym_0607865A = 0x0607865A);
PROVIDE(sym_0607865C = 0x0607865C);
PROVIDE(sym_0607865E = 0x0607865E);
PROVIDE(sym_06078660 = 0x06078660);
PROVIDE(sym_06078662 = 0x06078662);
PROVIDE(sym_06078663 = 0x06078663);
PROVIDE(sym_06078664 = 0x06078664);
PROVIDE(sym_06078668 = 0x06078668);
PROVIDE(sym_0607866C = 0x0607866C);
PROVIDE(sym_0607866D = 0x0607866D);
PROVIDE(sym_06078670 = 0x06078670);
PROVIDE(sym_0607867C = 0x0607867C);
PROVIDE(sym_06078680 = 0x06078680);
PROVIDE(sym_06078698 = 0x06078698);
PROVIDE(sym_0607869A = 0x0607869A);
PROVIDE(sym_0607869C = 0x0607869C);
PROVIDE(sym_060786A0 = 0x060786A0);
PROVIDE(sym_060786A4 = 0x060786A4);
PROVIDE(sym_060786A8 = 0x060786A8);
PROVIDE(sym_060786AC = 0x060786AC);
PROVIDE(sym_060786B0 = 0x060786B0);
PROVIDE(sym_060786B4 = 0x060786B4);
PROVIDE(sym_060786B8 = 0x060786B8);
PROVIDE(sym_060786BC = 0x060786BC);
PROVIDE(sym_060786C0 = 0x060786C0);
PROVIDE(sym_060786C4 = 0x060786C4);
PROVIDE(sym_060786C8 = 0x060786C8);
PROVIDE(sym_060786CA = 0x060786CA);
PROVIDE(sym_060786CC = 0x060786CC);
PROVIDE(sym_0607884C = 0x0607884C);
PROVIDE(sym_06078850 = 0x06078850);
PROVIDE(sym_06078854 = 0x06078854);
PROVIDE(sym_06078858 = 0x06078858);
PROVIDE(sym_0607885C = 0x0607885C);
PROVIDE(sym_06078860 = 0x06078860);
PROVIDE(sym_06078864 = 0x06078864);
PROVIDE(sym_06078868 = 0x06078868);
PROVIDE(sym_0607886C = 0x0607886C);
PROVIDE(sym_0607886E = 0x0607886E);
PROVIDE(sym_06078870 = 0x06078870);
PROVIDE(sym_06078878 = 0x06078878);
PROVIDE(sym_0607887A = 0x0607887A);
PROVIDE(sym_0607887C = 0x0607887C);
PROVIDE(sym_0607887E = 0x0607887E);
PROVIDE(sym_0607887F = 0x0607887F);
PROVIDE(sym_06078880 = 0x06078880);
PROVIDE(sym_06078884 = 0x06078884);
PROVIDE(sym_06078888 = 0x06078888);
PROVIDE(sym_06078894 = 0x06078894);
PROVIDE(sym_06078898 = 0x06078898);
PROVIDE(sym_0607889C = 0x0607889C);
PROVIDE(sym_060788A0 = 0x060788A0);
PROVIDE(sym_060788A4 = 0x060788A4);
PROVIDE(sym_060788A8 = 0x060788A8);
PROVIDE(sym_060788AC = 0x060788AC);
PROVIDE(sym_060788B0 = 0x060788B0);
PROVIDE(sym_060788B2 = 0x060788B2);
PROVIDE(sym_060788B4 = 0x060788B4);
PROVIDE(sym_060788C0 = 0x060788C0);
PROVIDE(sym_060788CC = 0x060788CC);
PROVIDE(sym_060788D8 = 0x060788D8);
PROVIDE(sym_060788E4 = 0x060788E4);
PROVIDE(sym_060788F0 = 0x060788F0);
PROVIDE(sym_060788F4 = 0x060788F4);
PROVIDE(sym_060788F8 = 0x060788F8);
PROVIDE(sym_060788FC = 0x060788FC);
PROVIDE(sym_06078900 = 0x06078900);
PROVIDE(sym_06078B68 = 0x06078B68);
PROVIDE(sym_0607E940 = 0x0607E940);
PROVIDE(sym_0607E944 = 0x0607E944);
PROVIDE(sym_0607E948 = 0x0607E948);
PROVIDE(sym_0607E94C = 0x0607E94C);
PROVIDE(sym_0607E9EC = 0x0607E9EC);
PROVIDE(sym_0607EA8C = 0x0607EA8C);
PROVIDE(sym_0607EA98 = 0x0607EA98);
PROVIDE(sym_0607EA9C = 0x0607EA9C);
PROVIDE(sym_0607EAA0 = 0x0607EAA0);
PROVIDE(sym_0607EAAC = 0x0607EAAC);
PROVIDE(sym_0607EAB8 = 0x0607EAB8);
PROVIDE(sym_0607EABC = 0x0607EABC);
PROVIDE(sym_0607EAC0 = 0x0607EAC0);
PROVIDE(sym_0607EAC8 = 0x0607EAC8);
PROVIDE(sym_0607EACC = 0x0607EACC);
PROVIDE(sym_0607EAD0 = 0x0607EAD0);
PROVIDE(sym_0607EAD8 = 0x0607EAD8);
PROVIDE(sym_0607EADC = 0x0607EADC);
PROVIDE(sym_0607EAE0 = 0x0607EAE0);
PROVIDE(sym_0607EAE4 = 0x0607EAE4);
PROVIDE(sym_0607EAE8 = 0x0607EAE8);
PROVIDE(sym_0607EAEC = 0x0607EAEC);
PROVIDE(sym_0607EB84 = 0x0607EB84);
PROVIDE(sym_0607EB88 = 0x0607EB88);
PROVIDE(sym_0607EB8C = 0x0607EB8C);
PROVIDE(sym_0607EB94 = 0x0607EB94);
PROVIDE(sym_0607EBBC = 0x0607EBBC);
PROVIDE(sym_0607EBC0 = 0x0607EBC0);
PROVIDE(sym_0607EBC4 = 0x0607EBC4);
PROVIDE(sym_0607EBC8 = 0x0607EBC8);
PROVIDE(sym_0607EBCC = 0x0607EBCC);
PROVIDE(sym_0607EBD0 = 0x0607EBD0);
PROVIDE(sym_0607EBD4 = 0x0607EBD4);
PROVIDE(sym_0607EBDC = 0x0607EBDC);
PROVIDE(sym_0607EBE0 = 0x0607EBE0);
PROVIDE(sym_0607EBE4 = 0x0607EBE4);
PROVIDE(sym_0607EBEC = 0x0607EBEC);
PROVIDE(sym_0607EBF4 = 0x0607EBF4);
PROVIDE(sym_0607EBF8 = 0x0607EBF8);
PROVIDE(sym_0607ED88 = 0x0607ED88);
PROVIDE(sym_0607ED8C = 0x0607ED8C);
PROVIDE(sym_0607ED90 = 0x0607ED90);
PROVIDE(sym_0607ED91 = 0x0607ED91);
PROVIDE(sym_06080307 = 0x06080307);
PROVIDE(sym_06081888 = 0x06081888);
PROVIDE(sym_0608188A = 0x0608188A);
PROVIDE(sym_0608188C = 0x0608188C);
PROVIDE(sym_0608188E = 0x0608188E);
PROVIDE(sym_06081890 = 0x06081890);
PROVIDE(sym_06081892 = 0x06081892);
PROVIDE(sym_06081894 = 0x06081894);
PROVIDE(sym_06081896 = 0x06081896);
PROVIDE(sym_06081898 = 0x06081898);
PROVIDE(sym_0608215C = 0x0608215C);
PROVIDE(sym_06082A20 = 0x06082A20);
PROVIDE(sym_06082A24 = 0x06082A24);
PROVIDE(sym_06082A25 = 0x06082A25);
PROVIDE(sym_06082A26 = 0x06082A26);
PROVIDE(sym_06082A28 = 0x06082A28);
PROVIDE(sym_06082A2C = 0x06082A2C);
PROVIDE(sym_06082A30 = 0x06082A30);
PROVIDE(sym_06082A34 = 0x06082A34);
PROVIDE(sym_06082A38 = 0x06082A38);
PROVIDE(sym_06082A3C = 0x06082A3C);
PROVIDE(sym_06082A40 = 0x06082A40);
PROVIDE(sym_06082A44 = 0x06082A44);
PROVIDE(sym_06082A48 = 0x06082A48);
PROVIDE(sym_06082A50 = 0x06082A50);
PROVIDE(sym_06082A54 = 0x06082A54);
PROVIDE(sym_06082A58 = 0x06082A58);
PROVIDE(sym_06082A5C = 0x06082A5C);
PROVIDE(sym_06082A60 = 0x06082A60);
PROVIDE(sym_06082A68 = 0x06082A68);
PROVIDE(sym_06082A6C = 0x06082A6C);
PROVIDE(sym_06082A70 = 0x06082A70);
PROVIDE(sym_06082A74 = 0x06082A74);
PROVIDE(sym_06082A78 = 0x06082A78);
PROVIDE(sym_06083238 = 0x06083238);
PROVIDE(sym_0608323C = 0x0608323C);
PROVIDE(sym_06083240 = 0x06083240);
PROVIDE(sym_06083244 = 0x06083244);
PROVIDE(sym_06083250 = 0x06083250);
PROVIDE(sym_06083254 = 0x06083254);
PROVIDE(sym_06083255 = 0x06083255);
PROVIDE(sym_06083258 = 0x06083258);
PROVIDE(sym_0608325C = 0x0608325C);
PROVIDE(sym_06083260 = 0x06083260);
PROVIDE(sym_06083261 = 0x06083261);
PROVIDE(sym_06083274 = 0x06083274);
PROVIDE(sym_06084360 = 0x06084360);
PROVIDE(sym_0608436C = 0x0608436C);
PROVIDE(sym_06084AEC = 0x06084AEC);
PROVIDE(sym_06084AF0 = 0x06084AF0);
PROVIDE(sym_06084AF2 = 0x06084AF2);
PROVIDE(sym_06084AF4 = 0x06084AF4);
PROVIDE(sym_06084AF6 = 0x06084AF6);
PROVIDE(sym_06084AF8 = 0x06084AF8);
PROVIDE(sym_06084AFC = 0x06084AFC);
PROVIDE(sym_06084B00 = 0x06084B00);
PROVIDE(sym_06084B08 = 0x06084B08);
PROVIDE(sym_06084B0C = 0x06084B0C);
PROVIDE(sym_06084B10 = 0x06084B10);
PROVIDE(sym_06084B14 = 0x06084B14);
PROVIDE(sym_06084B18 = 0x06084B18);
PROVIDE(sym_06084B1C = 0x06084B1C);
PROVIDE(sym_06084B20 = 0x06084B20);
PROVIDE(sym_06084B28 = 0x06084B28);
PROVIDE(sym_06084CA8 = 0x06084CA8);
PROVIDE(sym_06084E28 = 0x06084E28);
PROVIDE(sym_06084FA8 = 0x06084FA8);
PROVIDE(sym_06084FAC = 0x06084FAC);
PROVIDE(sym_06084FB0 = 0x06084FB0);
PROVIDE(sym_06084FB4 = 0x06084FB4);
PROVIDE(sym_06084FB8 = 0x06084FB8);
PROVIDE(sym_06084FC8 = 0x06084FC8);
PROVIDE(sym_06085490 = 0x06085490);
PROVIDE(sym_06085640 = 0x06085640);
PROVIDE(sym_06085F88 = 0x06085F88);
PROVIDE(sym_06085F89 = 0x06085F89);
PROVIDE(sym_06085F8A = 0x06085F8A);
PROVIDE(sym_06085F8B = 0x06085F8B);
PROVIDE(sym_06085F8C = 0x06085F8C);
PROVIDE(sym_06085F8D = 0x06085F8D);
PROVIDE(sym_06085F8E = 0x06085F8E);
PROVIDE(sym_06085F90 = 0x06085F90);
PROVIDE(sym_06085F92 = 0x06085F92);
PROVIDE(sym_06085F94 = 0x06085F94);
PROVIDE(sym_06085F98 = 0x06085F98);
PROVIDE(sym_06085FAC = 0x06085FAC);
PROVIDE(sym_06085FBC = 0x06085FBC);
PROVIDE(sym_06085FC0 = 0x06085FC0);
PROVIDE(sym_06085FCC = 0x06085FCC);
PROVIDE(sym_06085FD0 = 0x06085FD0);
PROVIDE(sym_06085FF0 = 0x06085FF0);
PROVIDE(sym_06085FF1 = 0x06085FF1);
PROVIDE(sym_06085FF2 = 0x06085FF2);
PROVIDE(sym_06085FF3 = 0x06085FF3);
PROVIDE(sym_06085FF4 = 0x06085FF4);
PROVIDE(sym_06085FF5 = 0x06085FF5);
PROVIDE(sym_06085FF6 = 0x06085FF6);
PROVIDE(sym_06085FF7 = 0x06085FF7);
PROVIDE(sym_06085FF8 = 0x06085FF8);
PROVIDE(sym_06085FF9 = 0x06085FF9);
PROVIDE(sym_06085FFC = 0x06085FFC);
PROVIDE(sym_06086000 = 0x06086000);
PROVIDE(sym_06086004 = 0x06086004);
PROVIDE(sym_06086008 = 0x06086008);
PROVIDE(sym_0608600C = 0x0608600C);
PROVIDE(sym_0608600D = 0x0608600D);
PROVIDE(sym_0608600E = 0x0608600E);
PROVIDE(sym_0608600F = 0x0608600F);
PROVIDE(sym_06086010 = 0x06086010);
PROVIDE(sym_06086011 = 0x06086011);
PROVIDE(sym_06086012 = 0x06086012);
PROVIDE(sym_06086014 = 0x06086014);
PROVIDE(sym_06086018 = 0x06086018);
PROVIDE(sym_0608601C = 0x0608601C);
PROVIDE(sym_06086020 = 0x06086020);
PROVIDE(sym_06086024 = 0x06086024);
PROVIDE(sym_06086028 = 0x06086028);
PROVIDE(sym_0608602C = 0x0608602C);
PROVIDE(sym_06086030 = 0x06086030);
PROVIDE(sym_06086034 = 0x06086034);
PROVIDE(sym_06086038 = 0x06086038);
PROVIDE(sym_0608604C = 0x0608604C);
PROVIDE(sym_06086050 = 0x06086050);
PROVIDE(sym_06086054 = 0x06086054);
PROVIDE(sym_06086056 = 0x06086056);
PROVIDE(sym_06086058 = 0x06086058);
PROVIDE(sym_0608605A = 0x0608605A);
PROVIDE(sym_06087060 = 0x06087060);
PROVIDE(sym_06087064 = 0x06087064);
PROVIDE(sym_06087068 = 0x06087068);
PROVIDE(sym_0608706A = 0x0608706A);
PROVIDE(sym_0608706C = 0x0608706C);
PROVIDE(sym_06087070 = 0x06087070);
PROVIDE(sym_06087074 = 0x06087074);
PROVIDE(sym_0608707C = 0x0608707C);
PROVIDE(sym_06087080 = 0x06087080);
PROVIDE(sym_06087084 = 0x06087084);
PROVIDE(sym_06087086 = 0x06087086);
PROVIDE(sym_06087094 = 0x06087094);
PROVIDE(sym_060870F4 = 0x060870F4);
PROVIDE(sym_060877B4 = 0x060877B4);
PROVIDE(sym_060877D8 = 0x060877D8);
PROVIDE(sym_060877D9 = 0x060877D9);
PROVIDE(sym_060877DD = 0x060877DD);
PROVIDE(sym_060877E4 = 0x060877E4);
PROVIDE(sym_060877E8 = 0x060877E8);
PROVIDE(sym_060877F0 = 0x060877F0);
PROVIDE(sym_060877F4 = 0x060877F4);
PROVIDE(sym_060877F8 = 0x060877F8);
PROVIDE(sym_060877FC = 0x060877FC);
PROVIDE(sym_06087800 = 0x06087800);
PROVIDE(sym_06087802 = 0x06087802);
PROVIDE(sym_06087804 = 0x06087804);
PROVIDE(sym_06087806 = 0x06087806);
PROVIDE(sym_06087808 = 0x06087808);
PROVIDE(sym_0608780A = 0x0608780A);
PROVIDE(sym_0608780C = 0x0608780C);
PROVIDE(sym_06087810 = 0x06087810);
PROVIDE(sym_06087814 = 0x06087814);
PROVIDE(sym_06087818 = 0x06087818);
PROVIDE(sym_0608781C = 0x0608781C);
PROVIDE(sym_06087820 = 0x06087820);
PROVIDE(sym_06087824 = 0x06087824);
PROVIDE(sym_06087825 = 0x06087825);
PROVIDE(sym_06087826 = 0x06087826);
PROVIDE(sym_06087828 = 0x06087828);
PROVIDE(sym_0608782C = 0x0608782C);
PROVIDE(sym_06087C6C = 0x06087C6C);
PROVIDE(sym_06087C84 = 0x06087C84);
PROVIDE(sym_06087C87 = 0x06087C87);
PROVIDE(sym_06089594 = 0x06089594);
PROVIDE(sym_06089595 = 0x06089595);
PROVIDE(sym_06089598 = 0x06089598);
PROVIDE(sym_0608959C = 0x0608959C);
PROVIDE(sym_060895A0 = 0x060895A0);
PROVIDE(sym_0608962C = 0x0608962C);
PROVIDE(sym_060896B8 = 0x060896B8);
PROVIDE(sym_06089744 = 0x06089744);
PROVIDE(sym_060897D0 = 0x060897D0);
PROVIDE(sym_06089B18 = 0x06089B18);
PROVIDE(sym_06089C58 = 0x06089C58);
PROVIDE(sym_06089D98 = 0x06089D98);
PROVIDE(sym_06089DB4 = 0x06089DB4);
PROVIDE(sym_06089DD0 = 0x06089DD0);
PROVIDE(sym_06089DEC = 0x06089DEC);
PROVIDE(sym_06089E08 = 0x06089E08);
PROVIDE(sym_06089E24 = 0x06089E24);
PROVIDE(sym_06089E28 = 0x06089E28);
PROVIDE(sym_06089E2C = 0x06089E2C);
PROVIDE(sym_06089E30 = 0x06089E30);
PROVIDE(sym_06089E34 = 0x06089E34);
PROVIDE(sym_06089E38 = 0x06089E38);
PROVIDE(sym_06089E3C = 0x06089E3C);
PROVIDE(sym_06089E40 = 0x06089E40);
PROVIDE(sym_06089E44 = 0x06089E44);
PROVIDE(sym_06089E46 = 0x06089E46);
PROVIDE(sym_06089E4A = 0x06089E4A);
PROVIDE(sym_06089E96 = 0x06089E96);
PROVIDE(sym_06089E98 = 0x06089E98);
PROVIDE(sym_06089E9C = 0x06089E9C);
PROVIDE(sym_06089E9E = 0x06089E9E);
PROVIDE(sym_06089EA0 = 0x06089EA0);
PROVIDE(sym_06089EC4 = 0x06089EC4);
PROVIDE(sym_06089EC6 = 0x06089EC6);
PROVIDE(sym_06089EC8 = 0x06089EC8);
PROVIDE(sym_06089ECC = 0x06089ECC);
PROVIDE(sym_06089ED0 = 0x06089ED0);
PROVIDE(sym_06089ED4 = 0x06089ED4);
PROVIDE(sym_06089ED6 = 0x06089ED6);
PROVIDE(sym_06089ED8 = 0x06089ED8);
PROVIDE(sym_06089EDA = 0x06089EDA);
PROVIDE(sym_06089EDC = 0x06089EDC);
PROVIDE(sym_06089EE0 = 0x06089EE0);
PROVIDE(sym_0608A4E0 = 0x0608A4E0);
PROVIDE(sym_0608A4F0 = 0x0608A4F0);
PROVIDE(sym_0608A520 = 0x0608A520);
PROVIDE(sym_0608A52C = 0x0608A52C);
PROVIDE(sym_0608A530 = 0x0608A530);
PROVIDE(sym_0608A6B0 = 0x0608A6B0);
PROVIDE(sym_0608A6C0 = 0x0608A6C0);
PROVIDE(sym_0608A6F0 = 0x0608A6F0);
PROVIDE(sym_0608A6FC = 0x0608A6FC);
PROVIDE(sym_0608A704 = 0x0608A704);
PROVIDE(sym_0608A70C = 0x0608A70C);
PROVIDE(sym_0608A718 = 0x0608A718);
PROVIDE(sym_0608A724 = 0x0608A724);
PROVIDE(sym_0608A730 = 0x0608A730);
PROVIDE(sym_0608A73C = 0x0608A73C);
PROVIDE(sym_0608A76C = 0x0608A76C);
PROVIDE(sym_0608A790 = 0x0608A790);
PROVIDE(sym_0608A798 = 0x0608A798);
PROVIDE(sym_0608A7A0 = 0x0608A7A0);
PROVIDE(sym_0608A7AC = 0x0608A7AC);
PROVIDE(sym_0608A7B8 = 0x0608A7B8);
PROVIDE(sym_0608A7C4 = 0x0608A7C4);
PROVIDE(sym_0608A7D0 = 0x0608A7D0);
PROVIDE(sym_0608A800 = 0x0608A800);
PROVIDE(sym_0608A820 = 0x0608A820);
PROVIDE(sym_0608AC20 = 0x0608AC20);
PROVIDE(sym_0608E460 = 0x0608E460);
PROVIDE(sym_06094220 = 0x06094220);
PROVIDE(sym_06094620 = 0x06094620);
PROVIDE(sym_06094A20 = 0x06094A20);
PROVIDE(sym_06094A28 = 0x06094A28);
PROVIDE(sym_06094A30 = 0x06094A30);
PROVIDE(sym_06094A60 = 0x06094A60);
PROVIDE(sym_06094A90 = 0x06094A90);
PROVIDE(sym_06094AB0 = 0x06094AB0);
PROVIDE(sym_06094AE0 = 0x06094AE0);
PROVIDE(sym_06094AE4 = 0x06094AE4);
PROVIDE(sym_06094EE4 = 0x06094EE4);
PROVIDE(sym_06094EEC = 0x06094EEC);
PROVIDE(sym_06094EF4 = 0x06094EF4);
PROVIDE(sym_06094F24 = 0x06094F24);
PROVIDE(sym_06094F54 = 0x06094F54);
PROVIDE(sym_06094F74 = 0x06094F74);
PROVIDE(sym_06094FA4 = 0x06094FA4);
PROVIDE(sym_06094FA8 = 0x06094FA8);
PROVIDE(sym_06094FAC = 0x06094FAC);
PROVIDE(sym_06095F48 = 0x06095F48);
PROVIDE(sym_060961A8 = 0x060961A8);
PROVIDE(sym_060A0FA8 = 0x060A0FA8);
PROVIDE(sym_060A17A8 = 0x060A17A8);
PROVIDE(sym_060A2428 = 0x060A2428);
PROVIDE(sym_060A2468 = 0x060A2468);
PROVIDE(sym_060A246C = 0x060A246C);
PROVIDE(sym_060A2470 = 0x060A2470);
PROVIDE(sym_060A3C70 = 0x060A3C70);
PROVIDE(sym_060A3D70 = 0x060A3D70);
PROVIDE(sym_060A3D74 = 0x060A3D74);
PROVIDE(sym_060A3D78 = 0x060A3D78);
PROVIDE(sym_060A3D7C = 0x060A3D7C);
PROVIDE(sym_060A3D84 = 0x060A3D84);
PROVIDE(sym_060A3D88 = 0x060A3D88);
PROVIDE(sym_060A3D96 = 0x060A3D96);
PROVIDE(sym_060A3DA8 = 0x060A3DA8);
PROVIDE(sym_060A3DB0 = 0x060A3DB0);
PROVIDE(sym_060A3DB8 = 0x060A3DB8);
PROVIDE(sym_060A3DBA = 0x060A3DBA);
PROVIDE(sym_060A3DBC = 0x060A3DBC);
PROVIDE(sym_060A3DBE = 0x060A3DBE);
PROVIDE(sym_060A3DF8 = 0x060A3DF8);
PROVIDE(sym_060A3E38 = 0x060A3E38);
PROVIDE(sym_060A3E3C = 0x060A3E3C);
PROVIDE(sym_060A3E44 = 0x060A3E44);
PROVIDE(sym_060A3E48 = 0x060A3E48);
PROVIDE(sym_060A3E68 = 0x060A3E68);
PROVIDE(sym_060A3EE8 = 0x060A3EE8);
PROVIDE(sym_060A3F68 = 0x060A3F68);
PROVIDE(sym_060A45D0 = 0x060A45D0);
PROVIDE(sym_060A4C38 = 0x060A4C38);
PROVIDE(sym_060A4C3C = 0x060A4C3C);
PROVIDE(sym_060A4C40 = 0x060A4C40);
PROVIDE(sym_060A4C44 = 0x060A4C44);
PROVIDE(sym_060A4C48 = 0x060A4C48);
PROVIDE(sym_060A4C4C = 0x060A4C4C);
PROVIDE(sym_060A4C50 = 0x060A4C50);
PROVIDE(sym_060A4C54 = 0x060A4C54);
PROVIDE(sym_060A4C58 = 0x060A4C58);
PROVIDE(sym_060A4C59 = 0x060A4C59);
PROVIDE(sym_060A4C5C = 0x060A4C5C);
PROVIDE(sym_060A4C60 = 0x060A4C60);
PROVIDE(sym_060A4C68 = 0x060A4C68);
PROVIDE(sym_060A4C70 = 0x060A4C70);
PROVIDE(sym_060A4C74 = 0x060A4C74);
PROVIDE(sym_060A4C78 = 0x060A4C78);
PROVIDE(sym_060A4C80 = 0x060A4C80);
PROVIDE(sym_060A4C84 = 0x060A4C84);
PROVIDE(sym_060A4C88 = 0x060A4C88);
PROVIDE(sym_060A4C8C = 0x060A4C8C);
PROVIDE(sym_060A4C90 = 0x060A4C90);
PROVIDE(sym_060A4C92 = 0x060A4C92);
PROVIDE(sym_060A4C94 = 0x060A4C94);
PROVIDE(sym_060A4C96 = 0x060A4C96);
PROVIDE(sym_060A4C98 = 0x060A4C98);
PROVIDE(sym_060A4C9C = 0x060A4C9C);
PROVIDE(sym_060A4CA8 = 0x060A4CA8);
PROVIDE(sym_060A4CA9 = 0x060A4CA9);
PROVIDE(sym_060A4CAA = 0x060A4CAA);
PROVIDE(sym_060A4CAB = 0x060A4CAB);
PROVIDE(sym_060A4CAC = 0x060A4CAC);
PROVIDE(sym_060A4CAE = 0x060A4CAE);
PROVIDE(sym_060A4CAF = 0x060A4CAF);
PROVIDE(sym_060A4CB0 = 0x060A4CB0);
PROVIDE(sym_060A4CB4 = 0x060A4CB4);
PROVIDE(sym_060A4CB8 = 0x060A4CB8);
PROVIDE(sym_060A4CBC = 0x060A4CBC);
PROVIDE(sym_060A4CC0 = 0x060A4CC0);
PROVIDE(sym_060A4CC4 = 0x060A4CC4);
PROVIDE(sym_060A4CC8 = 0x060A4CC8);
PROVIDE(sym_060A4CCC = 0x060A4CCC);
PROVIDE(sym_060A4CD0 = 0x060A4CD0);
PROVIDE(sym_060A4CD4 = 0x060A4CD4);
PROVIDE(sym_060A4CD8 = 0x060A4CD8);
PROVIDE(sym_060A4CD9 = 0x060A4CD9);
PROVIDE(sym_060A4CE8 = 0x060A4CE8);
PROVIDE(sym_060A4CEC = 0x060A4CEC);
PROVIDE(sym_060A4CF0 = 0x060A4CF0);
PROVIDE(sym_060A4CF4 = 0x060A4CF4);
PROVIDE(sym_060A4CF8 = 0x060A4CF8);
PROVIDE(sym_060A4CFC = 0x060A4CFC);
PROVIDE(sym_060A4CFD = 0x060A4CFD);
PROVIDE(sym_060A4D02 = 0x060A4D02);
PROVIDE(sym_060A4D04 = 0x060A4D04);
PROVIDE(sym_060A4D08 = 0x060A4D08);
PROVIDE(sym_060A4D0C = 0x060A4D0C);
PROVIDE(sym_060A4D0D = 0x060A4D0D);
PROVIDE(sym_060A4D0E = 0x060A4D0E);
PROVIDE(sym_060A4D0F = 0x060A4D0F);
PROVIDE(sym_060A4D10 = 0x060A4D10);
PROVIDE(sym_060A4D11 = 0x060A4D11);
PROVIDE(sym_060A4D14 = 0x060A4D14);
PROVIDE(sym_060A4D18 = 0x060A4D18);
PROVIDE(sym_060A4D28 = 0x060A4D28);
PROVIDE(sym_060A4D30 = 0x060A4D30);
PROVIDE(sym_060A4D36 = 0x060A4D36);
PROVIDE(sym_060A4D3E = 0x060A4D3E);
PROVIDE(sym_060A4D46 = 0x060A4D46);
PROVIDE(sym_060A4D58 = 0x060A4D58);
PROVIDE(sym_060A4D5C = 0x060A4D5C);
PROVIDE(sym_060A4D60 = 0x060A4D60);
PROVIDE(sym_060A4D80 = 0x060A4D80);
PROVIDE(sym_060A4D84 = 0x060A4D84);
PROVIDE(sym_060A4D88 = 0x060A4D88);
PROVIDE(sym_060A4D8C = 0x060A4D8C);
PROVIDE(sym_060A4D90 = 0x060A4D90);
PROVIDE(sym_060A4D94 = 0x060A4D94);
PROVIDE(sym_060A4D98 = 0x060A4D98);
PROVIDE(sym_060A4D9A = 0x060A4D9A);
PROVIDE(sym_060A4D9C = 0x060A4D9C);
PROVIDE(sym_060A4D9E = 0x060A4D9E);
PROVIDE(sym_060A4DA0 = 0x060A4DA0);
PROVIDE(sym_060A4DA2 = 0x060A4DA2);
PROVIDE(sym_060A4DA4 = 0x060A4DA4);
PROVIDE(sym_060A4DA5 = 0x060A4DA5);
PROVIDE(sym_060A4DA6 = 0x060A4DA6);
PROVIDE(sym_060A4DA7 = 0x060A4DA7);
PROVIDE(sym_060A4DA8 = 0x060A4DA8);
PROVIDE(sym_060A53A8 = 0x060A53A8);
PROVIDE(sym_060A53B0 = 0x060A53B0);
PROVIDE(sym_060A53B8 = 0x060A53B8);
PROVIDE(sym_060A5400 = 0x060A5400);
PROVIDE(sym_060A6000 = 0x060A6000);
PROVIDE(sym_060BF000 = 0x060BF000);
PROVIDE(sym_060C2000 = 0x060C2000);
PROVIDE(sym_060C6000 = 0x060C6000);
PROVIDE(sym_060D5840 = 0x060D5840);
PROVIDE(sym_060D6900 = 0x060D6900);
PROVIDE(sym_060EE300 = 0x060EE300);
PROVIDE(sym_060EE7D4 = 0x060EE7D4);
PROVIDE(sym_060EECA8 = 0x060EECA8);
PROVIDE(sym_060EF17C = 0x060EF17C);
PROVIDE(sym_060EF650 = 0x060EF650);
PROVIDE(sym_060EFB24 = 0x060EFB24);
PROVIDE(sym_060F0000 = 0x060F0000);
PROVIDE(sym_060F8000 = 0x060F8000);
PROVIDE(sym_060FD730 = 0x060FD730);
PROVIDE(sym_060FD760 = 0x060FD760);
PROVIDE(sym_060FD7C0 = 0x060FD7C0);
PROVIDE(sym_060FD970 = 0x060FD970);
PROVIDE(sym_060FDA18 = 0x060FDA18);
PROVIDE(sym_060FDAA8 = 0x060FDAA8);

/* 3142 code-range sym_ defined as labels in .s files (relocatable) */
